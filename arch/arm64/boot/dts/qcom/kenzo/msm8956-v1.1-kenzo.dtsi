/*
 * Silicon v1.1 speed-bin overrides for Xiaomi Redmi Note 3 (kenzo/kate).
 *
 * This program is free software; you can redistribute it and/or modify
 * it under the terms of the GNU General Public License version 2 and
 * only version 2 as published by the Free Software Foundation.
 *
 * This program is distributed in the hope that it will be useful,
 * but WITHOUT ANY WARRANTY; without even the implied warranty of
 * MERCHANTABILITY or FITNESS FOR A PARTICULAR PURPOSE.  See the
 * GNU General Public License for more details.
 */

/* The stock A72 and A53 tables stop at speed bin 0 on this revision. */
&clock_cpu {
	/delete-property/ qcom,speed2-bin-v0-c0;
	/delete-property/ qcom,speed2-bin-v0-c1;
	/delete-property/ qcom,speed2-bin-v0-cci;
};

&apc0_vreg_corner {
	qcom,cpr-speed-bin-max-corners = <0 0 2 4 8>;
};

&apc1_vreg_corner {
	qcom,cpr-speed-bin-max-corners = <0 0 2 4 7>;
};
