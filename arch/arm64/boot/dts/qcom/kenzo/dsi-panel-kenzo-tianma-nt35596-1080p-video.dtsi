/*
 * kenzo/kate Tianma NT35596 1080p video panel
 * Generated by scripts/gen_panels.py from the stock kenzo device tree.
 * Do not edit by hand.
 */

&mdss_mdp {
	dsi_tianma_nt35596_1080_vid: qcom,mdss_dsi_tianma_nt35596_1080p_video {
		qcom,mdss-dsi-cold-command = [
			23 00 00 00 00 00 02 ff 01
			23 00 00 00 00 00 02 fb 01
			23 00 00 00 00 00 02 75 00
			23 00 00 00 00 00 02 76 e1
			23 00 00 00 00 00 02 77 00
			23 00 00 00 00 00 02 78 e7
			23 00 00 00 00 00 02 79 00
			23 00 00 00 00 00 02 7a f2
			23 00 00 00 00 00 02 7b 00
			23 00 00 00 00 00 02 7c fc
			23 00 00 00 00 00 02 7d 01
			23 00 00 00 00 00 02 7e 06
			23 00 00 00 00 00 02 7f 01
			23 00 00 00 00 00 02 80 0f
			23 00 00 00 00 00 02 81 01
			23 00 00 00 00 00 02 82 18
			23 00 00 00 00 00 02 83 01
			23 00 00 00 00 00 02 84 21
			23 00 00 00 00 00 02 85 01
			23 00 00 00 00 00 02 86 29
			23 00 00 00 00 00 02 87 01
			23 00 00 00 00 00 02 88 47
			23 00 00 00 00 00 02 89 01
			23 00 00 00 00 00 02 8a 62
			23 00 00 00 00 00 02 8b 01
			23 00 00 00 00 00 02 8c 91
			23 00 00 00 00 00 02 8d 01
			23 00 00 00 00 00 02 8e b7
			23 00 00 00 00 00 02 8f 01
			23 00 00 00 00 00 02 90 f8
			23 00 00 00 00 00 02 91 02
			23 00 00 00 00 00 02 92 2f
			23 00 00 00 00 00 02 93 02
			23 00 00 00 00 00 02 94 31
			23 00 00 00 00 00 02 95 02
			23 00 00 00 00 00 02 96 66
			23 00 00 00 00 00 02 97 02
			23 00 00 00 00 00 02 98 a6
			23 00 00 00 00 00 02 99 02
			23 00 00 00 00 00 02 9a cf
			23 00 00 00 00 00 02 9b 03
			23 00 00 00 00 00 02 9c 07
			23 00 00 00 00 00 02 9d 03
			23 00 00 00 00 00 02 9e 2b
			23 00 00 00 00 00 02 9f 03
			23 00 00 00 00 00 02 a0 58
			23 00 00 00 00 00 02 a2 03
			23 00 00 00 00 00 02 a3 65
			23 00 00 00 00 00 02 a4 03
			23 00 00 00 00 00 02 a5 70
			23 00 00 00 00 00 02 a6 03
			23 00 00 00 00 00 02 a7 79
			23 00 00 00 00 00 02 a9 03
			23 00 00 00 00 00 02 aa 8b
			23 00 00 00 00 00 02 ab 03
			23 00 00 00 00 00 02 ac 91
			23 00 00 00 00 00 02 ad 03
			23 00 00 00 00 00 02 ae 95
			23 00 00 00 00 00 02 af 03
			23 00 00 00 00 00 02 b0 a1
			23 00 00 00 00 00 02 b1 03
			23 00 00 00 00 00 02 b2 b2
			23 00 00 00 00 00 02 b3 00
			23 00 00 00 00 00 02 b4 e1
			23 00 00 00 00 00 02 b5 00
			23 00 00 00 00 00 02 b6 e7
			23 00 00 00 00 00 02 b7 00
			23 00 00 00 00 00 02 b8 f2
			23 00 00 00 00 00 02 b9 00
			23 00 00 00 00 00 02 ba fc
			23 00 00 00 00 00 02 bb 01
			23 00 00 00 00 00 02 bc 06
			23 00 00 00 00 00 02 bd 01
			23 00 00 00 00 00 02 be 0f
			23 00 00 00 00 00 02 bf 01
			23 00 00 00 00 00 02 c0 18
			23 00 00 00 00 00 02 c1 01
			23 00 00 00 00 00 02 c2 21
			23 00 00 00 00 00 02 c3 01
			23 00 00 00 00 00 02 c4 29
			23 00 00 00 00 00 02 c5 01
			23 00 00 00 00 00 02 c6 47
			23 00 00 00 00 00 02 c7 01
			23 00 00 00 00 00 02 c8 62
			23 00 00 00 00 00 02 c9 01
			23 00 00 00 00 00 02 ca 91
			23 00 00 00 00 00 02 cb 01
			23 00 00 00 00 00 02 cc b7
			23 00 00 00 00 00 02 cd 01
			23 00 00 00 00 00 02 ce f8
			23 00 00 00 00 00 02 cf 02
			23 00 00 00 00 00 02 d0 2f
			23 00 00 00 00 00 02 d1 02
			23 00 00 00 00 00 02 d2 31
			23 00 00 00 00 00 02 d3 02
			23 00 00 00 00 00 02 d4 66
			23 00 00 00 00 00 02 d5 02
			23 00 00 00 00 00 02 d6 a6
			23 00 00 00 00 00 02 d7 02
			23 00 00 00 00 00 02 d8 cf
			23 00 00 00 00 00 02 d9 03
			23 00 00 00 00 00 02 da 07
			23 00 00 00 00 00 02 db 03
			23 00 00 00 00 00 02 dc 2b
			23 00 00 00 00 00 02 dd 03
			23 00 00 00 00 00 02 de 58
			23 00 00 00 00 00 02 df 03
			23 00 00 00 00 00 02 e0 65
			23 00 00 00 00 00 02 e1 03
			23 00 00 00 00 00 02 e2 70
			23 00 00 00 00 00 02 e3 03
			23 00 00 00 00 00 02 e4 79
			23 00 00 00 00 00 02 e5 03
			23 00 00 00 00 00 02 e6 8b
			23 00 00 00 00 00 02 e7 03
			23 00 00 00 00 00 02 e8 91
			23 00 00 00 00 00 02 e9 03
			23 00 00 00 00 00 02 ea 95
			23 00 00 00 00 00 02 eb 03
			23 00 00 00 00 00 02 ec a1
			23 00 00 00 00 00 02 ed 03
			23 01 00 00 00 00 02 ee b2
			23 00 00 00 00 00 02 ef 00
			23 00 00 00 00 00 02 f0 a1
			23 00 00 00 00 00 02 f1 00
			23 00 00 00 00 00 02 f2 a9
			23 00 00 00 00 00 02 f3 00
			23 00 00 00 00 00 02 f4 b8
			23 00 00 00 00 00 02 f5 00
			23 00 00 00 00 00 02 f6 c6
			23 00 00 00 00 00 02 f7 00
			23 00 00 00 00 00 02 f8 d3
			23 00 00 00 00 00 02 f9 00
			23 00 00 00 00 00 02 fa df
			23 00 00 00 00 00 02 ff 02
			23 00 00 00 00 00 02 fb 01
			23 00 00 00 00 00 02 00 00
			23 00 00 00 00 00 02 01 ea
			23 00 00 00 00 00 02 02 00
			23 00 00 00 00 00 02 03 f5
			23 00 00 00 00 00 02 04 00
			23 00 00 00 00 00 02 05 ff
			23 00 00 00 00 00 02 06 01
			23 00 00 00 00 00 02 07 25
			23 00 00 00 00 00 02 08 01
			23 00 00 00 00 00 02 09 44
			23 00 00 00 00 00 02 0a 01
			23 00 00 00 00 00 02 0b 79
			23 00 00 00 00 00 02 0c 01
			23 00 00 00 00 00 02 0d a5
			23 00 00 00 00 00 02 0e 01
			23 00 00 00 00 00 02 0f ec
			23 00 00 00 00 00 02 10 02
			23 00 00 00 00 00 02 11 26
			23 00 00 00 00 00 02 12 02
			23 00 00 00 00 00 02 13 28
			23 00 00 00 00 00 02 14 02
			23 00 00 00 00 00 02 15 60
			23 00 00 00 00 00 02 16 02
			23 00 00 00 00 00 02 17 a1
			23 00 00 00 00 00 02 18 02
			23 00 00 00 00 00 02 19 cb
			23 00 00 00 00 00 02 1a 03
			23 00 00 00 00 00 02 1b 03
			23 00 00 00 00 00 02 1c 03
			23 00 00 00 00 00 02 1d 28
			23 00 00 00 00 00 02 1e 03
			23 00 00 00 00 00 02 1f 53
			23 00 00 00 00 00 02 20 03
			23 00 00 00 00 00 02 21 60
			23 00 00 00 00 00 02 22 03
			23 00 00 00 00 00 02 23 6f
			23 00 00 00 00 00 02 24 03
			23 00 00 00 00 00 02 25 7d
			23 00 00 00 00 00 02 26 03
			23 00 00 00 00 00 02 27 8d
			23 00 00 00 00 00 02 28 03
			23 00 00 00 00 00 02 29 9b
			23 00 00 00 00 00 02 2a 03
			23 00 00 00 00 00 02 2b a9
			23 00 00 00 00 00 02 2d 03
			23 00 00 00 00 00 02 2f aa
			23 00 00 00 00 00 02 30 03
			23 00 00 00 00 00 02 31 b2
			23 00 00 00 00 00 02 32 00
			23 00 00 00 00 00 02 33 a1
			23 00 00 00 00 00 02 34 00
			23 00 00 00 00 00 02 35 a9
			23 00 00 00 00 00 02 36 00
			23 00 00 00 00 00 02 37 b8
			23 00 00 00 00 00 02 38 00
			23 00 00 00 00 00 02 39 c6
			23 00 00 00 00 00 02 3a 00
			23 00 00 00 00 00 02 3b d3
			23 00 00 00 00 00 02 3d 00
			23 00 00 00 00 00 02 3f df
			23 00 00 00 00 00 02 40 00
			23 00 00 00 00 00 02 41 ea
			23 00 00 00 00 00 02 42 00
			23 00 00 00 00 00 02 43 f5
			23 00 00 00 00 00 02 44 00
			23 00 00 00 00 00 02 45 ff
			23 00 00 00 00 00 02 46 01
			23 00 00 00 00 00 02 47 25
			23 00 00 00 00 00 02 48 01
			23 00 00 00 00 00 02 49 44
			23 00 00 00 00 00 02 4a 01
			23 00 00 00 00 00 02 4b 79
			23 00 00 00 00 00 02 4c 01
			23 00 00 00 00 00 02 4d a5
			23 00 00 00 00 00 02 4e 01
			23 00 00 00 00 00 02 4f ec
			23 00 00 00 00 00 02 50 02
			23 00 00 00 00 00 02 51 26
			23 00 00 00 00 00 02 52 02
			23 00 00 00 00 00 02 53 28
			23 00 00 00 00 00 02 54 02
			23 00 00 00 00 00 02 55 60
			23 00 00 00 00 00 02 56 02
			23 00 00 00 00 00 02 58 a1
			23 00 00 00 00 00 02 59 02
			23 00 00 00 00 00 02 5a cb
			23 00 00 00 00 00 02 5b 03
			23 00 00 00 00 00 02 5c 03
			23 00 00 00 00 00 02 5d 03
			23 00 00 00 00 00 02 5e 28
			23 00 00 00 00 00 02 5f 03
			23 00 00 00 00 00 02 60 53
			23 00 00 00 00 00 02 61 03
			23 00 00 00 00 00 02 62 60
			23 00 00 00 00 00 02 63 03
			23 00 00 00 00 00 02 64 6f
			23 00 00 00 00 00 02 65 03
			23 00 00 00 00 00 02 66 7d
			23 00 00 00 00 00 02 67 03
			23 00 00 00 00 00 02 68 8d
			23 00 00 00 00 00 02 69 03
			23 00 00 00 00 00 02 6a 9b
			23 00 00 00 00 00 02 6b 03
			23 00 00 00 00 00 02 6c a9
			23 00 00 00 00 00 02 6d 03
			23 00 00 00 00 00 02 6e aa
			23 00 00 00 00 00 02 6f 03
			23 01 00 00 00 00 02 70 b2
			23 00 00 00 00 00 02 71 00
			23 00 00 00 00 00 02 72 36
			23 00 00 00 00 00 02 73 00
			23 00 00 00 00 00 02 74 3a
			23 00 00 00 00 00 02 75 00
			23 00 00 00 00 00 02 76 52
			23 00 00 00 00 00 02 77 00
			23 00 00 00 00 00 02 78 69
			23 00 00 00 00 00 02 79 00
			23 00 00 00 00 00 02 7a 7d
			23 00 00 00 00 00 02 7b 00
			23 00 00 00 00 00 02 7c 90
			23 00 00 00 00 00 02 7d 00
			23 00 00 00 00 00 02 7e a0
			23 00 00 00 00 00 02 7f 00
			23 00 00 00 00 00 02 80 af
			23 00 00 00 00 00 02 81 00
			23 00 00 00 00 00 02 82 bd
			23 00 00 00 00 00 02 83 00
			23 00 00 00 00 00 02 84 ef
			23 00 00 00 00 00 02 85 01
			23 00 00 00 00 00 02 86 17
			23 00 00 00 00 00 02 87 01
			23 00 00 00 00 00 02 88 57
			23 00 00 00 00 00 02 89 01
			23 00 00 00 00 00 02 8a 8b
			23 00 00 00 00 00 02 8b 01
			23 00 00 00 00 00 02 8c db
			23 00 00 00 00 00 02 8d 02
			23 00 00 00 00 00 02 8e 1a
			23 00 00 00 00 00 02 8f 02
			23 00 00 00 00 00 02 90 1c
			23 00 00 00 00 00 02 91 02
			23 00 00 00 00 00 02 92 56
			23 00 00 00 00 00 02 93 02
			23 00 00 00 00 00 02 94 98
			23 00 00 00 00 00 02 95 02
			23 00 00 00 00 00 02 96 c3
			23 00 00 00 00 00 02 97 02
			23 00 00 00 00 00 02 98 fa
			23 00 00 00 00 00 02 99 03
			23 00 00 00 00 00 02 9a 1f
			23 00 00 00 00 00 02 9b 03
			23 00 00 00 00 00 02 9c 52
			23 00 00 00 00 00 02 9d 03
			23 00 00 00 00 00 02 9e 5f
			23 00 00 00 00 00 02 9f 03
			23 00 00 00 00 00 02 a0 79
			23 00 00 00 00 00 02 a2 03
			23 00 00 00 00 00 02 a3 7e
			23 00 00 00 00 00 02 a4 03
			23 00 00 00 00 00 02 a5 ae
			23 00 00 00 00 00 02 a6 03
			23 00 00 00 00 00 02 a7 b0
			23 00 00 00 00 00 02 a9 03
			23 00 00 00 00 00 02 aa b2
			23 00 00 00 00 00 02 ab 03
			23 00 00 00 00 00 02 ac b2
			23 00 00 00 00 00 02 ad 03
			23 00 00 00 00 00 02 ae b2
			23 00 00 00 00 00 02 af 00
			23 00 00 00 00 00 02 b0 36
			23 00 00 00 00 00 02 b1 00
			23 00 00 00 00 00 02 b2 3a
			23 00 00 00 00 00 02 b3 00
			23 00 00 00 00 00 02 b4 52
			23 00 00 00 00 00 02 b5 00
			23 00 00 00 00 00 02 b6 69
			23 00 00 00 00 00 02 b7 00
			23 00 00 00 00 00 02 b8 7d
			23 00 00 00 00 00 02 b9 00
			23 00 00 00 00 00 02 ba 90
			23 00 00 00 00 00 02 bb 00
			23 00 00 00 00 00 02 bc a0
			23 00 00 00 00 00 02 bd 00
			23 00 00 00 00 00 02 be af
			23 00 00 00 00 00 02 bf 00
			23 00 00 00 00 00 02 c0 bd
			23 00 00 00 00 00 02 c1 00
			23 00 00 00 00 00 02 c2 ef
			23 00 00 00 00 00 02 c3 01
			23 00 00 00 00 00 02 c4 17
			23 00 00 00 00 00 02 c5 01
			23 00 00 00 00 00 02 c6 57
			23 00 00 00 00 00 02 c7 01
			23 00 00 00 00 00 02 c8 8b
			23 00 00 00 00 00 02 c9 01
			23 00 00 00 00 00 02 ca db
			23 00 00 00 00 00 02 cb 02
			23 00 00 00 00 00 02 cc 1a
			23 00 00 00 00 00 02 cd 02
			23 00 00 00 00 00 02 ce 1c
			23 00 00 00 00 00 02 cf 02
			23 00 00 00 00 00 02 d0 56
			23 00 00 00 00 00 02 d1 02
			23 00 00 00 00 00 02 d2 98
			23 00 00 00 00 00 02 d3 02
			23 00 00 00 00 00 02 d4 c3
			23 00 00 00 00 00 02 d5 02
			23 00 00 00 00 00 02 d6 fa
			23 00 00 00 00 00 02 d7 03
			23 00 00 00 00 00 02 d8 1f
			23 00 00 00 00 00 02 d9 03
			23 00 00 00 00 00 02 da 52
			23 00 00 00 00 00 02 db 03
			23 00 00 00 00 00 02 dc 5f
			23 00 00 00 00 00 02 dd 03
			23 00 00 00 00 00 02 de 79
			23 00 00 00 00 00 02 df 03
			23 00 00 00 00 00 02 e0 7e
			23 00 00 00 00 00 02 e1 03
			23 00 00 00 00 00 02 e2 ae
			23 00 00 00 00 00 02 e3 03
			23 00 00 00 00 00 02 e4 b0
			23 00 00 00 00 00 02 e5 03
			23 00 00 00 00 00 02 e6 b2
			23 00 00 00 00 00 02 e7 03
			23 00 00 00 00 00 02 e8 b2
			23 00 00 00 00 00 02 e9 03
			23 00 00 00 00 00 02 ea b2
			23 01 00 00 00 00 02 ff 00
		];
		qcom,mdss-dsi-warm-command = [
			23 00 00 00 00 00 02 ff 01
			23 00 00 00 00 00 02 fb 01
			23 00 00 00 00 00 02 75 00
			23 00 00 00 00 00 02 76 24
			23 00 00 00 00 00 02 77 00
			23 00 00 00 00 00 02 78 35
			23 00 00 00 00 00 02 79 00
			23 00 00 00 00 00 02 7a 54
			23 00 00 00 00 00 02 7b 00
			23 00 00 00 00 00 02 7c 6c
			23 00 00 00 00 00 02 7d 00
			23 00 00 00 00 00 02 7e 81
			23 00 00 00 00 00 02 7f 00
			23 00 00 00 00 00 02 80 94
			23 00 00 00 00 00 02 81 00
			23 00 00 00 00 00 02 82 a4
			23 00 00 00 00 00 02 83 00
			23 00 00 00 00 00 02 84 b3
			23 00 00 00 00 00 02 85 00
			23 00 00 00 00 00 02 86 c1
			23 00 00 00 00 00 02 87 00
			23 00 00 00 00 00 02 88 f1
			23 00 00 00 00 00 02 89 01
			23 00 00 00 00 00 02 8a 17
			23 00 00 00 00 00 02 8b 01
			23 00 00 00 00 00 02 8c 55
			23 00 00 00 00 00 02 8d 01
			23 00 00 00 00 00 02 8e 86
			23 00 00 00 00 00 02 8f 01
			23 00 00 00 00 00 02 90 d3
			23 00 00 00 00 00 02 91 02
			23 00 00 00 00 00 02 92 11
			23 00 00 00 00 00 02 93 02
			23 00 00 00 00 00 02 94 13
			23 00 00 00 00 00 02 95 02
			23 00 00 00 00 00 02 96 4b
			23 00 00 00 00 00 02 97 02
			23 00 00 00 00 00 02 98 8a
			23 00 00 00 00 00 02 99 02
			23 00 00 00 00 00 02 9a b1
			23 00 00 00 00 00 02 9b 02
			23 00 00 00 00 00 02 9c e6
			23 00 00 00 00 00 02 9d 03
			23 00 00 00 00 00 02 9e 0a
			23 00 00 00 00 00 02 9f 03
			23 00 00 00 00 00 02 a0 38
			23 00 00 00 00 00 02 a2 03
			23 00 00 00 00 00 02 a3 45
			23 00 00 00 00 00 02 a4 03
			23 00 00 00 00 00 02 a5 55
			23 00 00 00 00 00 02 a6 03
			23 00 00 00 00 00 02 a7 64
			23 00 00 00 00 00 02 a9 03
			23 00 00 00 00 00 02 aa 77
			23 00 00 00 00 00 02 ab 03
			23 00 00 00 00 00 02 ac 90
			23 00 00 00 00 00 02 ad 03
			23 00 00 00 00 00 02 ae a2
			23 00 00 00 00 00 02 af 03
			23 00 00 00 00 00 02 b0 a5
			23 00 00 00 00 00 02 b1 03
			23 00 00 00 00 00 02 b2 b2
			23 00 00 00 00 00 02 b3 00
			23 00 00 00 00 00 02 b4 24
			23 00 00 00 00 00 02 b5 00
			23 00 00 00 00 00 02 b6 35
			23 00 00 00 00 00 02 b7 00
			23 00 00 00 00 00 02 b8 54
			23 00 00 00 00 00 02 b9 00
			23 00 00 00 00 00 02 ba 6c
			23 00 00 00 00 00 02 bb 00
			23 00 00 00 00 00 02 bc 81
			23 00 00 00 00 00 02 bd 00
			23 00 00 00 00 00 02 be 94
			23 00 00 00 00 00 02 bf 00
			23 00 00 00 00 00 02 c0 a4
			23 00 00 00 00 00 02 c1 00
			23 00 00 00 00 00 02 c2 b3
			23 00 00 00 00 00 02 c3 00
			23 00 00 00 00 00 02 c4 c1
			23 00 00 00 00 00 02 c5 00
			23 00 00 00 00 00 02 c6 f1
			23 00 00 00 00 00 02 c7 01
			23 00 00 00 00 00 02 c8 17
			23 00 00 00 00 00 02 c9 01
			23 00 00 00 00 00 02 ca 55
			23 00 00 00 00 00 02 cb 01
			23 00 00 00 00 00 02 cc 86
			23 00 00 00 00 00 02 cd 01
			23 00 00 00 00 00 02 ce d3
			23 00 00 00 00 00 02 cf 02
			23 00 00 00 00 00 02 d0 11
			23 00 00 00 00 00 02 d1 02
			23 00 00 00 00 00 02 d2 13
			23 00 00 00 00 00 02 d3 02
			23 00 00 00 00 00 02 d4 4b
			23 00 00 00 00 00 02 d5 02
			23 00 00 00 00 00 02 d6 8a
			23 00 00 00 00 00 02 d7 02
			23 00 00 00 00 00 02 d8 b1
			23 00 00 00 00 00 02 d9 02
			23 00 00 00 00 00 02 da e6
			23 00 00 00 00 00 02 db 03
			23 00 00 00 00 00 02 dc 0a
			23 00 00 00 00 00 02 dd 03
			23 00 00 00 00 00 02 de 38
			23 00 00 00 00 00 02 df 03
			23 00 00 00 00 00 02 e0 45
			23 00 00 00 00 00 02 e1 03
			23 00 00 00 00 00 02 e2 55
			23 00 00 00 00 00 02 e3 03
			23 00 00 00 00 00 02 e4 64
			23 00 00 00 00 00 02 e5 03
			23 00 00 00 00 00 02 e6 77
			23 00 00 00 00 00 02 e7 03
			23 00 00 00 00 00 02 e8 90
			23 00 00 00 00 00 02 e9 03
			23 00 00 00 00 00 02 ea a2
			23 00 00 00 00 00 02 eb 03
			23 00 00 00 00 00 02 ec a5
			23 00 00 00 00 00 02 ed 03
			23 01 00 00 00 00 02 ee b2
			23 00 00 00 00 00 02 ef 00
			23 00 00 00 00 00 02 f0 a0
			23 00 00 00 00 00 02 f1 00
			23 00 00 00 00 00 02 f2 a8
			23 00 00 00 00 00 02 f3 00
			23 00 00 00 00 00 02 f4 b5
			23 00 00 00 00 00 02 f5 00
			23 00 00 00 00 00 02 f6 c2
			23 00 00 00 00 00 02 f7 00
			23 00 00 00 00 00 02 f8 ce
			23 00 00 00 00 00 02 f9 00
			23 00 00 00 00 00 02 fa da
			23 00 00 00 00 00 02 ff 02
			23 00 00 00 00 00 02 fb 01
			23 00 00 00 00 00 02 00 00
			23 00 00 00 00 00 02 01 e5
			23 00 00 00 00 00 02 02 00
			23 00 00 00 00 00 02 03 ef
			23 00 00 00 00 00 02 04 00
			23 00 00 00 00 00 02 05 f8
			23 00 00 00 00 00 02 06 01
			23 00 00 00 00 00 02 07 1c
			23 00 00 00 00 00 02 08 01
			23 00 00 00 00 00 02 09 3a
			23 00 00 00 00 00 02 0a 01
			23 00 00 00 00 00 02 0b 6d
			23 00 00 00 00 00 02 0c 01
			23 00 00 00 00 00 02 0d 99
			23 00 00 00 00 00 02 0e 01
			23 00 00 00 00 00 02 0f df
			23 00 00 00 00 00 02 10 02
			23 00 00 00 00 00 02 11 19
			23 00 00 00 00 00 02 12 02
			23 00 00 00 00 00 02 13 1b
			23 00 00 00 00 00 02 14 02
			23 00 00 00 00 00 02 15 51
			23 00 00 00 00 00 02 16 02
			23 00 00 00 00 00 02 17 8f
			23 00 00 00 00 00 02 18 02
			23 00 00 00 00 00 02 19 b7
			23 00 00 00 00 00 02 1a 02
			23 00 00 00 00 00 02 1b ec
			23 00 00 00 00 00 02 1c 03
			23 00 00 00 00 00 02 1d 0f
			23 00 00 00 00 00 02 1e 03
			23 00 00 00 00 00 02 1f 3d
			23 00 00 00 00 00 02 20 03
			23 00 00 00 00 00 02 21 4a
			23 00 00 00 00 00 02 22 03
			23 00 00 00 00 00 02 23 5a
			23 00 00 00 00 00 02 24 03
			23 00 00 00 00 00 02 25 69
			23 00 00 00 00 00 02 26 03
			23 00 00 00 00 00 02 27 7b
			23 00 00 00 00 00 02 28 03
			23 00 00 00 00 00 02 29 8d
			23 00 00 00 00 00 02 2a 03
			23 00 00 00 00 00 02 2b a3
			23 00 00 00 00 00 02 2d 03
			23 00 00 00 00 00 02 2f b1
			23 00 00 00 00 00 02 30 03
			23 00 00 00 00 00 02 31 b2
			23 00 00 00 00 00 02 32 00
			23 00 00 00 00 00 02 33 a0
			23 00 00 00 00 00 02 34 00
			23 00 00 00 00 00 02 35 a8
			23 00 00 00 00 00 02 36 00
			23 00 00 00 00 00 02 37 b5
			23 00 00 00 00 00 02 38 00
			23 00 00 00 00 00 02 39 c2
			23 00 00 00 00 00 02 3a 00
			23 00 00 00 00 00 02 3b ce
			23 00 00 00 00 00 02 3d 00
			23 00 00 00 00 00 02 3f da
			23 00 00 00 00 00 02 40 00
			23 00 00 00 00 00 02 41 e5
			23 00 00 00 00 00 02 42 00
			23 00 00 00 00 00 02 43 ef
			23 00 00 00 00 00 02 44 00
			23 00 00 00 00 00 02 45 f8
			23 00 00 00 00 00 02 46 01
			23 00 00 00 00 00 02 47 1c
			23 00 00 00 00 00 02 48 01
			23 00 00 00 00 00 02 49 3a
			23 00 00 00 00 00 02 4a 01
			23 00 00 00 00 00 02 4b 6d
			23 00 00 00 00 00 02 4c 01
			23 00 00 00 00 00 02 4d 99
			23 00 00 00 00 00 02 4e 01
			23 00 00 00 00 00 02 4f df
			23 00 00 00 00 00 02 50 02
			23 00 00 00 00 00 02 51 19
			23 00 00 00 00 00 02 52 02
			23 00 00 00 00 00 02 53 1b
			23 00 00 00 00 00 02 54 02
			23 00 00 00 00 00 02 55 51
			23 00 00 00 00 00 02 56 02
			23 00 00 00 00 00 02 58 8f
			23 00 00 00 00 00 02 59 02
			23 00 00 00 00 00 02 5a b7
			23 00 00 00 00 00 02 5b 02
			23 00 00 00 00 00 02 5c ec
			23 00 00 00 00 00 02 5d 03
			23 00 00 00 00 00 02 5e 0f
			23 00 00 00 00 00 02 5f 03
			23 00 00 00 00 00 02 60 3d
			23 00 00 00 00 00 02 61 03
			23 00 00 00 00 00 02 62 4a
			23 00 00 00 00 00 02 63 03
			23 00 00 00 00 00 02 64 5a
			23 00 00 00 00 00 02 65 03
			23 00 00 00 00 00 02 66 69
			23 00 00 00 00 00 02 67 03
			23 00 00 00 00 00 02 68 7b
			23 00 00 00 00 00 02 69 03
			23 00 00 00 00 00 02 6a 8d
			23 00 00 00 00 00 02 6b 03
			23 00 00 00 00 00 02 6c a3
			23 00 00 00 00 00 02 6d 03
			23 00 00 00 00 00 02 6e b1
			23 00 00 00 00 00 02 6f 03
			23 01 00 00 00 00 02 70 b2
			23 00 00 00 00 00 02 71 00
			23 00 00 00 00 00 02 72 d0
			23 00 00 00 00 00 02 73 00
			23 00 00 00 00 00 02 74 d9
			23 00 00 00 00 00 02 75 00
			23 00 00 00 00 00 02 76 e3
			23 00 00 00 00 00 02 77 00
			23 00 00 00 00 00 02 78 ed
			23 00 00 00 00 00 02 79 00
			23 00 00 00 00 00 02 7a f6
			23 00 00 00 00 00 02 7b 00
			23 00 00 00 00 00 02 7c ff
			23 00 00 00 00 00 02 7d 01
			23 00 00 00 00 00 02 7e 08
			23 00 00 00 00 00 02 7f 01
			23 00 00 00 00 00 02 80 10
			23 00 00 00 00 00 02 81 01
			23 00 00 00 00 00 02 82 19
			23 00 00 00 00 00 02 83 01
			23 00 00 00 00 00 02 84 36
			23 00 00 00 00 00 02 85 01
			23 00 00 00 00 00 02 86 50
			23 00 00 00 00 00 02 87 01
			23 00 00 00 00 00 02 88 7f
			23 00 00 00 00 00 02 89 01
			23 00 00 00 00 00 02 8a a6
			23 00 00 00 00 00 02 8b 01
			23 00 00 00 00 00 02 8c e9
			23 00 00 00 00 00 02 8d 02
			23 00 00 00 00 00 02 8e 20
			23 00 00 00 00 00 02 8f 02
			23 00 00 00 00 00 02 90 21
			23 00 00 00 00 00 02 91 02
			23 00 00 00 00 00 02 92 56
			23 00 00 00 00 00 02 93 02
			23 00 00 00 00 00 02 94 93
			23 00 00 00 00 00 02 95 02
			23 00 00 00 00 00 02 96 ba
			23 00 00 00 00 00 02 97 02
			23 00 00 00 00 00 02 98 ee
			23 00 00 00 00 00 02 99 03
			23 00 00 00 00 00 02 9a 10
			23 00 00 00 00 00 02 9b 03
			23 00 00 00 00 00 02 9c 39
			23 00 00 00 00 00 02 9d 03
			23 00 00 00 00 00 02 9e 48
			23 00 00 00 00 00 02 9f 03
			23 00 00 00 00 00 02 a0 51
			23 00 00 00 00 00 02 a2 03
			23 00 00 00 00 00 02 a3 5f
			23 00 00 00 00 00 02 a4 03
			23 00 00 00 00 00 02 a5 77
			23 00 00 00 00 00 02 a6 03
			23 00 00 00 00 00 02 a7 7d
			23 00 00 00 00 00 02 a9 03
			23 00 00 00 00 00 02 aa 80
			23 00 00 00 00 00 02 ab 03
			23 00 00 00 00 00 02 ac a2
			23 00 00 00 00 00 02 ad 03
			23 00 00 00 00 00 02 ae b2
			23 00 00 00 00 00 02 af 00
			23 00 00 00 00 00 02 b0 d0
			23 00 00 00 00 00 02 b1 00
			23 00 00 00 00 00 02 b2 d9
			23 00 00 00 00 00 02 b3 00
			23 00 00 00 00 00 02 b4 e3
			23 00 00 00 00 00 02 b5 00
			23 00 00 00 00 00 02 b6 ed
			23 00 00 00 00 00 02 b7 00
			23 00 00 00 00 00 02 b8 f6
			23 00 00 00 00 00 02 b9 00
			23 00 00 00 00 00 02 ba ff
			23 00 00 00 00 00 02 bb 01
			23 00 00 00 00 00 02 bc 08
			23 00 00 00 00 00 02 bd 01
			23 00 00 00 00 00 02 be 10
			23 00 00 00 00 00 02 bf 01
			23 00 00 00 00 00 02 c0 19
			23 00 00 00 00 00 02 c1 01
			23 00 00 00 00 00 02 c2 36
			23 00 00 00 00 00 02 c3 01
			23 00 00 00 00 00 02 c4 50
			23 00 00 00 00 00 02 c5 01
			23 00 00 00 00 00 02 c6 7f
			23 00 00 00 00 00 02 c7 01
			23 00 00 00 00 00 02 c8 a6
			23 00 00 00 00 00 02 c9 01
			23 00 00 00 00 00 02 ca e9
			23 00 00 00 00 00 02 cb 02
			23 00 00 00 00 00 02 cc 20
			23 00 00 00 00 00 02 cd 02
			23 00 00 00 00 00 02 ce 21
			23 00 00 00 00 00 02 cf 02
			23 00 00 00 00 00 02 d0 56
			23 00 00 00 00 00 02 d1 02
			23 00 00 00 00 00 02 d2 93
			23 00 00 00 00 00 02 d3 02
			23 00 00 00 00 00 02 d4 ba
			23 00 00 00 00 00 02 d5 02
			23 00 00 00 00 00 02 d6 ee
			23 00 00 00 00 00 02 d7 03
			23 00 00 00 00 00 02 d8 10
			23 00 00 00 00 00 02 d9 03
			23 00 00 00 00 00 02 da 39
			23 00 00 00 00 00 02 db 03
			23 00 00 00 00 00 02 dc 48
			23 00 00 00 00 00 02 dd 03
			23 00 00 00 00 00 02 de 51
			23 00 00 00 00 00 02 df 03
			23 00 00 00 00 00 02 e0 5f
			23 00 00 00 00 00 02 e1 03
			23 00 00 00 00 00 02 e2 77
			23 00 00 00 00 00 02 e3 03
			23 00 00 00 00 00 02 e4 7d
			23 00 00 00 00 00 02 e5 03
			23 00 00 00 00 00 02 e6 80
			23 00 00 00 00 00 02 e7 03
			23 00 00 00 00 00 02 e8 a2
			23 00 00 00 00 00 02 e9 03
			23 00 00 00 00 00 02 ea b2
			23 01 00 00 00 00 02 ff 00
		];
		qcom,mdss-dsi-default-command = [
			23 00 00 00 00 00 02 ff 01
			23 00 00 00 00 00 02 fb 01
			23 00 00 00 00 00 02 75 00
			23 00 00 00 00 00 02 76 00
			23 00 00 00 00 00 02 77 00
			23 00 00 00 00 00 02 78 21
			23 00 00 00 00 00 02 79 00
			23 00 00 00 00 00 02 7a 4a
			23 00 00 00 00 00 02 7b 00
			23 00 00 00 00 00 02 7c 66
			23 00 00 00 00 00 02 7d 00
			23 00 00 00 00 00 02 7e 7f
			23 00 00 00 00 00 02 7f 00
			23 00 00 00 00 00 02 80 94
			23 00 00 00 00 00 02 81 00
			23 00 00 00 00 00 02 82 a7
			23 00 00 00 00 00 02 83 00
			23 00 00 00 00 00 02 84 b8
			23 00 00 00 00 00 02 85 00
			23 00 00 00 00 00 02 86 c7
			23 00 00 00 00 00 02 87 00
			23 00 00 00 00 00 02 88 fb
			23 00 00 00 00 00 02 89 01
			23 00 00 00 00 00 02 8a 25
			23 00 00 00 00 00 02 8b 01
			23 00 00 00 00 00 02 8c 61
			23 00 00 00 00 00 02 8d 01
			23 00 00 00 00 00 02 8e 94
			23 00 00 00 00 00 02 8f 01
			23 00 00 00 00 00 02 90 e2
			23 00 00 00 00 00 02 91 02
			23 00 00 00 00 00 02 92 20
			23 00 00 00 00 00 02 93 02
			23 00 00 00 00 00 02 94 22
			23 00 00 00 00 00 02 95 02
			23 00 00 00 00 00 02 96 5c
			23 00 00 00 00 00 02 97 02
			23 00 00 00 00 00 02 98 9e
			23 00 00 00 00 00 02 99 02
			23 00 00 00 00 00 02 9a c9
			23 00 00 00 00 00 02 9b 03
			23 00 00 00 00 00 02 9c 01
			23 00 00 00 00 00 02 9d 03
			23 00 00 00 00 00 02 9e 28
			23 00 00 00 00 00 02 9f 03
			23 00 00 00 00 00 02 a0 55
			23 00 00 00 00 00 02 a2 03
			23 00 00 00 00 00 02 a3 62
			23 00 00 00 00 00 02 a4 03
			23 00 00 00 00 00 02 a5 6f
			23 00 00 00 00 00 02 a6 03
			23 00 00 00 00 00 02 a7 7e
			23 00 00 00 00 00 02 a9 03
			23 00 00 00 00 00 02 aa 8f
			23 00 00 00 00 00 02 ab 03
			23 00 00 00 00 00 02 ac 9c
			23 00 00 00 00 00 02 ad 03
			23 00 00 00 00 00 02 ae a2
			23 00 00 00 00 00 02 af 03
			23 00 00 00 00 00 02 b0 ab
			23 00 00 00 00 00 02 b1 03
			23 00 00 00 00 00 02 b2 b2
			23 00 00 00 00 00 02 b3 00
			23 00 00 00 00 00 02 b4 00
			23 00 00 00 00 00 02 b5 00
			23 00 00 00 00 00 02 b6 21
			23 00 00 00 00 00 02 b7 00
			23 00 00 00 00 00 02 b8 4a
			23 00 00 00 00 00 02 b9 00
			23 00 00 00 00 00 02 ba 66
			23 00 00 00 00 00 02 bb 00
			23 00 00 00 00 00 02 bc 7f
			23 00 00 00 00 00 02 bd 00
			23 00 00 00 00 00 02 be 94
			23 00 00 00 00 00 02 bf 00
			23 00 00 00 00 00 02 c0 a7
			23 00 00 00 00 00 02 c1 00
			23 00 00 00 00 00 02 c2 b8
			23 00 00 00 00 00 02 c3 00
			23 00 00 00 00 00 02 c4 c7
			23 00 00 00 00 00 02 c5 00
			23 00 00 00 00 00 02 c6 fb
			23 00 00 00 00 00 02 c7 01
			23 00 00 00 00 00 02 c8 25
			23 00 00 00 00 00 02 c9 01
			23 00 00 00 00 00 02 ca 61
			23 00 00 00 00 00 02 cb 01
			23 00 00 00 00 00 02 cc 94
			23 00 00 00 00 00 02 cd 01
			23 00 00 00 00 00 02 ce e2
			23 00 00 00 00 00 02 cf 02
			23 00 00 00 00 00 02 d0 20
			23 00 00 00 00 00 02 d1 02
			23 00 00 00 00 00 02 d2 22
			23 00 00 00 00 00 02 d3 02
			23 00 00 00 00 00 02 d4 5c
			23 00 00 00 00 00 02 d5 02
			23 00 00 00 00 00 02 d6 9e
			23 00 00 00 00 00 02 d7 02
			23 00 00 00 00 00 02 d8 c9
			23 00 00 00 00 00 02 d9 03
			23 00 00 00 00 00 02 da 01
			23 00 00 00 00 00 02 db 03
			23 00 00 00 00 00 02 dc 28
			23 00 00 00 00 00 02 dd 03
			23 00 00 00 00 00 02 de 55
			23 00 00 00 00 00 02 df 03
			23 00 00 00 00 00 02 e0 62
			23 00 00 00 00 00 02 e1 03
			23 00 00 00 00 00 02 e2 6f
			23 00 00 00 00 00 02 e3 03
			23 00 00 00 00 00 02 e4 7e
			23 00 00 00 00 00 02 e5 03
			23 00 00 00 00 00 02 e6 8f
			23 00 00 00 00 00 02 e7 03
			23 00 00 00 00 00 02 e8 9c
			23 00 00 00 00 00 02 e9 03
			23 00 00 00 00 00 02 ea a2
			23 00 00 00 00 00 02 eb 03
			23 00 00 00 00 00 02 ec ab
			23 00 00 00 00 00 02 ed 03
			23 01 00 00 00 00 02 ee b2
			23 00 00 00 00 00 02 ef 00
			23 00 00 00 00 00 02 f0 00
			23 00 00 00 00 00 02 f1 00
			23 00 00 00 00 00 02 f2 21
			23 00 00 00 00 00 02 f3 00
			23 00 00 00 00 00 02 f4 4a
			23 00 00 00 00 00 02 f5 00
			23 00 00 00 00 00 02 f6 66
			23 00 00 00 00 00 02 f7 00
			23 00 00 00 00 00 02 f8 7f
			23 00 00 00 00 00 02 f9 00
			23 00 00 00 00 00 02 fa 94
			23 00 00 00 00 00 02 ff 02
			23 00 00 00 00 00 02 fb 01
			23 00 00 00 00 00 02 00 00
			23 00 00 00 00 00 02 01 a7
			23 00 00 00 00 00 02 02 00
			23 00 00 00 00 00 02 03 b8
			23 00 00 00 00 00 02 04 00
			23 00 00 00 00 00 02 05 c7
			23 00 00 00 00 00 02 06 00
			23 00 00 00 00 00 02 07 fb
			23 00 00 00 00 00 02 08 01
			23 00 00 00 00 00 02 09 25
			23 00 00 00 00 00 02 0a 01
			23 00 00 00 00 00 02 0b 61
			23 00 00 00 00 00 02 0c 01
			23 00 00 00 00 00 02 0d 94
			23 00 00 00 00 00 02 0e 01
			23 00 00 00 00 00 02 0f e2
			23 00 00 00 00 00 02 10 02
			23 00 00 00 00 00 02 11 20
			23 00 00 00 00 00 02 12 02
			23 00 00 00 00 00 02 13 22
			23 00 00 00 00 00 02 14 02
			23 00 00 00 00 00 02 15 5c
			23 00 00 00 00 00 02 16 02
			23 00 00 00 00 00 02 17 9e
			23 00 00 00 00 00 02 18 02
			23 00 00 00 00 00 02 19 c9
			23 00 00 00 00 00 02 1a 03
			23 00 00 00 00 00 02 1b 01
			23 00 00 00 00 00 02 1c 03
			23 00 00 00 00 00 02 1d 28
			23 00 00 00 00 00 02 1e 03
			23 00 00 00 00 00 02 1f 55
			23 00 00 00 00 00 02 20 03
			23 00 00 00 00 00 02 21 62
			23 00 00 00 00 00 02 22 03
			23 00 00 00 00 00 02 23 6f
			23 00 00 00 00 00 02 24 03
			23 00 00 00 00 00 02 25 7e
			23 00 00 00 00 00 02 26 03
			23 00 00 00 00 00 02 27 8f
			23 00 00 00 00 00 02 28 03
			23 00 00 00 00 00 02 29 9c
			23 00 00 00 00 00 02 2a 03
			23 00 00 00 00 00 02 2b a2
			23 00 00 00 00 00 02 2d 03
			23 00 00 00 00 00 02 2f ab
			23 00 00 00 00 00 02 30 03
			23 00 00 00 00 00 02 31 b2
			23 00 00 00 00 00 02 32 00
			23 00 00 00 00 00 02 33 00
			23 00 00 00 00 00 02 34 00
			23 00 00 00 00 00 02 35 21
			23 00 00 00 00 00 02 36 00
			23 00 00 00 00 00 02 37 4a
			23 00 00 00 00 00 02 38 00
			23 00 00 00 00 00 02 39 66
			23 00 00 00 00 00 02 3a 00
			23 00 00 00 00 00 02 3b 7f
			23 00 00 00 00 00 02 3d 00
			23 00 00 00 00 00 02 3f 94
			23 00 00 00 00 00 02 40 00
			23 00 00 00 00 00 02 41 a7
			23 00 00 00 00 00 02 42 00
			23 00 00 00 00 00 02 43 b8
			23 00 00 00 00 00 02 44 00
			23 00 00 00 00 00 02 45 c7
			23 00 00 00 00 00 02 46 00
			23 00 00 00 00 00 02 47 fb
			23 00 00 00 00 00 02 48 01
			23 00 00 00 00 00 02 49 25
			23 00 00 00 00 00 02 4a 01
			23 00 00 00 00 00 02 4b 61
			23 00 00 00 00 00 02 4c 01
			23 00 00 00 00 00 02 4d 94
			23 00 00 00 00 00 02 4e 01
			23 00 00 00 00 00 02 4f e2
			23 00 00 00 00 00 02 50 02
			23 00 00 00 00 00 02 51 20
			23 00 00 00 00 00 02 52 02
			23 00 00 00 00 00 02 53 22
			23 00 00 00 00 00 02 54 02
			23 00 00 00 00 00 02 55 5c
			23 00 00 00 00 00 02 56 02
			23 00 00 00 00 00 02 58 9e
			23 00 00 00 00 00 02 59 02
			23 00 00 00 00 00 02 5a c9
			23 00 00 00 00 00 02 5b 03
			23 00 00 00 00 00 02 5c 01
			23 00 00 00 00 00 02 5d 03
			23 00 00 00 00 00 02 5e 28
			23 00 00 00 00 00 02 5f 03
			23 00 00 00 00 00 02 60 55
			23 00 00 00 00 00 02 61 03
			23 00 00 00 00 00 02 62 62
			23 00 00 00 00 00 02 63 03
			23 00 00 00 00 00 02 64 6f
			23 00 00 00 00 00 02 65 03
			23 00 00 00 00 00 02 66 7e
			23 00 00 00 00 00 02 67 03
			23 00 00 00 00 00 02 68 8f
			23 00 00 00 00 00 02 69 03
			23 00 00 00 00 00 02 6a 9c
			23 00 00 00 00 00 02 6b 03
			23 00 00 00 00 00 02 6c a2
			23 00 00 00 00 00 02 6d 03
			23 00 00 00 00 00 02 6e ab
			23 00 00 00 00 00 02 6f 03
			23 01 00 00 00 00 02 70 b2
			23 00 00 00 00 00 02 71 00
			23 00 00 00 00 00 02 72 00
			23 00 00 00 00 00 02 73 00
			23 00 00 00 00 00 02 74 1e
			23 00 00 00 00 00 02 75 00
			23 00 00 00 00 00 02 76 48
			23 00 00 00 00 00 02 77 00
			23 00 00 00 00 00 02 78 57
			23 00 00 00 00 00 02 79 00
			23 00 00 00 00 00 02 7a 6a
			23 00 00 00 00 00 02 7b 00
			23 00 00 00 00 00 02 7c 80
			23 00 00 00 00 00 02 7d 00
			23 00 00 00 00 00 02 7e 90
			23 00 00 00 00 00 02 7f 00
			23 00 00 00 00 00 02 80 a0
			23 00 00 00 00 00 02 81 00
			23 00 00 00 00 00 02 82 ae
			23 00 00 00 00 00 02 83 00
			23 00 00 00 00 00 02 84 e3
			23 00 00 00 00 00 02 85 01
			23 00 00 00 00 00 02 86 0e
			23 00 00 00 00 00 02 87 01
			23 00 00 00 00 00 02 88 50
			23 00 00 00 00 00 02 89 01
			23 00 00 00 00 00 02 8a 88
			23 00 00 00 00 00 02 8b 01
			23 00 00 00 00 00 02 8c da
			23 00 00 00 00 00 02 8d 02
			23 00 00 00 00 00 02 8e 19
			23 00 00 00 00 00 02 8f 02
			23 00 00 00 00 00 02 90 1b
			23 00 00 00 00 00 02 91 02
			23 00 00 00 00 00 02 92 58
			23 00 00 00 00 00 02 93 02
			23 00 00 00 00 00 02 94 9c
			23 00 00 00 00 00 02 95 02
			23 00 00 00 00 00 02 96 c6
			23 00 00 00 00 00 02 97 03
			23 00 00 00 00 00 02 98 01
			23 00 00 00 00 00 02 99 03
			23 00 00 00 00 00 02 9a 28
			23 00 00 00 00 00 02 9b 03
			23 00 00 00 00 00 02 9c 55
			23 00 00 00 00 00 02 9d 03
			23 00 00 00 00 00 02 9e 62
			23 00 00 00 00 00 02 9f 03
			23 00 00 00 00 00 02 a0 6f
			23 00 00 00 00 00 02 a2 03
			23 00 00 00 00 00 02 a3 7e
			23 00 00 00 00 00 02 a4 03
			23 00 00 00 00 00 02 a5 8f
			23 00 00 00 00 00 02 a6 03
			23 00 00 00 00 00 02 a7 9c
			23 00 00 00 00 00 02 a9 03
			23 00 00 00 00 00 02 aa a2
			23 00 00 00 00 00 02 ab 03
			23 00 00 00 00 00 02 ac ab
			23 00 00 00 00 00 02 ad 03
			23 00 00 00 00 00 02 ae b2
			23 00 00 00 00 00 02 af 00
			23 00 00 00 00 00 02 b0 00
			23 00 00 00 00 00 02 b1 00
			23 00 00 00 00 00 02 b2 1e
			23 00 00 00 00 00 02 b3 00
			23 00 00 00 00 00 02 b4 48
			23 00 00 00 00 00 02 b5 00
			23 00 00 00 00 00 02 b6 57
			23 00 00 00 00 00 02 b7 00
			23 00 00 00 00 00 02 b8 6a
			23 00 00 00 00 00 02 b9 00
			23 00 00 00 00 00 02 ba 80
			23 00 00 00 00 00 02 bb 00
			23 00 00 00 00 00 02 bc 90
			23 00 00 00 00 00 02 bd 00
			23 00 00 00 00 00 02 be a0
			23 00 00 00 00 00 02 bf 00
			23 00 00 00 00 00 02 c0 ae
			23 00 00 00 00 00 02 c1 00
			23 00 00 00 00 00 02 c2 e3
			23 00 00 00 00 00 02 c3 01
			23 00 00 00 00 00 02 c4 0e
			23 00 00 00 00 00 02 c5 01
			23 00 00 00 00 00 02 c6 50
			23 00 00 00 00 00 02 c7 01
			23 00 00 00 00 00 02 c8 88
			23 00 00 00 00 00 02 c9 01
			23 00 00 00 00 00 02 ca da
			23 00 00 00 00 00 02 cb 02
			23 00 00 00 00 00 02 cc 19
			23 00 00 00 00 00 02 cd 02
			23 00 00 00 00 00 02 ce 1b
			23 00 00 00 00 00 02 cf 02
			23 00 00 00 00 00 02 d0 58
			23 00 00 00 00 00 02 d1 02
			23 00 00 00 00 00 02 d2 9c
			23 00 00 00 00 00 02 d3 02
			23 00 00 00 00 00 02 d4 c6
			23 00 00 00 00 00 02 d5 03
			23 00 00 00 00 00 02 d6 01
			23 00 00 00 00 00 02 d7 03
			23 00 00 00 00 00 02 d8 28
			23 00 00 00 00 00 02 d9 03
			23 00 00 00 00 00 02 da 55
			23 00 00 00 00 00 02 db 03
			23 00 00 00 00 00 02 dc 62
			23 00 00 00 00 00 02 dd 03
			23 00 00 00 00 00 02 de 6f
			23 00 00 00 00 00 02 df 03
			23 00 00 00 00 00 02 e0 7e
			23 00 00 00 00 00 02 e1 03
			23 00 00 00 00 00 02 e2 8f
			23 00 00 00 00 00 02 e3 03
			23 00 00 00 00 00 02 e4 9c
			23 00 00 00 00 00 02 e5 03
			23 00 00 00 00 00 02 e6 a2
			23 00 00 00 00 00 02 e7 03
			23 00 00 00 00 00 02 e8 ab
			23 00 00 00 00 00 02 e9 03
			23 00 00 00 00 00 02 ea b2
			23 01 00 00 00 00 02 ff 00
		];
		qcom,mdss-dsi-ceon-command = [
			23 01 00 00 00 00 02 55 80
		];
		qcom,mdss-dsi-ceoff-command = [
			23 01 00 00 00 00 02 55 00
		];
		qcom,mdss-dsi-eyecare-off-command = [
			23 00 00 00 00 00 02 ff 01
			23 00 00 00 00 00 02 fb 01
			23 00 00 00 00 00 02 75 00
			23 00 00 00 00 00 02 76 00
			23 00 00 00 00 00 02 77 00
			23 00 00 00 00 00 02 78 21
			23 00 00 00 00 00 02 79 00
			23 00 00 00 00 00 02 7a 4a
			23 00 00 00 00 00 02 7b 00
			23 00 00 00 00 00 02 7c 66
			23 00 00 00 00 00 02 7d 00
			23 00 00 00 00 00 02 7e 7f
			23 00 00 00 00 00 02 7f 00
			23 00 00 00 00 00 02 80 94
			23 00 00 00 00 00 02 81 00
			23 00 00 00 00 00 02 82 a7
			23 00 00 00 00 00 02 83 00
			23 00 00 00 00 00 02 84 b8
			23 00 00 00 00 00 02 85 00
			23 00 00 00 00 00 02 86 c7
			23 00 00 00 00 00 02 87 00
			23 00 00 00 00 00 02 88 fb
			23 00 00 00 00 00 02 89 01
			23 00 00 00 00 00 02 8a 25
			23 00 00 00 00 00 02 8b 01
			23 00 00 00 00 00 02 8c 61
			23 00 00 00 00 00 02 8d 01
			23 00 00 00 00 00 02 8e 94
			23 00 00 00 00 00 02 8f 01
			23 00 00 00 00 00 02 90 e2
			23 00 00 00 00 00 02 91 02
			23 00 00 00 00 00 02 92 20
			23 00 00 00 00 00 02 93 02
			23 00 00 00 00 00 02 94 22
			23 00 00 00 00 00 02 95 02
			23 00 00 00 00 00 02 96 5c
			23 00 00 00 00 00 02 97 02
			23 00 00 00 00 00 02 98 9e
			23 00 00 00 00 00 02 99 02
			23 00 00 00 00 00 02 9a c9
			23 00 00 00 00 00 02 9b 03
			23 00 00 00 00 00 02 9c 01
			23 00 00 00 00 00 02 9d 03
			23 00 00 00 00 00 02 9e 28
			23 00 00 00 00 00 02 9f 03
			23 00 00 00 00 00 02 a0 55
			23 00 00 00 00 00 02 a2 03
			23 00 00 00 00 00 02 a3 62
			23 00 00 00 00 00 02 a4 03
			23 00 00 00 00 00 02 a5 6f
			23 00 00 00 00 00 02 a6 03
			23 00 00 00 00 00 02 a7 7e
			23 00 00 00 00 00 02 a9 03
			23 00 00 00 00 00 02 aa 8f
			23 00 00 00 00 00 02 ab 03
			23 00 00 00 00 00 02 ac 9c
			23 00 00 00 00 00 02 ad 03
			23 00 00 00 00 00 02 ae a2
			23 00 00 00 00 00 02 af 03
			23 00 00 00 00 00 02 b0 ab
			23 00 00 00 00 00 02 b1 03
			23 00 00 00 00 00 02 b2 b2
			23 00 00 00 00 00 02 b3 00
			23 00 00 00 00 00 02 b4 00
			23 00 00 00 00 00 02 b5 00
			23 00 00 00 00 00 02 b6 21
			23 00 00 00 00 00 02 b7 00
			23 00 00 00 00 00 02 b8 4a
			23 00 00 00 00 00 02 b9 00
			23 00 00 00 00 00 02 ba 66
			23 00 00 00 00 00 02 bb 00
			23 00 00 00 00 00 02 bc 7f
			23 00 00 00 00 00 02 bd 00
			23 00 00 00 00 00 02 be 94
			23 00 00 00 00 00 02 bf 00
			23 00 00 00 00 00 02 c0 a7
			23 00 00 00 00 00 02 c1 00
			23 00 00 00 00 00 02 c2 b8
			23 00 00 00 00 00 02 c3 00
			23 00 00 00 00 00 02 c4 c7
			23 00 00 00 00 00 02 c5 00
			23 00 00 00 00 00 02 c6 fb
			23 00 00 00 00 00 02 c7 01
			23 00 00 00 00 00 02 c8 25
			23 00 00 00 00 00 02 c9 01
			23 00 00 00 00 00 02 ca 61
			23 00 00 00 00 00 02 cb 01
			23 00 00 00 00 00 02 cc 94
			23 00 00 00 00 00 02 cd 01
			23 00 00 00 00 00 02 ce e2
			23 00 00 00 00 00 02 cf 02
			23 00 00 00 00 00 02 d0 20
			23 00 00 00 00 00 02 d1 02
			23 00 00 00 00 00 02 d2 22
			23 00 00 00 00 00 02 d3 02
			23 00 00 00 00 00 02 d4 5c
			23 00 00 00 00 00 02 d5 02
			23 00 00 00 00 00 02 d6 9e
			23 00 00 00 00 00 02 d7 02
			23 00 00 00 00 00 02 d8 c9
			23 00 00 00 00 00 02 d9 03
			23 00 00 00 00 00 02 da 01
			23 00 00 00 00 00 02 db 03
			23 00 00 00 00 00 02 dc 28
			23 00 00 00 00 00 02 dd 03
			23 00 00 00 00 00 02 de 55
			23 00 00 00 00 00 02 df 03
			23 00 00 00 00 00 02 e0 62
			23 00 00 00 00 00 02 e1 03
			23 00 00 00 00 00 02 e2 6f
			23 00 00 00 00 00 02 e3 03
			23 00 00 00 00 00 02 e4 7e
			23 00 00 00 00 00 02 e5 03
			23 00 00 00 00 00 02 e6 8f
			23 00 00 00 00 00 02 e7 03
			23 00 00 00 00 00 02 e8 9c
			23 00 00 00 00 00 02 e9 03
			23 00 00 00 00 00 02 ea a2
			23 00 00 00 00 00 02 eb 03
			23 00 00 00 00 00 02 ec ab
			23 00 00 00 00 00 02 ed 03
			23 01 00 00 00 00 02 ee b2
			23 00 00 00 00 00 02 ef 00
			23 00 00 00 00 00 02 f0 00
			23 00 00 00 00 00 02 f1 00
			23 00 00 00 00 00 02 f2 21
			23 00 00 00 00 00 02 f3 00
			23 00 00 00 00 00 02 f4 4a
			23 00 00 00 00 00 02 f5 00
			23 00 00 00 00 00 02 f6 66
			23 00 00 00 00 00 02 f7 00
			23 00 00 00 00 00 02 f8 7f
			23 00 00 00 00 00 02 f9 00
			23 00 00 00 00 00 02 fa 94
			23 00 00 00 00 00 02 ff 02
			23 00 00 00 00 00 02 fb 01
			23 00 00 00 00 00 02 00 00
			23 00 00 00 00 00 02 01 a7
			23 00 00 00 00 00 02 02 00
			23 00 00 00 00 00 02 03 b8
			23 00 00 00 00 00 02 04 00
			23 00 00 00 00 00 02 05 c7
			23 00 00 00 00 00 02 06 00
			23 00 00 00 00 00 02 07 fb
			23 00 00 00 00 00 02 08 01
			23 00 00 00 00 00 02 09 25
			23 00 00 00 00 00 02 0a 01
			23 00 00 00 00 00 02 0b 61
			23 00 00 00 00 00 02 0c 01
			23 00 00 00 00 00 02 0d 94
			23 00 00 00 00 00 02 0e 01
			23 00 00 00 00 00 02 0f e2
			23 00 00 00 00 00 02 10 02
			23 00 00 00 00 00 02 11 20
			23 00 00 00 00 00 02 12 02
			23 00 00 00 00 00 02 13 22
			23 00 00 00 00 00 02 14 02
			23 00 00 00 00 00 02 15 5c
			23 00 00 00 00 00 02 16 02
			23 00 00 00 00 00 02 17 9e
			23 00 00 00 00 00 02 18 02
			23 00 00 00 00 00 02 19 c9
			23 00 00 00 00 00 02 1a 03
			23 00 00 00 00 00 02 1b 01
			23 00 00 00 00 00 02 1c 03
			23 00 00 00 00 00 02 1d 28
			23 00 00 00 00 00 02 1e 03
			23 00 00 00 00 00 02 1f 55
			23 00 00 00 00 00 02 20 03
			23 00 00 00 00 00 02 21 62
			23 00 00 00 00 00 02 22 03
			23 00 00 00 00 00 02 23 6f
			23 00 00 00 00 00 02 24 03
			23 00 00 00 00 00 02 25 7e
			23 00 00 00 00 00 02 26 03
			23 00 00 00 00 00 02 27 8f
			23 00 00 00 00 00 02 28 03
			23 00 00 00 00 00 02 29 9c
			23 00 00 00 00 00 02 2a 03
			23 00 00 00 00 00 02 2b a2
			23 00 00 00 00 00 02 2d 03
			23 00 00 00 00 00 02 2f ab
			23 00 00 00 00 00 02 30 03
			23 00 00 00 00 00 02 31 b2
			23 00 00 00 00 00 02 32 00
			23 00 00 00 00 00 02 33 00
			23 00 00 00 00 00 02 34 00
			23 00 00 00 00 00 02 35 21
			23 00 00 00 00 00 02 36 00
			23 00 00 00 00 00 02 37 4a
			23 00 00 00 00 00 02 38 00
			23 00 00 00 00 00 02 39 66
			23 00 00 00 00 00 02 3a 00
			23 00 00 00 00 00 02 3b 7f
			23 00 00 00 00 00 02 3d 00
			23 00 00 00 00 00 02 3f 94
			23 00 00 00 00 00 02 40 00
			23 00 00 00 00 00 02 41 a7
			23 00 00 00 00 00 02 42 00
			23 00 00 00 00 00 02 43 b8
			23 00 00 00 00 00 02 44 00
			23 00 00 00 00 00 02 45 c7
			23 00 00 00 00 00 02 46 00
			23 00 00 00 00 00 02 47 fb
			23 00 00 00 00 00 02 48 01
			23 00 00 00 00 00 02 49 25
			23 00 00 00 00 00 02 4a 01
			23 00 00 00 00 00 02 4b 61
			23 00 00 00 00 00 02 4c 01
			23 00 00 00 00 00 02 4d 94
			23 00 00 00 00 00 02 4e 01
			23 00 00 00 00 00 02 4f e2
			23 00 00 00 00 00 02 50 02
			23 00 00 00 00 00 02 51 20
			23 00 00 00 00 00 02 52 02
			23 00 00 00 00 00 02 53 22
			23 00 00 00 00 00 02 54 02
			23 00 00 00 00 00 02 55 5c
			23 00 00 00 00 00 02 56 02
			23 00 00 00 00 00 02 58 9e
			23 00 00 00 00 00 02 59 02
			23 00 00 00 00 00 02 5a c9
			23 00 00 00 00 00 02 5b 03
			23 00 00 00 00 00 02 5c 01
			23 00 00 00 00 00 02 5d 03
			23 00 00 00 00 00 02 5e 28
			23 00 00 00 00 00 02 5f 03
			23 00 00 00 00 00 02 60 55
			23 00 00 00 00 00 02 61 03
			23 00 00 00 00 00 02 62 62
			23 00 00 00 00 00 02 63 03
			23 00 00 00 00 00 02 64 6f
			23 00 00 00 00 00 02 65 03
			23 00 00 00 00 00 02 66 7e
			23 00 00 00 00 00 02 67 03
			23 00 00 00 00 00 02 68 8f
			23 00 00 00 00 00 02 69 03
			23 00 00 00 00 00 02 6a 9c
			23 00 00 00 00 00 02 6b 03
			23 00 00 00 00 00 02 6c a2
			23 00 00 00 00 00 02 6d 03
			23 00 00 00 00 00 02 6e ab
			23 00 00 00 00 00 02 6f 03
			23 01 00 00 00 00 02 70 b2
			23 00 00 00 00 00 02 71 00
			23 00 00 00 00 00 02 72 00
			23 00 00 00 00 00 02 73 00
			23 00 00 00 00 00 02 74 1e
			23 00 00 00 00 00 02 75 00
			23 00 00 00 00 00 02 76 48
			23 00 00 00 00 00 02 77 00
			23 00 00 00 00 00 02 78 57
			23 00 00 00 00 00 02 79 00
			23 00 00 00 00 00 02 7a 6a
			23 00 00 00 00 00 02 7b 00
			23 00 00 00 00 00 02 7c 80
			23 00 00 00 00 00 02 7d 00
			23 00 00 00 00 00 02 7e 90
			23 00 00 00 00 00 02 7f 00
			23 00 00 00 00 00 02 80 a0
			23 00 00 00 00 00 02 81 00
			23 00 00 00 00 00 02 82 ae
			23 00 00 00 00 00 02 83 00
			23 00 00 00 00 00 02 84 e3
			23 00 00 00 00 00 02 85 01
			23 00 00 00 00 00 02 86 0e
			23 00 00 00 00 00 02 87 01
			23 00 00 00 00 00 02 88 50
			23 00 00 00 00 00 02 89 01
			23 00 00 00 00 00 02 8a 88
			23 00 00 00 00 00 02 8b 01
			23 00 00 00 00 00 02 8c da
			23 00 00 00 00 00 02 8d 02
			23 00 00 00 00 00 02 8e 19
			23 00 00 00 00 00 02 8f 02
			23 00 00 00 00 00 02 90 1b
			23 00 00 00 00 00 02 91 02
			23 00 00 00 00 00 02 92 58
			23 00 00 00 00 00 02 93 02
			23 00 00 00 00 00 02 94 9c
			23 00 00 00 00 00 02 95 02
			23 00 00 00 00 00 02 96 c6
			23 00 00 00 00 00 02 97 03
			23 00 00 00 00 00 02 98 01
			23 00 00 00 00 00 02 99 03
			23 00 00 00 00 00 02 9a 28
			23 00 00 00 00 00 02 9b 03
			23 00 00 00 00 00 02 9c 55
			23 00 00 00 00 00 02 9d 03
			23 00 00 00 00 00 02 9e 62
			23 00 00 00 00 00 02 9f 03
			23 00 00 00 00 00 02 a0 6f
			23 00 00 00 00 00 02 a2 03
			23 00 00 00 00 00 02 a3 7e
			23 00 00 00 00 00 02 a4 03
			23 00 00 00 00 00 02 a5 8f
			23 00 00 00 00 00 02 a6 03
			23 00 00 00 00 00 02 a7 9c
			23 00 00 00 00 00 02 a9 03
			23 00 00 00 00 00 02 aa a2
			23 00 00 00 00 00 02 ab 03
			23 00 00 00 00 00 02 ac ab
			23 00 00 00 00 00 02 ad 03
			23 00 00 00 00 00 02 ae b2
			23 00 00 00 00 00 02 af 00
			23 00 00 00 00 00 02 b0 00
			23 00 00 00 00 00 02 b1 00
			23 00 00 00 00 00 02 b2 1e
			23 00 00 00 00 00 02 b3 00
			23 00 00 00 00 00 02 b4 48
			23 00 00 00 00 00 02 b5 00
			23 00 00 00 00 00 02 b6 57
			23 00 00 00 00 00 02 b7 00
			23 00 00 00 00 00 02 b8 6a
			23 00 00 00 00 00 02 b9 00
			23 00 00 00 00 00 02 ba 80
			23 00 00 00 00 00 02 bb 00
			23 00 00 00 00 00 02 bc 90
			23 00 00 00 00 00 02 bd 00
			23 00 00 00 00 00 02 be a0
			23 00 00 00 00 00 02 bf 00
			23 00 00 00 00 00 02 c0 ae
			23 00 00 00 00 00 02 c1 00
			23 00 00 00 00 00 02 c2 e3
			23 00 00 00 00 00 02 c3 01
			23 00 00 00 00 00 02 c4 0e
			23 00 00 00 00 00 02 c5 01
			23 00 00 00 00 00 02 c6 50
			23 00 00 00 00 00 02 c7 01
			23 00 00 00 00 00 02 c8 88
			23 00 00 00 00 00 02 c9 01
			23 00 00 00 00 00 02 ca da
			23 00 00 00 00 00 02 cb 02
			23 00 00 00 00 00 02 cc 19
			23 00 00 00 00 00 02 cd 02
			23 00 00 00 00 00 02 ce 1b
			23 00 00 00 00 00 02 cf 02
			23 00 00 00 00 00 02 d0 58
			23 00 00 00 00 00 02 d1 02
			23 00 00 00 00 00 02 d2 9c
			23 00 00 00 00 00 02 d3 02
			23 00 00 00 00 00 02 d4 c6
			23 00 00 00 00 00 02 d5 03
			23 00 00 00 00 00 02 d6 01
			23 00 00 00 00 00 02 d7 03
			23 00 00 00 00 00 02 d8 28
			23 00 00 00 00 00 02 d9 03
			23 00 00 00 00 00 02 da 55
			23 00 00 00 00 00 02 db 03
			23 00 00 00 00 00 02 dc 62
			23 00 00 00 00 00 02 dd 03
			23 00 00 00 00 00 02 de 6f
			23 00 00 00 00 00 02 df 03
			23 00 00 00 00 00 02 e0 7e
			23 00 00 00 00 00 02 e1 03
			23 00 00 00 00 00 02 e2 8f
			23 00 00 00 00 00 02 e3 03
			23 00 00 00 00 00 02 e4 9c
			23 00 00 00 00 00 02 e5 03
			23 00 00 00 00 00 02 e6 a2
			23 00 00 00 00 00 02 e7 03
			23 00 00 00 00 00 02 e8 ab
			23 00 00 00 00 00 02 e9 03
			23 00 00 00 00 00 02 ea b2
			23 01 00 00 00 00 02 ff 00
		];
		qcom,mdss-dsi-eyecare-level1-command = [
			23 00 00 00 00 00 02 ff 01
			23 00 00 00 00 00 02 fb 01
			23 00 00 00 00 00 02 75 00
			23 00 00 00 00 00 02 76 11
			23 00 00 00 00 00 02 77 00
			23 00 00 00 00 00 02 78 29
			23 00 00 00 00 00 02 79 00
			23 00 00 00 00 00 02 7a 4b
			23 00 00 00 00 00 02 7b 00
			23 00 00 00 00 00 02 7c 66
			23 00 00 00 00 00 02 7d 00
			23 00 00 00 00 00 02 7e 7c
			23 00 00 00 00 00 02 7f 00
			23 00 00 00 00 00 02 80 91
			23 00 00 00 00 00 02 81 00
			23 00 00 00 00 00 02 82 a3
			23 00 00 00 00 00 02 83 00
			23 00 00 00 00 00 02 84 b3
			23 00 00 00 00 00 02 85 00
			23 00 00 00 00 00 02 86 c3
			23 00 00 00 00 00 02 87 00
			23 00 00 00 00 00 02 88 f6
			23 00 00 00 00 00 02 89 01
			23 00 00 00 00 00 02 8a 1f
			23 00 00 00 00 00 02 8b 01
			23 00 00 00 00 00 02 8c 5f
			23 00 00 00 00 00 02 8d 01
			23 00 00 00 00 00 02 8e 91
			23 00 00 00 00 00 02 8f 01
			23 00 00 00 00 00 02 90 df
			23 00 00 00 00 00 02 91 02
			23 00 00 00 00 00 02 92 1c
			23 00 00 00 00 00 02 93 02
			23 00 00 00 00 00 02 94 1e
			23 00 00 00 00 00 02 95 02
			23 00 00 00 00 00 02 96 58
			23 00 00 00 00 00 02 97 02
			23 00 00 00 00 00 02 98 98
			23 00 00 00 00 00 02 99 02
			23 00 00 00 00 00 02 9a c2
			23 00 00 00 00 00 02 9b 02
			23 00 00 00 00 00 02 9c fa
			23 00 00 00 00 00 02 9d 03
			23 00 00 00 00 00 02 9e 1f
			23 00 00 00 00 00 02 9f 03
			23 00 00 00 00 00 02 a0 4f
			23 00 00 00 00 00 02 a2 03
			23 00 00 00 00 00 02 a3 5c
			23 00 00 00 00 00 02 a4 03
			23 00 00 00 00 00 02 a5 6b
			23 00 00 00 00 00 02 a6 03
			23 00 00 00 00 00 02 a7 7c
			23 00 00 00 00 00 02 a9 03
			23 00 00 00 00 00 02 aa 90
			23 00 00 00 00 00 02 ab 03
			23 00 00 00 00 00 02 ac a7
			23 00 00 00 00 00 02 ad 03
			23 00 00 00 00 00 02 ae bf
			23 00 00 00 00 00 02 af 03
			23 00 00 00 00 00 02 b0 ce
			23 00 00 00 00 00 02 b1 03
			23 00 00 00 00 00 02 b2 cf
			23 00 00 00 00 00 02 b3 00
			23 00 00 00 00 00 02 b4 11
			23 00 00 00 00 00 02 b5 00
			23 00 00 00 00 00 02 b6 29
			23 00 00 00 00 00 02 b7 00
			23 00 00 00 00 00 02 b8 4b
			23 00 00 00 00 00 02 b9 00
			23 00 00 00 00 00 02 ba 66
			23 00 00 00 00 00 02 bb 00
			23 00 00 00 00 00 02 bc 7c
			23 00 00 00 00 00 02 bd 00
			23 00 00 00 00 00 02 be 91
			23 00 00 00 00 00 02 bf 00
			23 00 00 00 00 00 02 c0 a3
			23 00 00 00 00 00 02 c1 00
			23 00 00 00 00 00 02 c2 b3
			23 00 00 00 00 00 02 c3 00
			23 00 00 00 00 00 02 c4 c3
			23 00 00 00 00 00 02 c5 00
			23 00 00 00 00 00 02 c6 f6
			23 00 00 00 00 00 02 c7 01
			23 00 00 00 00 00 02 c8 1f
			23 00 00 00 00 00 02 c9 01
			23 00 00 00 00 00 02 ca 5f
			23 00 00 00 00 00 02 cb 01
			23 00 00 00 00 00 02 cc 91
			23 00 00 00 00 00 02 cd 01
			23 00 00 00 00 00 02 ce df
			23 00 00 00 00 00 02 cf 02
			23 00 00 00 00 00 02 d0 1c
			23 00 00 00 00 00 02 d1 02
			23 00 00 00 00 00 02 d2 1e
			23 00 00 00 00 00 02 d3 02
			23 00 00 00 00 00 02 d4 58
			23 00 00 00 00 00 02 d5 02
			23 00 00 00 00 00 02 d6 98
			23 00 00 00 00 00 02 d7 02
			23 00 00 00 00 00 02 d8 c2
			23 00 00 00 00 00 02 d9 02
			23 00 00 00 00 00 02 da fa
			23 00 00 00 00 00 02 db 03
			23 00 00 00 00 00 02 dc 1f
			23 00 00 00 00 00 02 dd 03
			23 00 00 00 00 00 02 de 4f
			23 00 00 00 00 00 02 df 03
			23 00 00 00 00 00 02 e0 5c
			23 00 00 00 00 00 02 e1 03
			23 00 00 00 00 00 02 e2 6b
			23 00 00 00 00 00 02 e3 03
			23 00 00 00 00 00 02 e4 7c
			23 00 00 00 00 00 02 e5 03
			23 00 00 00 00 00 02 e6 90
			23 00 00 00 00 00 02 e7 03
			23 00 00 00 00 00 02 e8 a7
			23 00 00 00 00 00 02 e9 03
			23 00 00 00 00 00 02 ea bf
			23 00 00 00 00 00 02 eb 03
			23 00 00 00 00 00 02 ec ce
			23 00 00 00 00 00 02 ed 03
			23 01 00 00 00 00 02 ee cf
			23 00 00 00 00 00 02 ef 00
			23 00 00 00 00 00 02 f0 00
			23 00 00 00 00 00 02 f1 00
			23 00 00 00 00 00 02 f2 1d
			23 00 00 00 00 00 02 f3 00
			23 00 00 00 00 00 02 f4 44
			23 00 00 00 00 00 02 f5 00
			23 00 00 00 00 00 02 f6 61
			23 00 00 00 00 00 02 f7 00
			23 00 00 00 00 00 02 f8 78
			23 00 00 00 00 00 02 f9 00
			23 00 00 00 00 00 02 fa 8d
			23 00 00 00 00 00 02 ff 02
			23 00 00 00 00 00 02 fb 01
			23 00 00 00 00 00 02 00 00
			23 00 00 00 00 00 02 01 9f
			23 00 00 00 00 00 02 02 00
			23 00 00 00 00 00 02 03 b0
			23 00 00 00 00 00 02 04 00
			23 00 00 00 00 00 02 05 bf
			23 00 00 00 00 00 02 06 00
			23 00 00 00 00 00 02 07 f3
			23 00 00 00 00 00 02 08 01
			23 00 00 00 00 00 02 09 1c
			23 00 00 00 00 00 02 0a 01
			23 00 00 00 00 00 02 0b 5d
			23 00 00 00 00 00 02 0c 01
			23 00 00 00 00 00 02 0d 8f
			23 00 00 00 00 00 02 0e 01
			23 00 00 00 00 00 02 0f df
			23 00 00 00 00 00 02 10 02
			23 00 00 00 00 00 02 11 1c
			23 00 00 00 00 00 02 12 02
			23 00 00 00 00 00 02 13 1e
			23 00 00 00 00 00 02 14 02
			23 00 00 00 00 00 02 15 58
			23 00 00 00 00 00 02 16 02
			23 00 00 00 00 00 02 17 99
			23 00 00 00 00 00 02 18 02
			23 00 00 00 00 00 02 19 c3
			23 00 00 00 00 00 02 1a 02
			23 00 00 00 00 00 02 1b fc
			23 00 00 00 00 00 02 1c 03
			23 00 00 00 00 00 02 1d 21
			23 00 00 00 00 00 02 1e 03
			23 00 00 00 00 00 02 1f 4f
			23 00 00 00 00 00 02 20 03
			23 00 00 00 00 00 02 21 5c
			23 00 00 00 00 00 02 22 03
			23 00 00 00 00 00 02 23 6b
			23 00 00 00 00 00 02 24 03
			23 00 00 00 00 00 02 25 7c
			23 00 00 00 00 00 02 26 03
			23 00 00 00 00 00 02 27 8f
			23 00 00 00 00 00 02 28 03
			23 00 00 00 00 00 02 29 a5
			23 00 00 00 00 00 02 2a 03
			23 00 00 00 00 00 02 2b be
			23 00 00 00 00 00 02 2d 03
			23 00 00 00 00 00 02 2f cd
			23 00 00 00 00 00 02 30 03
			23 00 00 00 00 00 02 31 cf
			23 00 00 00 00 00 02 32 00
			23 00 00 00 00 00 02 33 00
			23 00 00 00 00 00 02 34 00
			23 00 00 00 00 00 02 35 1d
			23 00 00 00 00 00 02 36 00
			23 00 00 00 00 00 02 37 44
			23 00 00 00 00 00 02 38 00
			23 00 00 00 00 00 02 39 61
			23 00 00 00 00 00 02 3a 00
			23 00 00 00 00 00 02 3b 78
			23 00 00 00 00 00 02 3d 00
			23 00 00 00 00 00 02 3f 8d
			23 00 00 00 00 00 02 40 00
			23 00 00 00 00 00 02 41 9f
			23 00 00 00 00 00 02 42 00
			23 00 00 00 00 00 02 43 b0
			23 00 00 00 00 00 02 44 00
			23 00 00 00 00 00 02 45 bf
			23 00 00 00 00 00 02 46 00
			23 00 00 00 00 00 02 47 f3
			23 00 00 00 00 00 02 48 01
			23 00 00 00 00 00 02 49 1c
			23 00 00 00 00 00 02 4a 01
			23 00 00 00 00 00 02 4b 5d
			23 00 00 00 00 00 02 4c 01
			23 00 00 00 00 00 02 4d 8f
			23 00 00 00 00 00 02 4e 01
			23 00 00 00 00 00 02 4f df
			23 00 00 00 00 00 02 50 02
			23 00 00 00 00 00 02 51 1c
			23 00 00 00 00 00 02 52 02
			23 00 00 00 00 00 02 53 1e
			23 00 00 00 00 00 02 54 02
			23 00 00 00 00 00 02 55 58
			23 00 00 00 00 00 02 56 02
			23 00 00 00 00 00 02 58 99
			23 00 00 00 00 00 02 59 02
			23 00 00 00 00 00 02 5a c3
			23 00 00 00 00 00 02 5b 02
			23 00 00 00 00 00 02 5c fc
			23 00 00 00 00 00 02 5d 03
			23 00 00 00 00 00 02 5e 21
			23 00 00 00 00 00 02 5f 03
			23 00 00 00 00 00 02 60 4f
			23 00 00 00 00 00 02 61 03
			23 00 00 00 00 00 02 62 5c
			23 00 00 00 00 00 02 63 03
			23 00 00 00 00 00 02 64 6b
			23 00 00 00 00 00 02 65 03
			23 00 00 00 00 00 02 66 7c
			23 00 00 00 00 00 02 67 03
			23 00 00 00 00 00 02 68 8f
			23 00 00 00 00 00 02 69 03
			23 00 00 00 00 00 02 6a a5
			23 00 00 00 00 00 02 6b 03
			23 00 00 00 00 00 02 6c be
			23 00 00 00 00 00 02 6d 03
			23 00 00 00 00 00 02 6e cd
			23 00 00 00 00 00 02 6f 03
			23 01 00 00 00 00 02 70 cf
			23 00 00 00 00 00 02 71 00
			23 00 00 00 00 00 02 72 d8
			23 00 00 00 00 00 02 73 00
			23 00 00 00 00 00 02 74 de
			23 00 00 00 00 00 02 75 00
			23 00 00 00 00 00 02 76 e9
			23 00 00 00 00 00 02 77 00
			23 00 00 00 00 00 02 78 f3
			23 00 00 00 00 00 02 79 00
			23 00 00 00 00 00 02 7a fd
			23 00 00 00 00 00 02 7b 01
			23 00 00 00 00 00 02 7c 07
			23 00 00 00 00 00 02 7d 01
			23 00 00 00 00 00 02 7e 10
			23 00 00 00 00 00 02 7f 01
			23 00 00 00 00 00 02 80 19
			23 00 00 00 00 00 02 81 01
			23 00 00 00 00 00 02 82 21
			23 00 00 00 00 00 02 83 01
			23 00 00 00 00 00 02 84 40
			23 00 00 00 00 00 02 85 01
			23 00 00 00 00 00 02 86 5c
			23 00 00 00 00 00 02 87 01
			23 00 00 00 00 00 02 88 8b
			23 00 00 00 00 00 02 89 01
			23 00 00 00 00 00 02 8a b3
			23 00 00 00 00 00 02 8b 01
			23 00 00 00 00 00 02 8c f5
			23 00 00 00 00 00 02 8d 02
			23 00 00 00 00 00 02 8e 2c
			23 00 00 00 00 00 02 8f 02
			23 00 00 00 00 00 02 90 2e
			23 00 00 00 00 00 02 91 02
			23 00 00 00 00 00 02 92 64
			23 00 00 00 00 00 02 93 02
			23 00 00 00 00 00 02 94 a3
			23 00 00 00 00 00 02 95 02
			23 00 00 00 00 00 02 96 cc
			23 00 00 00 00 00 02 97 03
			23 00 00 00 00 00 02 98 02
			23 00 00 00 00 00 02 99 03
			23 00 00 00 00 00 02 9a 27
			23 00 00 00 00 00 02 9b 03
			23 00 00 00 00 00 02 9c 54
			23 00 00 00 00 00 02 9d 03
			23 00 00 00 00 00 02 9e 61
			23 00 00 00 00 00 02 9f 03
			23 00 00 00 00 00 02 a0 6f
			23 00 00 00 00 00 02 a2 03
			23 00 00 00 00 00 02 a3 7e
			23 00 00 00 00 00 02 a4 03
			23 00 00 00 00 00 02 a5 8e
			23 00 00 00 00 00 02 a6 03
			23 00 00 00 00 00 02 a7 a1
			23 00 00 00 00 00 02 a9 03
			23 00 00 00 00 00 02 aa b7
			23 00 00 00 00 00 02 ab 03
			23 00 00 00 00 00 02 ac cc
			23 00 00 00 00 00 02 ad 03
			23 00 00 00 00 00 02 ae cf
			23 00 00 00 00 00 02 af 00
			23 00 00 00 00 00 02 b0 d8
			23 00 00 00 00 00 02 b1 00
			23 00 00 00 00 00 02 b2 de
			23 00 00 00 00 00 02 b3 00
			23 00 00 00 00 00 02 b4 e9
			23 00 00 00 00 00 02 b5 00
			23 00 00 00 00 00 02 b6 f3
			23 00 00 00 00 00 02 b7 00
			23 00 00 00 00 00 02 b8 fd
			23 00 00 00 00 00 02 b9 01
			23 00 00 00 00 00 02 ba 07
			23 00 00 00 00 00 02 bb 01
			23 00 00 00 00 00 02 bc 10
			23 00 00 00 00 00 02 bd 01
			23 00 00 00 00 00 02 be 19
			23 00 00 00 00 00 02 bf 01
			23 00 00 00 00 00 02 c0 21
			23 00 00 00 00 00 02 c1 01
			23 00 00 00 00 00 02 c2 40
			23 00 00 00 00 00 02 c3 01
			23 00 00 00 00 00 02 c4 5c
			23 00 00 00 00 00 02 c5 01
			23 00 00 00 00 00 02 c6 8b
			23 00 00 00 00 00 02 c7 01
			23 00 00 00 00 00 02 c8 b3
			23 00 00 00 00 00 02 c9 01
			23 00 00 00 00 00 02 ca f5
			23 00 00 00 00 00 02 cb 02
			23 00 00 00 00 00 02 cc 2c
			23 00 00 00 00 00 02 cd 02
			23 00 00 00 00 00 02 ce 2e
			23 00 00 00 00 00 02 cf 02
			23 00 00 00 00 00 02 d0 64
			23 00 00 00 00 00 02 d1 02
			23 00 00 00 00 00 02 d2 a3
			23 00 00 00 00 00 02 d3 02
			23 00 00 00 00 00 02 d4 cc
			23 00 00 00 00 00 02 d5 03
			23 00 00 00 00 00 02 d6 02
			23 00 00 00 00 00 02 d7 03
			23 00 00 00 00 00 02 d8 27
			23 00 00 00 00 00 02 d9 03
			23 00 00 00 00 00 02 da 54
			23 00 00 00 00 00 02 db 03
			23 00 00 00 00 00 02 dc 61
			23 00 00 00 00 00 02 dd 03
			23 00 00 00 00 00 02 de 6f
			23 00 00 00 00 00 02 df 03
			23 00 00 00 00 00 02 e0 7e
			23 00 00 00 00 00 02 e1 03
			23 00 00 00 00 00 02 e2 8e
			23 00 00 00 00 00 02 e3 03
			23 00 00 00 00 00 02 e4 a1
			23 00 00 00 00 00 02 e5 03
			23 00 00 00 00 00 02 e6 b7
			23 00 00 00 00 00 02 e7 03
			23 00 00 00 00 00 02 e8 cc
			23 00 00 00 00 00 02 e9 03
			23 01 00 00 00 00 02 ea cf
		];
		qcom,mdss-dsi-eyecare-level2-command = [
			23 00 00 00 00 00 02 ff 01
			23 00 00 00 00 00 02 fb 01
			23 00 00 00 00 00 02 75 00
			23 00 00 00 00 00 02 76 22
			23 00 00 00 00 00 02 77 00
			23 00 00 00 00 00 02 78 36
			23 00 00 00 00 00 02 79 00
			23 00 00 00 00 00 02 7a 54
			23 00 00 00 00 00 02 7b 00
			23 00 00 00 00 00 02 7c 6e
			23 00 00 00 00 00 02 7d 00
			23 00 00 00 00 00 02 7e 83
			23 00 00 00 00 00 02 7f 00
			23 00 00 00 00 00 02 80 97
			23 00 00 00 00 00 02 81 00
			23 00 00 00 00 00 02 82 a8
			23 00 00 00 00 00 02 83 00
			23 00 00 00 00 00 02 84 b8
			23 00 00 00 00 00 02 85 00
			23 00 00 00 00 00 02 86 c7
			23 00 00 00 00 00 02 87 00
			23 00 00 00 00 00 02 88 fa
			23 00 00 00 00 00 02 89 01
			23 00 00 00 00 00 02 8a 22
			23 00 00 00 00 00 02 8b 01
			23 00 00 00 00 00 02 8c 61
			23 00 00 00 00 00 02 8d 01
			23 00 00 00 00 00 02 8e 93
			23 00 00 00 00 00 02 8f 01
			23 00 00 00 00 00 02 90 e0
			23 00 00 00 00 00 02 91 02
			23 00 00 00 00 00 02 92 1d
			23 00 00 00 00 00 02 93 02
			23 00 00 00 00 00 02 94 1f
			23 00 00 00 00 00 02 95 02
			23 00 00 00 00 00 02 96 58
			23 00 00 00 00 00 02 97 02
			23 00 00 00 00 00 02 98 99
			23 00 00 00 00 00 02 99 02
			23 00 00 00 00 00 02 9a c2
			23 00 00 00 00 00 02 9b 02
			23 00 00 00 00 00 02 9c fb
			23 00 00 00 00 00 02 9d 03
			23 00 00 00 00 00 02 9e 21
			23 00 00 00 00 00 02 9f 03
			23 00 00 00 00 00 02 a0 4f
			23 00 00 00 00 00 02 a2 03
			23 00 00 00 00 00 02 a3 5d
			23 00 00 00 00 00 02 a4 03
			23 00 00 00 00 00 02 a5 6c
			23 00 00 00 00 00 02 a6 03
			23 00 00 00 00 00 02 a7 7d
			23 00 00 00 00 00 02 a9 03
			23 00 00 00 00 00 02 aa 90
			23 00 00 00 00 00 02 ab 03
			23 00 00 00 00 00 02 ac a8
			23 00 00 00 00 00 02 ad 03
			23 00 00 00 00 00 02 ae bf
			23 00 00 00 00 00 02 af 03
			23 00 00 00 00 00 02 b0 ce
			23 00 00 00 00 00 02 b1 03
			23 00 00 00 00 00 02 b2 cf
			23 00 00 00 00 00 02 b3 00
			23 00 00 00 00 00 02 b4 22
			23 00 00 00 00 00 02 b5 00
			23 00 00 00 00 00 02 b6 36
			23 00 00 00 00 00 02 b7 00
			23 00 00 00 00 00 02 b8 54
			23 00 00 00 00 00 02 b9 00
			23 00 00 00 00 00 02 ba 6e
			23 00 00 00 00 00 02 bb 00
			23 00 00 00 00 00 02 bc 83
			23 00 00 00 00 00 02 bd 00
			23 00 00 00 00 00 02 be 97
			23 00 00 00 00 00 02 bf 00
			23 00 00 00 00 00 02 c0 a8
			23 00 00 00 00 00 02 c1 00
			23 00 00 00 00 00 02 c2 b8
			23 00 00 00 00 00 02 c3 00
			23 00 00 00 00 00 02 c4 c7
			23 00 00 00 00 00 02 c5 00
			23 00 00 00 00 00 02 c6 fa
			23 00 00 00 00 00 02 c7 01
			23 00 00 00 00 00 02 c8 22
			23 00 00 00 00 00 02 c9 01
			23 00 00 00 00 00 02 ca 61
			23 00 00 00 00 00 02 cb 01
			23 00 00 00 00 00 02 cc 93
			23 00 00 00 00 00 02 cd 01
			23 00 00 00 00 00 02 ce e0
			23 00 00 00 00 00 02 cf 02
			23 00 00 00 00 00 02 d0 1d
			23 00 00 00 00 00 02 d1 02
			23 00 00 00 00 00 02 d2 1f
			23 00 00 00 00 00 02 d3 02
			23 00 00 00 00 00 02 d4 58
			23 00 00 00 00 00 02 d5 02
			23 00 00 00 00 00 02 d6 99
			23 00 00 00 00 00 02 d7 02
			23 00 00 00 00 00 02 d8 c2
			23 00 00 00 00 00 02 d9 02
			23 00 00 00 00 00 02 da fb
			23 00 00 00 00 00 02 db 03
			23 00 00 00 00 00 02 dc 21
			23 00 00 00 00 00 02 dd 03
			23 00 00 00 00 00 02 de 4f
			23 00 00 00 00 00 02 df 03
			23 00 00 00 00 00 02 e0 5d
			23 00 00 00 00 00 02 e1 03
			23 00 00 00 00 00 02 e2 6c
			23 00 00 00 00 00 02 e3 03
			23 00 00 00 00 00 02 e4 7d
			23 00 00 00 00 00 02 e5 03
			23 00 00 00 00 00 02 e6 90
			23 00 00 00 00 00 02 e7 03
			23 00 00 00 00 00 02 e8 a8
			23 00 00 00 00 00 02 e9 03
			23 00 00 00 00 00 02 ea bf
			23 00 00 00 00 00 02 eb 03
			23 00 00 00 00 00 02 ec ce
			23 00 00 00 00 00 02 ed 03
			23 01 00 00 00 00 02 ee cf
			23 00 00 00 00 00 02 ef 00
			23 00 00 00 00 00 02 f0 00
			23 00 00 00 00 00 02 f1 00
			23 00 00 00 00 00 02 f2 1d
			23 00 00 00 00 00 02 f3 00
			23 00 00 00 00 00 02 f4 44
			23 00 00 00 00 00 02 f5 00
			23 00 00 00 00 00 02 f6 61
			23 00 00 00 00 00 02 f7 00
			23 00 00 00 00 00 02 f8 78
			23 00 00 00 00 00 02 f9 00
			23 00 00 00 00 00 02 fa 8d
			23 00 00 00 00 00 02 ff 02
			23 00 00 00 00 00 02 fb 01
			23 00 00 00 00 00 02 00 00
			23 00 00 00 00 00 02 01 9f
			23 00 00 00 00 00 02 02 00
			23 00 00 00 00 00 02 03 b0
			23 00 00 00 00 00 02 04 00
			23 00 00 00 00 00 02 05 bf
			23 00 00 00 00 00 02 06 00
			23 00 00 00 00 00 02 07 f3
			23 00 00 00 00 00 02 08 01
			23 00 00 00 00 00 02 09 1c
			23 00 00 00 00 00 02 0a 01
			23 00 00 00 00 00 02 0b 5d
			23 00 00 00 00 00 02 0c 01
			23 00 00 00 00 00 02 0d 8f
			23 00 00 00 00 00 02 0e 01
			23 00 00 00 00 00 02 0f df
			23 00 00 00 00 00 02 10 02
			23 00 00 00 00 00 02 11 1c
			23 00 00 00 00 00 02 12 02
			23 00 00 00 00 00 02 13 1e
			23 00 00 00 00 00 02 14 02
			23 00 00 00 00 00 02 15 58
			23 00 00 00 00 00 02 16 02
			23 00 00 00 00 00 02 17 99
			23 00 00 00 00 00 02 18 02
			23 00 00 00 00 00 02 19 c3
			23 00 00 00 00 00 02 1a 02
			23 00 00 00 00 00 02 1b fc
			23 00 00 00 00 00 02 1c 03
			23 00 00 00 00 00 02 1d 21
			23 00 00 00 00 00 02 1e 03
			23 00 00 00 00 00 02 1f 4f
			23 00 00 00 00 00 02 20 03
			23 00 00 00 00 00 02 21 5c
			23 00 00 00 00 00 02 22 03
			23 00 00 00 00 00 02 23 6b
			23 00 00 00 00 00 02 24 03
			23 00 00 00 00 00 02 25 7c
			23 00 00 00 00 00 02 26 03
			23 00 00 00 00 00 02 27 8f
			23 00 00 00 00 00 02 28 03
			23 00 00 00 00 00 02 29 a5
			23 00 00 00 00 00 02 2a 03
			23 00 00 00 00 00 02 2b be
			23 00 00 00 00 00 02 2d 03
			23 00 00 00 00 00 02 2f cd
			23 00 00 00 00 00 02 30 03
			23 00 00 00 00 00 02 31 cf
			23 00 00 00 00 00 02 32 00
			23 00 00 00 00 00 02 33 00
			23 00 00 00 00 00 02 34 00
			23 00 00 00 00 00 02 35 1d
			23 00 00 00 00 00 02 36 00
			23 00 00 00 00 00 02 37 44
			23 00 00 00 00 00 02 38 00
			23 00 00 00 00 00 02 39 61
			23 00 00 00 00 00 02 3a 00
			23 00 00 00 00 00 02 3b 78
			23 00 00 00 00 00 02 3d 00
			23 00 00 00 00 00 02 3f 8d
			23 00 00 00 00 00 02 40 00
			23 00 00 00 00 00 02 41 9f
			23 00 00 00 00 00 02 42 00
			23 00 00 00 00 00 02 43 b0
			23 00 00 00 00 00 02 44 00
			23 00 00 00 00 00 02 45 bf
			23 00 00 00 00 00 02 46 00
			23 00 00 00 00 00 02 47 f3
			23 00 00 00 00 00 02 48 01
			23 00 00 00 00 00 02 49 1c
			23 00 00 00 00 00 02 4a 01
			23 00 00 00 00 00 02 4b 5d
			23 00 00 00 00 00 02 4c 01
			23 00 00 00 00 00 02 4d 8f
			23 00 00 00 00 00 02 4e 01
			23 00 00 00 00 00 02 4f df
			23 00 00 00 00 00 02 50 02
			23 00 00 00 00 00 02 51 1c
			23 00 00 00 00 00 02 52 02
			23 00 00 00 00 00 02 53 1e
			23 00 00 00 00 00 02 54 02
			23 00 00 00 00 00 02 55 58
			23 00 00 00 00 00 02 56 02
			23 00 00 00 00 00 02 58 99
			23 00 00 00 00 00 02 59 02
			23 00 00 00 00 00 02 5a c3
			23 00 00 00 00 00 02 5b 02
			23 00 00 00 00 00 02 5c fc
			23 00 00 00 00 00 02 5d 03
			23 00 00 00 00 00 02 5e 21
			23 00 00 00 00 00 02 5f 03
			23 00 00 00 00 00 02 60 4f
			23 00 00 00 00 00 02 61 03
			23 00 00 00 00 00 02 62 5c
			23 00 00 00 00 00 02 63 03
			23 00 00 00 00 00 02 64 6b
			23 00 00 00 00 00 02 65 03
			23 00 00 00 00 00 02 66 7c
			23 00 00 00 00 00 02 67 03
			23 00 00 00 00 00 02 68 8f
			23 00 00 00 00 00 02 69 03
			23 00 00 00 00 00 02 6a a5
			23 00 00 00 00 00 02 6b 03
			23 00 00 00 00 00 02 6c be
			23 00 00 00 00 00 02 6d 03
			23 00 00 00 00 00 02 6e cd
			23 00 00 00 00 00 02 6f 03
			23 01 00 00 00 00 02 70 cf
			23 00 00 00 00 00 02 71 01
			23 00 00 00 00 00 02 72 10
			23 00 00 00 00 00 02 73 01
			23 00 00 00 00 00 02 74 14
			23 00 00 00 00 00 02 75 01
			23 00 00 00 00 00 02 76 1d
			23 00 00 00 00 00 02 77 01
			23 00 00 00 00 00 02 78 24
			23 00 00 00 00 00 02 79 01
			23 00 00 00 00 00 02 7a 2c
			23 00 00 00 00 00 02 7b 01
			23 00 00 00 00 00 02 7c 34
			23 00 00 00 00 00 02 7d 01
			23 00 00 00 00 00 02 7e 3b
			23 00 00 00 00 00 02 7f 01
			23 00 00 00 00 00 02 80 42
			23 00 00 00 00 00 02 81 01
			23 00 00 00 00 00 02 82 49
			23 00 00 00 00 00 02 83 01
			23 00 00 00 00 00 02 84 62
			23 00 00 00 00 00 02 85 01
			23 00 00 00 00 00 02 86 79
			23 00 00 00 00 00 02 87 01
			23 00 00 00 00 00 02 88 a2
			23 00 00 00 00 00 02 89 01
			23 00 00 00 00 00 02 8a c6
			23 00 00 00 00 00 02 8b 02
			23 00 00 00 00 00 02 8c 01
			23 00 00 00 00 00 02 8d 02
			23 00 00 00 00 00 02 8e 36
			23 00 00 00 00 00 02 8f 02
			23 00 00 00 00 00 02 90 37
			23 00 00 00 00 00 02 91 02
			23 00 00 00 00 00 02 92 6b
			23 00 00 00 00 00 02 93 02
			23 00 00 00 00 00 02 94 a9
			23 00 00 00 00 00 02 95 02
			23 00 00 00 00 00 02 96 d2
			23 00 00 00 00 00 02 97 03
			23 00 00 00 00 00 02 98 07
			23 00 00 00 00 00 02 99 03
			23 00 00 00 00 00 02 9a 2d
			23 00 00 00 00 00 02 9b 03
			23 00 00 00 00 00 02 9c 58
			23 00 00 00 00 00 02 9d 03
			23 00 00 00 00 00 02 9e 65
			23 00 00 00 00 00 02 9f 03
			23 00 00 00 00 00 02 a0 72
			23 00 00 00 00 00 02 a2 03
			23 00 00 00 00 00 02 a3 81
			23 00 00 00 00 00 02 a4 03
			23 00 00 00 00 00 02 a5 91
			23 00 00 00 00 00 02 a6 03
			23 00 00 00 00 00 02 a7 a3
			23 00 00 00 00 00 02 a9 03
			23 00 00 00 00 00 02 aa b9
			23 00 00 00 00 00 02 ab 03
			23 00 00 00 00 00 02 ac cc
			23 00 00 00 00 00 02 ad 03
			23 00 00 00 00 00 02 ae cf
			23 00 00 00 00 00 02 af 01
			23 00 00 00 00 00 02 b0 10
			23 00 00 00 00 00 02 b1 01
			23 00 00 00 00 00 02 b2 14
			23 00 00 00 00 00 02 b3 01
			23 00 00 00 00 00 02 b4 1d
			23 00 00 00 00 00 02 b5 01
			23 00 00 00 00 00 02 b6 24
			23 00 00 00 00 00 02 b7 01
			23 00 00 00 00 00 02 b8 2c
			23 00 00 00 00 00 02 b9 01
			23 00 00 00 00 00 02 ba 34
			23 00 00 00 00 00 02 bb 01
			23 00 00 00 00 00 02 bc 3b
			23 00 00 00 00 00 02 bd 01
			23 00 00 00 00 00 02 be 42
			23 00 00 00 00 00 02 bf 01
			23 00 00 00 00 00 02 c0 49
			23 00 00 00 00 00 02 c1 01
			23 00 00 00 00 00 02 c2 62
			23 00 00 00 00 00 02 c3 01
			23 00 00 00 00 00 02 c4 79
			23 00 00 00 00 00 02 c5 01
			23 00 00 00 00 00 02 c6 a2
			23 00 00 00 00 00 02 c7 01
			23 00 00 00 00 00 02 c8 c6
			23 00 00 00 00 00 02 c9 02
			23 00 00 00 00 00 02 ca 01
			23 00 00 00 00 00 02 cb 02
			23 00 00 00 00 00 02 cc 36
			23 00 00 00 00 00 02 cd 02
			23 00 00 00 00 00 02 ce 37
			23 00 00 00 00 00 02 cf 02
			23 00 00 00 00 00 02 d0 6b
			23 00 00 00 00 00 02 d1 02
			23 00 00 00 00 00 02 d2 a9
			23 00 00 00 00 00 02 d3 02
			23 00 00 00 00 00 02 d4 d2
			23 00 00 00 00 00 02 d5 03
			23 00 00 00 00 00 02 d6 07
			23 00 00 00 00 00 02 d7 03
			23 00 00 00 00 00 02 d8 2d
			23 00 00 00 00 00 02 d9 03
			23 00 00 00 00 00 02 da 58
			23 00 00 00 00 00 02 db 03
			23 00 00 00 00 00 02 dc 65
			23 00 00 00 00 00 02 dd 03
			23 00 00 00 00 00 02 de 72
			23 00 00 00 00 00 02 df 03
			23 00 00 00 00 00 02 e0 81
			23 00 00 00 00 00 02 e1 03
			23 00 00 00 00 00 02 e2 91
			23 00 00 00 00 00 02 e3 03
			23 00 00 00 00 00 02 e4 a3
			23 00 00 00 00 00 02 e5 03
			23 00 00 00 00 00 02 e6 b9
			23 00 00 00 00 00 02 e7 03
			23 00 00 00 00 00 02 e8 cc
			23 00 00 00 00 00 02 e9 03
			23 01 00 00 00 00 02 ea cf
		];
		qcom,mdss-dsi-eyecare-level3-command = [
			23 00 00 00 00 00 02 ff 01
			23 00 00 00 00 00 02 fb 01
			23 00 00 00 00 00 02 75 00
			23 00 00 00 00 00 02 76 33
			23 00 00 00 00 00 02 77 00
			23 00 00 00 00 00 02 78 44
			23 00 00 00 00 00 02 79 00
			23 00 00 00 00 00 02 7a 60
			23 00 00 00 00 00 02 7b 00
			23 00 00 00 00 00 02 7c 77
			23 00 00 00 00 00 02 7d 00
			23 00 00 00 00 00 02 7e 8c
			23 00 00 00 00 00 02 7f 00
			23 00 00 00 00 00 02 80 9e
			23 00 00 00 00 00 02 81 00
			23 00 00 00 00 00 02 82 af
			23 00 00 00 00 00 02 83 00
			23 00 00 00 00 00 02 84 bf
			23 00 00 00 00 00 02 85 00
			23 00 00 00 00 00 02 86 cd
			23 00 00 00 00 00 02 87 00
			23 00 00 00 00 00 02 88 fe
			23 00 00 00 00 00 02 89 01
			23 00 00 00 00 00 02 8a 25
			23 00 00 00 00 00 02 8b 01
			23 00 00 00 00 00 02 8c 64
			23 00 00 00 00 00 02 8d 01
			23 00 00 00 00 00 02 8e 94
			23 00 00 00 00 00 02 8f 01
			23 00 00 00 00 00 02 90 e1
			23 00 00 00 00 00 02 91 02
			23 00 00 00 00 00 02 92 1e
			23 00 00 00 00 00 02 93 02
			23 00 00 00 00 00 02 94 20
			23 00 00 00 00 00 02 95 02
			23 00 00 00 00 00 02 96 59
			23 00 00 00 00 00 02 97 02
			23 00 00 00 00 00 02 98 99
			23 00 00 00 00 00 02 99 02
			23 00 00 00 00 00 02 9a c3
			23 00 00 00 00 00 02 9b 02
			23 00 00 00 00 00 02 9c fb
			23 00 00 00 00 00 02 9d 03
			23 00 00 00 00 00 02 9e 21
			23 00 00 00 00 00 02 9f 03
			23 00 00 00 00 00 02 a0 4f
			23 00 00 00 00 00 02 a2 03
			23 00 00 00 00 00 02 a3 5d
			23 00 00 00 00 00 02 a4 03
			23 00 00 00 00 00 02 a5 6c
			23 00 00 00 00 00 02 a6 03
			23 00 00 00 00 00 02 a7 7d
			23 00 00 00 00 00 02 a9 03
			23 00 00 00 00 00 02 aa 91
			23 00 00 00 00 00 02 ab 03
			23 00 00 00 00 00 02 ac a8
			23 00 00 00 00 00 02 ad 03
			23 00 00 00 00 00 02 ae bf
			23 00 00 00 00 00 02 af 03
			23 00 00 00 00 00 02 b0 ce
			23 00 00 00 00 00 02 b1 03
			23 00 00 00 00 00 02 b2 cf
			23 00 00 00 00 00 02 b3 00
			23 00 00 00 00 00 02 b4 33
			23 00 00 00 00 00 02 b5 00
			23 00 00 00 00 00 02 b6 44
			23 00 00 00 00 00 02 b7 00
			23 00 00 00 00 00 02 b8 60
			23 00 00 00 00 00 02 b9 00
			23 00 00 00 00 00 02 ba 77
			23 00 00 00 00 00 02 bb 00
			23 00 00 00 00 00 02 bc 8c
			23 00 00 00 00 00 02 bd 00
			23 00 00 00 00 00 02 be 9e
			23 00 00 00 00 00 02 bf 00
			23 00 00 00 00 00 02 c0 af
			23 00 00 00 00 00 02 c1 00
			23 00 00 00 00 00 02 c2 bf
			23 00 00 00 00 00 02 c3 00
			23 00 00 00 00 00 02 c4 cd
			23 00 00 00 00 00 02 c5 00
			23 00 00 00 00 00 02 c6 fe
			23 00 00 00 00 00 02 c7 01
			23 00 00 00 00 00 02 c8 25
			23 00 00 00 00 00 02 c9 01
			23 00 00 00 00 00 02 ca 64
			23 00 00 00 00 00 02 cb 01
			23 00 00 00 00 00 02 cc 94
			23 00 00 00 00 00 02 cd 01
			23 00 00 00 00 00 02 ce e1
			23 00 00 00 00 00 02 cf 02
			23 00 00 00 00 00 02 d0 1e
			23 00 00 00 00 00 02 d1 02
			23 00 00 00 00 00 02 d2 20
			23 00 00 00 00 00 02 d3 02
			23 00 00 00 00 00 02 d4 59
			23 00 00 00 00 00 02 d5 02
			23 00 00 00 00 00 02 d6 99
			23 00 00 00 00 00 02 d7 02
			23 00 00 00 00 00 02 d8 c3
			23 00 00 00 00 00 02 d9 02
			23 00 00 00 00 00 02 da fb
			23 00 00 00 00 00 02 db 03
			23 00 00 00 00 00 02 dc 21
			23 00 00 00 00 00 02 dd 03
			23 00 00 00 00 00 02 de 4f
			23 00 00 00 00 00 02 df 03
			23 00 00 00 00 00 02 e0 5d
			23 00 00 00 00 00 02 e1 03
			23 00 00 00 00 00 02 e2 6c
			23 00 00 00 00 00 02 e3 03
			23 00 00 00 00 00 02 e4 7d
			23 00 00 00 00 00 02 e5 03
			23 00 00 00 00 00 02 e6 91
			23 00 00 00 00 00 02 e7 03
			23 00 00 00 00 00 02 e8 a8
			23 00 00 00 00 00 02 e9 03
			23 00 00 00 00 00 02 ea bf
			23 00 00 00 00 00 02 eb 03
			23 00 00 00 00 00 02 ec ce
			23 00 00 00 00 00 02 ed 03
			23 01 00 00 00 00 02 ee cf
			23 00 00 00 00 00 02 ef 00
			23 00 00 00 00 00 02 f0 00
			23 00 00 00 00 00 02 f1 00
			23 00 00 00 00 00 02 f2 1d
			23 00 00 00 00 00 02 f3 00
			23 00 00 00 00 00 02 f4 44
			23 00 00 00 00 00 02 f5 00
			23 00 00 00 00 00 02 f6 61
			23 00 00 00 00 00 02 f7 00
			23 00 00 00 00 00 02 f8 78
			23 00 00 00 00 00 02 f9 00
			23 00 00 00 00 00 02 fa 8d
			23 00 00 00 00 00 02 ff 02
			23 00 00 00 00 00 02 fb 01
			23 00 00 00 00 00 02 00 00
			23 00 00 00 00 00 02 01 9f
			23 00 00 00 00 00 02 02 00
			23 00 00 00 00 00 02 03 b0
			23 00 00 00 00 00 02 04 00
			23 00 00 00 00 00 02 05 bf
			23 00 00 00 00 00 02 06 00
			23 00 00 00 00 00 02 07 f3
			23 00 00 00 00 00 02 08 01
			23 00 00 00 00 00 02 09 1c
			23 00 00 00 00 00 02 0a 01
			23 00 00 00 00 00 02 0b 5d
			23 00 00 00 00 00 02 0c 01
			23 00 00 00 00 00 02 0d 8f
			23 00 00 00 00 00 02 0e 01
			23 00 00 00 00 00 02 0f df
			23 00 00 00 00 00 02 10 02
			23 00 00 00 00 00 02 11 1c
			23 00 00 00 00 00 02 12 02
			23 00 00 00 00 00 02 13 1e
			23 00 00 00 00 00 02 14 02
			23 00 00 00 00 00 02 15 58
			23 00 00 00 00 00 02 16 02
			23 00 00 00 00 00 02 17 99
			23 00 00 00 00 00 02 18 02
			23 00 00 00 00 00 02 19 c3
			23 00 00 00 00 00 02 1a 02
			23 00 00 00 00 00 02 1b fc
			23 00 00 00 00 00 02 1c 03
			23 00 00 00 00 00 02 1d 21
			23 00 00 00 00 00 02 1e 03
			23 00 00 00 00 00 02 1f 4f
			23 00 00 00 00 00 02 20 03
			23 00 00 00 00 00 02 21 5c
			23 00 00 00 00 00 02 22 03
			23 00 00 00 00 00 02 23 6b
			23 00 00 00 00 00 02 24 03
			23 00 00 00 00 00 02 25 7c
			23 00 00 00 00 00 02 26 03
			23 00 00 00 00 00 02 27 8f
			23 00 00 00 00 00 02 28 03
			23 00 00 00 00 00 02 29 a5
			23 00 00 00 00 00 02 2a 03
			23 00 00 00 00 00 02 2b be
			23 00 00 00 00 00 02 2d 03
			23 00 00 00 00 00 02 2f cd
			23 00 00 00 00 00 02 30 03
			23 00 00 00 00 00 02 31 cf
			23 00 00 00 00 00 02 32 00
			23 00 00 00 00 00 02 33 00
			23 00 00 00 00 00 02 34 00
			23 00 00 00 00 00 02 35 1d
			23 00 00 00 00 00 02 36 00
			23 00 00 00 00 00 02 37 44
			23 00 00 00 00 00 02 38 00
			23 00 00 00 00 00 02 39 61
			23 00 00 00 00 00 02 3a 00
			23 00 00 00 00 00 02 3b 78
			23 00 00 00 00 00 02 3d 00
			23 00 00 00 00 00 02 3f 8d
			23 00 00 00 00 00 02 40 00
			23 00 00 00 00 00 02 41 9f
			23 00 00 00 00 00 02 42 00
			23 00 00 00 00 00 02 43 b0
			23 00 00 00 00 00 02 44 00
			23 00 00 00 00 00 02 45 bf
			23 00 00 00 00 00 02 46 00
			23 00 00 00 00 00 02 47 f3
			23 00 00 00 00 00 02 48 01
			23 00 00 00 00 00 02 49 1c
			23 00 00 00 00 00 02 4a 01
			23 00 00 00 00 00 02 4b 5d
			23 00 00 00 00 00 02 4c 01
			23 00 00 00 00 00 02 4d 8f
			23 00 00 00 00 00 02 4e 01
			23 00 00 00 00 00 02 4f df
			23 00 00 00 00 00 02 50 02
			23 00 00 00 00 00 02 51 1c
			23 00 00 00 00 00 02 52 02
			23 00 00 00 00 00 02 53 1e
			23 00 00 00 00 00 02 54 02
			23 00 00 00 00 00 02 55 58
			23 00 00 00 00 00 02 56 02
			23 00 00 00 00 00 02 58 99
			23 00 00 00 00 00 02 59 02
			23 00 00 00 00 00 02 5a c3
			23 00 00 00 00 00 02 5b 02
			23 00 00 00 00 00 02 5c fc
			23 00 00 00 00 00 02 5d 03
			23 00 00 00 00 00 02 5e 21
			23 00 00 00 00 00 02 5f 03
			23 00 00 00 00 00 02 60 4f
			23 00 00 00 00 00 02 61 03
			23 00 00 00 00 00 02 62 5c
			23 00 00 00 00 00 02 63 03
			23 00 00 00 00 00 02 64 6b
			23 00 00 00 00 00 02 65 03
			23 00 00 00 00 00 02 66 7c
			23 00 00 00 00 00 02 67 03
			23 00 00 00 00 00 02 68 8f
			23 00 00 00 00 00 02 69 03
			23 00 00 00 00 00 02 6a a5
			23 00 00 00 00 00 02 6b 03
			23 00 00 00 00 00 02 6c be
			23 00 00 00 00 00 02 6d 03
			23 00 00 00 00 00 02 6e cd
			23 00 00 00 00 00 02 6f 03
			23 01 00 00 00 00 02 70 cf
			23 00 00 00 00 00 02 71 01
			23 00 00 00 00 00 02 72 40
			23 00 00 00 00 00 02 73 01
			23 00 00 00 00 00 02 74 43
			23 00 00 00 00 00 02 75 01
			23 00 00 00 00 00 02 76 4a
			23 00 00 00 00 00 02 77 01
			23 00 00 00 00 00 02 78 50
			23 00 00 00 00 00 02 79 01
			23 00 00 00 00 00 02 7a 56
			23 00 00 00 00 00 02 7b 01
			23 00 00 00 00 00 02 7c 5c
			23 00 00 00 00 00 02 7d 01
			23 00 00 00 00 00 02 7e 62
			23 00 00 00 00 00 02 7f 01
			23 00 00 00 00 00 02 80 68
			23 00 00 00 00 00 02 81 01
			23 00 00 00 00 00 02 82 6d
			23 00 00 00 00 00 02 83 01
			23 00 00 00 00 00 02 84 83
			23 00 00 00 00 00 02 85 01
			23 00 00 00 00 00 02 86 96
			23 00 00 00 00 00 02 87 01
			23 00 00 00 00 00 02 88 ba
			23 00 00 00 00 00 02 89 01
			23 00 00 00 00 00 02 8a d9
			23 00 00 00 00 00 02 8b 02
			23 00 00 00 00 00 02 8c 0f
			23 00 00 00 00 00 02 8d 02
			23 00 00 00 00 00 02 8e 40
			23 00 00 00 00 00 02 8f 02
			23 00 00 00 00 00 02 90 41
			23 00 00 00 00 00 02 91 02
			23 00 00 00 00 00 02 92 73
			23 00 00 00 00 00 02 93 02
			23 00 00 00 00 00 02 94 b0
			23 00 00 00 00 00 02 95 02
			23 00 00 00 00 00 02 96 d9
			23 00 00 00 00 00 02 97 03
			23 00 00 00 00 00 02 98 0d
			23 00 00 00 00 00 02 99 03
			23 00 00 00 00 00 02 9a 32
			23 00 00 00 00 00 02 9b 03
			23 00 00 00 00 00 02 9c 5d
			23 00 00 00 00 00 02 9d 03
			23 00 00 00 00 00 02 9e 69
			23 00 00 00 00 00 02 9f 03
			23 00 00 00 00 00 02 a0 76
			23 00 00 00 00 00 02 a2 03
			23 00 00 00 00 00 02 a3 84
			23 00 00 00 00 00 02 a4 03
			23 00 00 00 00 00 02 a5 94
			23 00 00 00 00 00 02 a6 03
			23 00 00 00 00 00 02 a7 a6
			23 00 00 00 00 00 02 a9 03
			23 00 00 00 00 00 02 aa ba
			23 00 00 00 00 00 02 ab 03
			23 00 00 00 00 00 02 ac cd
			23 00 00 00 00 00 02 ad 03
			23 00 00 00 00 00 02 ae cf
			23 00 00 00 00 00 02 af 01
			23 00 00 00 00 00 02 b0 40
			23 00 00 00 00 00 02 b1 01
			23 00 00 00 00 00 02 b2 43
			23 00 00 00 00 00 02 b3 01
			23 00 00 00 00 00 02 b4 4a
			23 00 00 00 00 00 02 b5 01
			23 00 00 00 00 00 02 b6 50
			23 00 00 00 00 00 02 b7 01
			23 00 00 00 00 00 02 b8 56
			23 00 00 00 00 00 02 b9 01
			23 00 00 00 00 00 02 ba 5c
			23 00 00 00 00 00 02 bb 01
			23 00 00 00 00 00 02 bc 62
			23 00 00 00 00 00 02 bd 01
			23 00 00 00 00 00 02 be 68
			23 00 00 00 00 00 02 bf 01
			23 00 00 00 00 00 02 c0 6d
			23 00 00 00 00 00 02 c1 01
			23 00 00 00 00 00 02 c2 83
			23 00 00 00 00 00 02 c3 01
			23 00 00 00 00 00 02 c4 96
			23 00 00 00 00 00 02 c5 01
			23 00 00 00 00 00 02 c6 ba
			23 00 00 00 00 00 02 c7 01
			23 00 00 00 00 00 02 c8 d9
			23 00 00 00 00 00 02 c9 02
			23 00 00 00 00 00 02 ca 0f
			23 00 00 00 00 00 02 cb 02
			23 00 00 00 00 00 02 cc 40
			23 00 00 00 00 00 02 cd 02
			23 00 00 00 00 00 02 ce 41
			23 00 00 00 00 00 02 cf 02
			23 00 00 00 00 00 02 d0 73
			23 00 00 00 00 00 02 d1 02
			23 00 00 00 00 00 02 d2 b0
			23 00 00 00 00 00 02 d3 02
			23 00 00 00 00 00 02 d4 d9
			23 00 00 00 00 00 02 d5 03
			23 00 00 00 00 00 02 d6 0d
			23 00 00 00 00 00 02 d7 03
			23 00 00 00 00 00 02 d8 32
			23 00 00 00 00 00 02 d9 03
			23 00 00 00 00 00 02 da 5d
			23 00 00 00 00 00 02 db 03
			23 00 00 00 00 00 02 dc 69
			23 00 00 00 00 00 02 dd 03
			23 00 00 00 00 00 02 de 76
			23 00 00 00 00 00 02 df 03
			23 00 00 00 00 00 02 e0 84
			23 00 00 00 00 00 02 e1 03
			23 00 00 00 00 00 02 e2 94
			23 00 00 00 00 00 02 e3 03
			23 00 00 00 00 00 02 e4 a6
			23 00 00 00 00 00 02 e5 03
			23 00 00 00 00 00 02 e6 ba
			23 00 00 00 00 00 02 e7 03
			23 00 00 00 00 00 02 e8 cd
			23 00 00 00 00 00 02 e9 03
			23 01 00 00 00 00 02 ea cf
		];
		qcom,mdss-dsi-eyecare-level4-command = [
			23 00 00 00 00 00 02 ff 01
			23 00 00 00 00 00 02 fb 01
			23 00 00 00 00 00 02 75 00
			23 00 00 00 00 00 02 76 43
			23 00 00 00 00 00 02 77 00
			23 00 00 00 00 00 02 78 52
			23 00 00 00 00 00 02 79 00
			23 00 00 00 00 00 02 7a 6b
			23 00 00 00 00 00 02 7b 00
			23 00 00 00 00 00 02 7c 81
			23 00 00 00 00 00 02 7d 00
			23 00 00 00 00 00 02 7e 95
			23 00 00 00 00 00 02 7f 00
			23 00 00 00 00 00 02 80 a6
			23 00 00 00 00 00 02 81 00
			23 00 00 00 00 00 02 82 b6
			23 00 00 00 00 00 02 83 00
			23 00 00 00 00 00 02 84 c5
			23 00 00 00 00 00 02 85 00
			23 00 00 00 00 00 02 86 d3
			23 00 00 00 00 00 02 87 01
			23 00 00 00 00 00 02 88 03
			23 00 00 00 00 00 02 89 01
			23 00 00 00 00 00 02 8a 29
			23 00 00 00 00 00 02 8b 01
			23 00 00 00 00 00 02 8c 66
			23 00 00 00 00 00 02 8d 01
			23 00 00 00 00 00 02 8e 96
			23 00 00 00 00 00 02 8f 01
			23 00 00 00 00 00 02 90 e2
			23 00 00 00 00 00 02 91 02
			23 00 00 00 00 00 02 92 1f
			23 00 00 00 00 00 02 93 02
			23 00 00 00 00 00 02 94 20
			23 00 00 00 00 00 02 95 02
			23 00 00 00 00 00 02 96 5a
			23 00 00 00 00 00 02 97 02
			23 00 00 00 00 00 02 98 9a
			23 00 00 00 00 00 02 99 02
			23 00 00 00 00 00 02 9a c3
			23 00 00 00 00 00 02 9b 02
			23 00 00 00 00 00 02 9c fc
			23 00 00 00 00 00 02 9d 03
			23 00 00 00 00 00 02 9e 21
			23 00 00 00 00 00 02 9f 03
			23 00 00 00 00 00 02 a0 50
			23 00 00 00 00 00 02 a2 03
			23 00 00 00 00 00 02 a3 5d
			23 00 00 00 00 00 02 a4 03
			23 00 00 00 00 00 02 a5 6c
			23 00 00 00 00 00 02 a6 03
			23 00 00 00 00 00 02 a7 7d
			23 00 00 00 00 00 02 a9 03
			23 00 00 00 00 00 02 aa 91
			23 00 00 00 00 00 02 ab 03
			23 00 00 00 00 00 02 ac a8
			23 00 00 00 00 00 02 ad 03
			23 00 00 00 00 00 02 ae bf
			23 00 00 00 00 00 02 af 03
			23 00 00 00 00 00 02 b0 ce
			23 00 00 00 00 00 02 b1 03
			23 00 00 00 00 00 02 b2 cf
			23 00 00 00 00 00 02 b3 00
			23 00 00 00 00 00 02 b4 43
			23 00 00 00 00 00 02 b5 00
			23 00 00 00 00 00 02 b6 52
			23 00 00 00 00 00 02 b7 00
			23 00 00 00 00 00 02 b8 6b
			23 00 00 00 00 00 02 b9 00
			23 00 00 00 00 00 02 ba 81
			23 00 00 00 00 00 02 bb 00
			23 00 00 00 00 00 02 bc 95
			23 00 00 00 00 00 02 bd 00
			23 00 00 00 00 00 02 be a6
			23 00 00 00 00 00 02 bf 00
			23 00 00 00 00 00 02 c0 b6
			23 00 00 00 00 00 02 c1 00
			23 00 00 00 00 00 02 c2 c5
			23 00 00 00 00 00 02 c3 00
			23 00 00 00 00 00 02 c4 d3
			23 00 00 00 00 00 02 c5 01
			23 00 00 00 00 00 02 c6 03
			23 00 00 00 00 00 02 c7 01
			23 00 00 00 00 00 02 c8 29
			23 00 00 00 00 00 02 c9 01
			23 00 00 00 00 00 02 ca 66
			23 00 00 00 00 00 02 cb 01
			23 00 00 00 00 00 02 cc 96
			23 00 00 00 00 00 02 cd 01
			23 00 00 00 00 00 02 ce e2
			23 00 00 00 00 00 02 cf 02
			23 00 00 00 00 00 02 d0 1f
			23 00 00 00 00 00 02 d1 02
			23 00 00 00 00 00 02 d2 20
			23 00 00 00 00 00 02 d3 02
			23 00 00 00 00 00 02 d4 5a
			23 00 00 00 00 00 02 d5 02
			23 00 00 00 00 00 02 d6 9a
			23 00 00 00 00 00 02 d7 02
			23 00 00 00 00 00 02 d8 c3
			23 00 00 00 00 00 02 d9 02
			23 00 00 00 00 00 02 da fc
			23 00 00 00 00 00 02 db 03
			23 00 00 00 00 00 02 dc 21
			23 00 00 00 00 00 02 dd 03
			23 00 00 00 00 00 02 de 50
			23 00 00 00 00 00 02 df 03
			23 00 00 00 00 00 02 e0 5d
			23 00 00 00 00 00 02 e1 03
			23 00 00 00 00 00 02 e2 6c
			23 00 00 00 00 00 02 e3 03
			23 00 00 00 00 00 02 e4 7d
			23 00 00 00 00 00 02 e5 03
			23 00 00 00 00 00 02 e6 91
			23 00 00 00 00 00 02 e7 03
			23 00 00 00 00 00 02 e8 a8
			23 00 00 00 00 00 02 e9 03
			23 00 00 00 00 00 02 ea bf
			23 00 00 00 00 00 02 eb 03
			23 00 00 00 00 00 02 ec ce
			23 00 00 00 00 00 02 ed 03
			23 01 00 00 00 00 02 ee cf
			23 00 00 00 00 00 02 ef 00
			23 00 00 00 00 00 02 f0 00
			23 00 00 00 00 00 02 f1 00
			23 00 00 00 00 00 02 f2 1d
			23 00 00 00 00 00 02 f3 00
			23 00 00 00 00 00 02 f4 44
			23 00 00 00 00 00 02 f5 00
			23 00 00 00 00 00 02 f6 61
			23 00 00 00 00 00 02 f7 00
			23 00 00 00 00 00 02 f8 78
			23 00 00 00 00 00 02 f9 00
			23 00 00 00 00 00 02 fa 8d
			23 00 00 00 00 00 02 ff 02
			23 00 00 00 00 00 02 fb 01
			23 00 00 00 00 00 02 00 00
			23 00 00 00 00 00 02 01 9f
			23 00 00 00 00 00 02 02 00
			23 00 00 00 00 00 02 03 b0
			23 00 00 00 00 00 02 04 00
			23 00 00 00 00 00 02 05 bf
			23 00 00 00 00 00 02 06 00
			23 00 00 00 00 00 02 07 f3
			23 00 00 00 00 00 02 08 01
			23 00 00 00 00 00 02 09 1c
			23 00 00 00 00 00 02 0a 01
			23 00 00 00 00 00 02 0b 5d
			23 00 00 00 00 00 02 0c 01
			23 00 00 00 00 00 02 0d 8f
			23 00 00 00 00 00 02 0e 01
			23 00 00 00 00 00 02 0f df
			23 00 00 00 00 00 02 10 02
			23 00 00 00 00 00 02 11 1c
			23 00 00 00 00 00 02 12 02
			23 00 00 00 00 00 02 13 1e
			23 00 00 00 00 00 02 14 02
			23 00 00 00 00 00 02 15 58
			23 00 00 00 00 00 02 16 02
			23 00 00 00 00 00 02 17 99
			23 00 00 00 00 00 02 18 02
			23 00 00 00 00 00 02 19 c3
			23 00 00 00 00 00 02 1a 02
			23 00 00 00 00 00 02 1b fc
			23 00 00 00 00 00 02 1c 03
			23 00 00 00 00 00 02 1d 21
			23 00 00 00 00 00 02 1e 03
			23 00 00 00 00 00 02 1f 4f
			23 00 00 00 00 00 02 20 03
			23 00 00 00 00 00 02 21 5c
			23 00 00 00 00 00 02 22 03
			23 00 00 00 00 00 02 23 6b
			23 00 00 00 00 00 02 24 03
			23 00 00 00 00 00 02 25 7c
			23 00 00 00 00 00 02 26 03
			23 00 00 00 00 00 02 27 8f
			23 00 00 00 00 00 02 28 03
			23 00 00 00 00 00 02 29 a5
			23 00 00 00 00 00 02 2a 03
			23 00 00 00 00 00 02 2b be
			23 00 00 00 00 00 02 2d 03
			23 00 00 00 00 00 02 2f cd
			23 00 00 00 00 00 02 30 03
			23 00 00 00 00 00 02 31 cf
			23 00 00 00 00 00 02 32 00
			23 00 00 00 00 00 02 33 00
			23 00 00 00 00 00 02 34 00
			23 00 00 00 00 00 02 35 1d
			23 00 00 00 00 00 02 36 00
			23 00 00 00 00 00 02 37 44
			23 00 00 00 00 00 02 38 00
			23 00 00 00 00 00 02 39 61
			23 00 00 00 00 00 02 3a 00
			23 00 00 00 00 00 02 3b 78
			23 00 00 00 00 00 02 3d 00
			23 00 00 00 00 00 02 3f 8d
			23 00 00 00 00 00 02 40 00
			23 00 00 00 00 00 02 41 9f
			23 00 00 00 00 00 02 42 00
			23 00 00 00 00 00 02 43 b0
			23 00 00 00 00 00 02 44 00
			23 00 00 00 00 00 02 45 bf
			23 00 00 00 00 00 02 46 00
			23 00 00 00 00 00 02 47 f3
			23 00 00 00 00 00 02 48 01
			23 00 00 00 00 00 02 49 1c
			23 00 00 00 00 00 02 4a 01
			23 00 00 00 00 00 02 4b 5d
			23 00 00 00 00 00 02 4c 01
			23 00 00 00 00 00 02 4d 8f
			23 00 00 00 00 00 02 4e 01
			23 00 00 00 00 00 02 4f df
			23 00 00 00 00 00 02 50 02
			23 00 00 00 00 00 02 51 1c
			23 00 00 00 00 00 02 52 02
			23 00 00 00 00 00 02 53 1e
			23 00 00 00 00 00 02 54 02
			23 00 00 00 00 00 02 55 58
			23 00 00 00 00 00 02 56 02
			23 00 00 00 00 00 02 58 99
			23 00 00 00 00 00 02 59 02
			23 00 00 00 00 00 02 5a c3
			23 00 00 00 00 00 02 5b 02
			23 00 00 00 00 00 02 5c fc
			23 00 00 00 00 00 02 5d 03
			23 00 00 00 00 00 02 5e 21
			23 00 00 00 00 00 02 5f 03
			23 00 00 00 00 00 02 60 4f
			23 00 00 00 00 00 02 61 03
			23 00 00 00 00 00 02 62 5c
			23 00 00 00 00 00 02 63 03
			23 00 00 00 00 00 02 64 6b
			23 00 00 00 00 00 02 65 03
			23 00 00 00 00 00 02 66 7c
			23 00 00 00 00 00 02 67 03
			23 00 00 00 00 00 02 68 8f
			23 00 00 00 00 00 02 69 03
			23 00 00 00 00 00 02 6a a5
			23 00 00 00 00 00 02 6b 03
			23 00 00 00 00 00 02 6c be
			23 00 00 00 00 00 02 6d 03
			23 00 00 00 00 00 02 6e cd
			23 00 00 00 00 00 02 6f 03
			23 01 00 00 00 00 02 70 cf
			23 00 00 00 00 00 02 71 01
			23 00 00 00 00 00 02 72 70
			23 00 00 00 00 00 02 73 01
			23 00 00 00 00 00 02 74 73
			23 00 00 00 00 00 02 75 01
			23 00 00 00 00 00 02 76 78
			23 00 00 00 00 00 02 77 01
			23 00 00 00 00 00 02 78 7d
			23 00 00 00 00 00 02 79 01
			23 00 00 00 00 00 02 7a 81
			23 00 00 00 00 00 02 7b 01
			23 00 00 00 00 00 02 7c 86
			23 00 00 00 00 00 02 7d 01
			23 00 00 00 00 00 02 7e 8b
			23 00 00 00 00 00 02 7f 01
			23 00 00 00 00 00 02 80 8f
			23 00 00 00 00 00 02 81 01
			23 00 00 00 00 00 02 82 94
			23 00 00 00 00 00 02 83 01
			23 00 00 00 00 00 02 84 a5
			23 00 00 00 00 00 02 85 01
			23 00 00 00 00 00 02 86 b5
			23 00 00 00 00 00 02 87 01
			23 00 00 00 00 00 02 88 d3
			23 00 00 00 00 00 02 89 01
			23 00 00 00 00 00 02 8a ef
			23 00 00 00 00 00 02 8b 02
			23 00 00 00 00 00 02 8c 1e
			23 00 00 00 00 00 02 8d 02
			23 00 00 00 00 00 02 8e 4c
			23 00 00 00 00 00 02 8f 02
			23 00 00 00 00 00 02 90 4d
			23 00 00 00 00 00 02 91 02
			23 00 00 00 00 00 02 92 7e
			23 00 00 00 00 00 02 93 02
			23 00 00 00 00 00 02 94 b9
			23 00 00 00 00 00 02 95 02
			23 00 00 00 00 00 02 96 e2
			23 00 00 00 00 00 02 97 03
			23 00 00 00 00 00 02 98 15
			23 00 00 00 00 00 02 99 03
			23 00 00 00 00 00 02 9a 39
			23 00 00 00 00 00 02 9b 03
			23 00 00 00 00 00 02 9c 62
			23 00 00 00 00 00 02 9d 03
			23 00 00 00 00 00 02 9e 6e
			23 00 00 00 00 00 02 9f 03
			23 00 00 00 00 00 02 a0 7b
			23 00 00 00 00 00 02 a2 03
			23 00 00 00 00 00 02 a3 88
			23 00 00 00 00 00 02 a4 03
			23 00 00 00 00 00 02 a5 97
			23 00 00 00 00 00 02 a6 03
			23 00 00 00 00 00 02 a7 a9
			23 00 00 00 00 00 02 a9 03
			23 00 00 00 00 00 02 aa bc
			23 00 00 00 00 00 02 ab 03
			23 00 00 00 00 00 02 ac cd
			23 00 00 00 00 00 02 ad 03
			23 00 00 00 00 00 02 ae cf
			23 00 00 00 00 00 02 af 01
			23 00 00 00 00 00 02 b0 70
			23 00 00 00 00 00 02 b1 01
			23 00 00 00 00 00 02 b2 73
			23 00 00 00 00 00 02 b3 01
			23 00 00 00 00 00 02 b4 78
			23 00 00 00 00 00 02 b5 01
			23 00 00 00 00 00 02 b6 7d
			23 00 00 00 00 00 02 b7 01
			23 00 00 00 00 00 02 b8 81
			23 00 00 00 00 00 02 b9 01
			23 00 00 00 00 00 02 ba 86
			23 00 00 00 00 00 02 bb 01
			23 00 00 00 00 00 02 bc 8b
			23 00 00 00 00 00 02 bd 01
			23 00 00 00 00 00 02 be 8f
			23 00 00 00 00 00 02 bf 01
			23 00 00 00 00 00 02 c0 94
			23 00 00 00 00 00 02 c1 01
			23 00 00 00 00 00 02 c2 a5
			23 00 00 00 00 00 02 c3 01
			23 00 00 00 00 00 02 c4 b5
			23 00 00 00 00 00 02 c5 01
			23 00 00 00 00 00 02 c6 d3
			23 00 00 00 00 00 02 c7 01
			23 00 00 00 00 00 02 c8 ef
			23 00 00 00 00 00 02 c9 02
			23 00 00 00 00 00 02 ca 1e
			23 00 00 00 00 00 02 cb 02
			23 00 00 00 00 00 02 cc 4c
			23 00 00 00 00 00 02 cd 02
			23 00 00 00 00 00 02 ce 4d
			23 00 00 00 00 00 02 cf 02
			23 00 00 00 00 00 02 d0 7e
			23 00 00 00 00 00 02 d1 02
			23 00 00 00 00 00 02 d2 b9
			23 00 00 00 00 00 02 d3 02
			23 00 00 00 00 00 02 d4 e2
			23 00 00 00 00 00 02 d5 03
			23 00 00 00 00 00 02 d6 15
			23 00 00 00 00 00 02 d7 03
			23 00 00 00 00 00 02 d8 39
			23 00 00 00 00 00 02 d9 03
			23 00 00 00 00 00 02 da 62
			23 00 00 00 00 00 02 db 03
			23 00 00 00 00 00 02 dc 6e
			23 00 00 00 00 00 02 dd 03
			23 00 00 00 00 00 02 de 7b
			23 00 00 00 00 00 02 df 03
			23 00 00 00 00 00 02 e0 88
			23 00 00 00 00 00 02 e1 03
			23 00 00 00 00 00 02 e2 97
			23 00 00 00 00 00 02 e3 03
			23 00 00 00 00 00 02 e4 a9
			23 00 00 00 00 00 02 e5 03
			23 00 00 00 00 00 02 e6 bc
			23 00 00 00 00 00 02 e7 03
			23 00 00 00 00 00 02 e8 cd
			23 00 00 00 00 00 02 e9 03
			23 01 00 00 00 00 02 ea cf
		];
		qcom,mdss-dsi-eyecare-level5-command = [
			23 00 00 00 00 00 02 ff 01
			23 00 00 00 00 00 02 fb 01
			23 00 00 00 00 00 02 75 00
			23 00 00 00 00 00 02 76 53
			23 00 00 00 00 00 02 77 00
			23 00 00 00 00 00 02 78 60
			23 00 00 00 00 00 02 79 00
			23 00 00 00 00 00 02 7a 77
			23 00 00 00 00 00 02 7b 00
			23 00 00 00 00 00 02 7c 8c
			23 00 00 00 00 00 02 7d 00
			23 00 00 00 00 00 02 7e 9e
			23 00 00 00 00 00 02 7f 00
			23 00 00 00 00 00 02 80 af
			23 00 00 00 00 00 02 81 00
			23 00 00 00 00 00 02 82 be
			23 00 00 00 00 00 02 83 00
			23 00 00 00 00 00 02 84 cd
			23 00 00 00 00 00 02 85 00
			23 00 00 00 00 00 02 86 da
			23 00 00 00 00 00 02 87 01
			23 00 00 00 00 00 02 88 08
			23 00 00 00 00 00 02 89 01
			23 00 00 00 00 00 02 8a 2d
			23 00 00 00 00 00 02 8b 01
			23 00 00 00 00 00 02 8c 69
			23 00 00 00 00 00 02 8d 01
			23 00 00 00 00 00 02 8e 99
			23 00 00 00 00 00 02 8f 01
			23 00 00 00 00 00 02 90 e4
			23 00 00 00 00 00 02 91 02
			23 00 00 00 00 00 02 92 20
			23 00 00 00 00 00 02 93 02
			23 00 00 00 00 00 02 94 21
			23 00 00 00 00 00 02 95 02
			23 00 00 00 00 00 02 96 5a
			23 00 00 00 00 00 02 97 02
			23 00 00 00 00 00 02 98 9a
			23 00 00 00 00 00 02 99 02
			23 00 00 00 00 00 02 9a c4
			23 00 00 00 00 00 02 9b 02
			23 00 00 00 00 00 02 9c fc
			23 00 00 00 00 00 02 9d 03
			23 00 00 00 00 00 02 9e 22
			23 00 00 00 00 00 02 9f 03
			23 00 00 00 00 00 02 a0 50
			23 00 00 00 00 00 02 a2 03
			23 00 00 00 00 00 02 a3 5e
			23 00 00 00 00 00 02 a4 03
			23 00 00 00 00 00 02 a5 6d
			23 00 00 00 00 00 02 a6 03
			23 00 00 00 00 00 02 a7 7e
			23 00 00 00 00 00 02 a9 03
			23 00 00 00 00 00 02 aa 91
			23 00 00 00 00 00 02 ab 03
			23 00 00 00 00 00 02 ac a8
			23 00 00 00 00 00 02 ad 03
			23 00 00 00 00 00 02 ae c0
			23 00 00 00 00 00 02 af 03
			23 00 00 00 00 00 02 b0 ce
			23 00 00 00 00 00 02 b1 03
			23 00 00 00 00 00 02 b2 cf
			23 00 00 00 00 00 02 b3 00
			23 00 00 00 00 00 02 b4 53
			23 00 00 00 00 00 02 b5 00
			23 00 00 00 00 00 02 b6 60
			23 00 00 00 00 00 02 b7 00
			23 00 00 00 00 00 02 b8 77
			23 00 00 00 00 00 02 b9 00
			23 00 00 00 00 00 02 ba 8c
			23 00 00 00 00 00 02 bb 00
			23 00 00 00 00 00 02 bc 9e
			23 00 00 00 00 00 02 bd 00
			23 00 00 00 00 00 02 be af
			23 00 00 00 00 00 02 bf 00
			23 00 00 00 00 00 02 c0 be
			23 00 00 00 00 00 02 c1 00
			23 00 00 00 00 00 02 c2 cd
			23 00 00 00 00 00 02 c3 00
			23 00 00 00 00 00 02 c4 da
			23 00 00 00 00 00 02 c5 01
			23 00 00 00 00 00 02 c6 08
			23 00 00 00 00 00 02 c7 01
			23 00 00 00 00 00 02 c8 2d
			23 00 00 00 00 00 02 c9 01
			23 00 00 00 00 00 02 ca 69
			23 00 00 00 00 00 02 cb 01
			23 00 00 00 00 00 02 cc 99
			23 00 00 00 00 00 02 cd 01
			23 00 00 00 00 00 02 ce e4
			23 00 00 00 00 00 02 cf 02
			23 00 00 00 00 00 02 d0 20
			23 00 00 00 00 00 02 d1 02
			23 00 00 00 00 00 02 d2 21
			23 00 00 00 00 00 02 d3 02
			23 00 00 00 00 00 02 d4 5a
			23 00 00 00 00 00 02 d5 02
			23 00 00 00 00 00 02 d6 9a
			23 00 00 00 00 00 02 d7 02
			23 00 00 00 00 00 02 d8 c4
			23 00 00 00 00 00 02 d9 02
			23 00 00 00 00 00 02 da fc
			23 00 00 00 00 00 02 db 03
			23 00 00 00 00 00 02 dc 22
			23 00 00 00 00 00 02 dd 03
			23 00 00 00 00 00 02 de 50
			23 00 00 00 00 00 02 df 03
			23 00 00 00 00 00 02 e0 5e
			23 00 00 00 00 00 02 e1 03
			23 00 00 00 00 00 02 e2 6d
			23 00 00 00 00 00 02 e3 03
			23 00 00 00 00 00 02 e4 7e
			23 00 00 00 00 00 02 e5 03
			23 00 00 00 00 00 02 e6 91
			23 00 00 00 00 00 02 e7 03
			23 00 00 00 00 00 02 e8 a8
			23 00 00 00 00 00 02 e9 03
			23 00 00 00 00 00 02 ea c0
			23 00 00 00 00 00 02 eb 03
			23 00 00 00 00 00 02 ec ce
			23 00 00 00 00 00 02 ed 03
			23 01 00 00 00 00 02 ee cf
			23 00 00 00 00 00 02 ef 00
			23 00 00 00 00 00 02 f0 00
			23 00 00 00 00 00 02 f1 00
			23 00 00 00 00 00 02 f2 1d
			23 00 00 00 00 00 02 f3 00
			23 00 00 00 00 00 02 f4 44
			23 00 00 00 00 00 02 f5 00
			23 00 00 00 00 00 02 f6 61
			23 00 00 00 00 00 02 f7 00
			23 00 00 00 00 00 02 f8 78
			23 00 00 00 00 00 02 f9 00
			23 00 00 00 00 00 02 fa 8d
			23 00 00 00 00 00 02 ff 02
			23 00 00 00 00 00 02 fb 01
			23 00 00 00 00 00 02 00 00
			23 00 00 00 00 00 02 01 9f
			23 00 00 00 00 00 02 02 00
			23 00 00 00 00 00 02 03 b0
			23 00 00 00 00 00 02 04 00
			23 00 00 00 00 00 02 05 bf
			23 00 00 00 00 00 02 06 00
			23 00 00 00 00 00 02 07 f3
			23 00 00 00 00 00 02 08 01
			23 00 00 00 00 00 02 09 1c
			23 00 00 00 00 00 02 0a 01
			23 00 00 00 00 00 02 0b 5d
			23 00 00 00 00 00 02 0c 01
			23 00 00 00 00 00 02 0d 8f
			23 00 00 00 00 00 02 0e 01
			23 00 00 00 00 00 02 0f df
			23 00 00 00 00 00 02 10 02
			23 00 00 00 00 00 02 11 1c
			23 00 00 00 00 00 02 12 02
			23 00 00 00 00 00 02 13 1e
			23 00 00 00 00 00 02 14 02
			23 00 00 00 00 00 02 15 58
			23 00 00 00 00 00 02 16 02
			23 00 00 00 00 00 02 17 99
			23 00 00 00 00 00 02 18 02
			23 00 00 00 00 00 02 19 c3
			23 00 00 00 00 00 02 1a 02
			23 00 00 00 00 00 02 1b fc
			23 00 00 00 00 00 02 1c 03
			23 00 00 00 00 00 02 1d 21
			23 00 00 00 00 00 02 1e 03
			23 00 00 00 00 00 02 1f 4f
			23 00 00 00 00 00 02 20 03
			23 00 00 00 00 00 02 21 5c
			23 00 00 00 00 00 02 22 03
			23 00 00 00 00 00 02 23 6b
			23 00 00 00 00 00 02 24 03
			23 00 00 00 00 00 02 25 7c
			23 00 00 00 00 00 02 26 03
			23 00 00 00 00 00 02 27 8f
			23 00 00 00 00 00 02 28 03
			23 00 00 00 00 00 02 29 a5
			23 00 00 00 00 00 02 2a 03
			23 00 00 00 00 00 02 2b be
			23 00 00 00 00 00 02 2d 03
			23 00 00 00 00 00 02 2f cd
			23 00 00 00 00 00 02 30 03
			23 00 00 00 00 00 02 31 cf
			23 00 00 00 00 00 02 32 00
			23 00 00 00 00 00 02 33 00
			23 00 00 00 00 00 02 34 00
			23 00 00 00 00 00 02 35 1d
			23 00 00 00 00 00 02 36 00
			23 00 00 00 00 00 02 37 44
			23 00 00 00 00 00 02 38 00
			23 00 00 00 00 00 02 39 61
			23 00 00 00 00 00 02 3a 00
			23 00 00 00 00 00 02 3b 78
			23 00 00 00 00 00 02 3d 00
			23 00 00 00 00 00 02 3f 8d
			23 00 00 00 00 00 02 40 00
			23 00 00 00 00 00 02 41 9f
			23 00 00 00 00 00 02 42 00
			23 00 00 00 00 00 02 43 b0
			23 00 00 00 00 00 02 44 00
			23 00 00 00 00 00 02 45 bf
			23 00 00 00 00 00 02 46 00
			23 00 00 00 00 00 02 47 f3
			23 00 00 00 00 00 02 48 01
			23 00 00 00 00 00 02 49 1c
			23 00 00 00 00 00 02 4a 01
			23 00 00 00 00 00 02 4b 5d
			23 00 00 00 00 00 02 4c 01
			23 00 00 00 00 00 02 4d 8f
			23 00 00 00 00 00 02 4e 01
			23 00 00 00 00 00 02 4f df
			23 00 00 00 00 00 02 50 02
			23 00 00 00 00 00 02 51 1c
			23 00 00 00 00 00 02 52 02
			23 00 00 00 00 00 02 53 1e
			23 00 00 00 00 00 02 54 02
			23 00 00 00 00 00 02 55 58
			23 00 00 00 00 00 02 56 02
			23 00 00 00 00 00 02 58 99
			23 00 00 00 00 00 02 59 02
			23 00 00 00 00 00 02 5a c3
			23 00 00 00 00 00 02 5b 02
			23 00 00 00 00 00 02 5c fc
			23 00 00 00 00 00 02 5d 03
			23 00 00 00 00 00 02 5e 21
			23 00 00 00 00 00 02 5f 03
			23 00 00 00 00 00 02 60 4f
			23 00 00 00 00 00 02 61 03
			23 00 00 00 00 00 02 62 5c
			23 00 00 00 00 00 02 63 03
			23 00 00 00 00 00 02 64 6b
			23 00 00 00 00 00 02 65 03
			23 00 00 00 00 00 02 66 7c
			23 00 00 00 00 00 02 67 03
			23 00 00 00 00 00 02 68 8f
			23 00 00 00 00 00 02 69 03
			23 00 00 00 00 00 02 6a a5
			23 00 00 00 00 00 02 6b 03
			23 00 00 00 00 00 02 6c be
			23 00 00 00 00 00 02 6d 03
			23 00 00 00 00 00 02 6e cd
			23 00 00 00 00 00 02 6f 03
			23 01 00 00 00 00 02 70 cf
			23 00 00 00 00 00 02 71 01
			23 00 00 00 00 00 02 72 96
			23 00 00 00 00 00 02 73 01
			23 00 00 00 00 00 02 74 98
			23 00 00 00 00 00 02 75 01
			23 00 00 00 00 00 02 76 9c
			23 00 00 00 00 00 02 77 01
			23 00 00 00 00 00 02 78 a0
			23 00 00 00 00 00 02 79 01
			23 00 00 00 00 00 02 7a a4
			23 00 00 00 00 00 02 7b 01
			23 00 00 00 00 00 02 7c a8
			23 00 00 00 00 00 02 7d 01
			23 00 00 00 00 00 02 7e ac
			23 00 00 00 00 00 02 7f 01
			23 00 00 00 00 00 02 80 b0
			23 00 00 00 00 00 02 81 01
			23 00 00 00 00 00 02 82 b3
			23 00 00 00 00 00 02 83 01
			23 00 00 00 00 00 02 84 c2
			23 00 00 00 00 00 02 85 01
			23 00 00 00 00 00 02 86 d0
			23 00 00 00 00 00 02 87 01
			23 00 00 00 00 00 02 88 ea
			23 00 00 00 00 00 02 89 02
			23 00 00 00 00 00 02 8a 01
			23 00 00 00 00 00 02 8b 02
			23 00 00 00 00 00 02 8c 2c
			23 00 00 00 00 00 02 8d 02
			23 00 00 00 00 00 02 8e 57
			23 00 00 00 00 00 02 8f 02
			23 00 00 00 00 00 02 90 59
			23 00 00 00 00 00 02 91 02
			23 00 00 00 00 00 02 92 87
			23 00 00 00 00 00 02 93 02
			23 00 00 00 00 00 02 94 c2
			23 00 00 00 00 00 02 95 02
			23 00 00 00 00 00 02 96 ea
			23 00 00 00 00 00 02 97 03
			23 00 00 00 00 00 02 98 1d
			23 00 00 00 00 00 02 99 03
			23 00 00 00 00 00 02 9a 40
			23 00 00 00 00 00 02 9b 03
			23 00 00 00 00 00 02 9c 68
			23 00 00 00 00 00 02 9d 03
			23 00 00 00 00 00 02 9e 73
			23 00 00 00 00 00 02 9f 03
			23 00 00 00 00 00 02 a0 7f
			23 00 00 00 00 00 02 a2 03
			23 00 00 00 00 00 02 a3 8c
			23 00 00 00 00 00 02 a4 03
			23 00 00 00 00 00 02 a5 9b
			23 00 00 00 00 00 02 a6 03
			23 00 00 00 00 00 02 a7 ac
			23 00 00 00 00 00 02 a9 03
			23 00 00 00 00 00 02 aa be
			23 00 00 00 00 00 02 ab 03
			23 00 00 00 00 00 02 ac cd
			23 00 00 00 00 00 02 ad 03
			23 00 00 00 00 00 02 ae cf
			23 00 00 00 00 00 02 af 01
			23 00 00 00 00 00 02 b0 96
			23 00 00 00 00 00 02 b1 01
			23 00 00 00 00 00 02 b2 98
			23 00 00 00 00 00 02 b3 01
			23 00 00 00 00 00 02 b4 9c
			23 00 00 00 00 00 02 b5 01
			23 00 00 00 00 00 02 b6 a0
			23 00 00 00 00 00 02 b7 01
			23 00 00 00 00 00 02 b8 a4
			23 00 00 00 00 00 02 b9 01
			23 00 00 00 00 00 02 ba a8
			23 00 00 00 00 00 02 bb 01
			23 00 00 00 00 00 02 bc ac
			23 00 00 00 00 00 02 bd 01
			23 00 00 00 00 00 02 be b0
			23 00 00 00 00 00 02 bf 01
			23 00 00 00 00 00 02 c0 b3
			23 00 00 00 00 00 02 c1 01
			23 00 00 00 00 00 02 c2 c2
			23 00 00 00 00 00 02 c3 01
			23 00 00 00 00 00 02 c4 d0
			23 00 00 00 00 00 02 c5 01
			23 00 00 00 00 00 02 c6 ea
			23 00 00 00 00 00 02 c7 02
			23 00 00 00 00 00 02 c8 01
			23 00 00 00 00 00 02 c9 02
			23 00 00 00 00 00 02 ca 2c
			23 00 00 00 00 00 02 cb 02
			23 00 00 00 00 00 02 cc 57
			23 00 00 00 00 00 02 cd 02
			23 00 00 00 00 00 02 ce 59
			23 00 00 00 00 00 02 cf 02
			23 00 00 00 00 00 02 d0 87
			23 00 00 00 00 00 02 d1 02
			23 00 00 00 00 00 02 d2 c2
			23 00 00 00 00 00 02 d3 02
			23 00 00 00 00 00 02 d4 ea
			23 00 00 00 00 00 02 d5 03
			23 00 00 00 00 00 02 d6 1d
			23 00 00 00 00 00 02 d7 03
			23 00 00 00 00 00 02 d8 40
			23 00 00 00 00 00 02 d9 03
			23 00 00 00 00 00 02 da 68
			23 00 00 00 00 00 02 db 03
			23 00 00 00 00 00 02 dc 73
			23 00 00 00 00 00 02 dd 03
			23 00 00 00 00 00 02 de 7f
			23 00 00 00 00 00 02 df 03
			23 00 00 00 00 00 02 e0 8c
			23 00 00 00 00 00 02 e1 03
			23 00 00 00 00 00 02 e2 9b
			23 00 00 00 00 00 02 e3 03
			23 00 00 00 00 00 02 e4 ac
			23 00 00 00 00 00 02 e5 03
			23 00 00 00 00 00 02 e6 be
			23 00 00 00 00 00 02 e7 03
			23 00 00 00 00 00 02 e8 cd
			23 00 00 00 00 00 02 e9 03
			23 01 00 00 00 00 02 ea cf
		];
		qcom,mdss-dsi-eyecare-level6-command = [
			23 00 00 00 00 00 02 ff 01
			23 00 00 00 00 00 02 fb 01
			23 00 00 00 00 00 02 75 00
			23 00 00 00 00 00 02 76 64
			23 00 00 00 00 00 02 77 00
			23 00 00 00 00 00 02 78 70
			23 00 00 00 00 00 02 79 00
			23 00 00 00 00 00 02 7a 85
			23 00 00 00 00 00 02 7b 00
			23 00 00 00 00 00 02 7c 98
			23 00 00 00 00 00 02 7d 00
			23 00 00 00 00 00 02 7e a9
			23 00 00 00 00 00 02 7f 00
			23 00 00 00 00 00 02 80 b9
			23 00 00 00 00 00 02 81 00
			23 00 00 00 00 00 02 82 c7
			23 00 00 00 00 00 02 83 00
			23 00 00 00 00 00 02 84 d5
			23 00 00 00 00 00 02 85 00
			23 00 00 00 00 00 02 86 e2
			23 00 00 00 00 00 02 87 01
			23 00 00 00 00 00 02 88 0e
			23 00 00 00 00 00 02 89 01
			23 00 00 00 00 00 02 8a 32
			23 00 00 00 00 00 02 8b 01
			23 00 00 00 00 00 02 8c 6d
			23 00 00 00 00 00 02 8d 01
			23 00 00 00 00 00 02 8e 9b
			23 00 00 00 00 00 02 8f 01
			23 00 00 00 00 00 02 90 e5
			23 00 00 00 00 00 02 91 02
			23 00 00 00 00 00 02 92 21
			23 00 00 00 00 00 02 93 02
			23 00 00 00 00 00 02 94 23
			23 00 00 00 00 00 02 95 02
			23 00 00 00 00 00 02 96 5b
			23 00 00 00 00 00 02 97 02
			23 00 00 00 00 00 02 98 9b
			23 00 00 00 00 00 02 99 02
			23 00 00 00 00 00 02 9a c4
			23 00 00 00 00 00 02 9b 02
			23 00 00 00 00 00 02 9c fd
			23 00 00 00 00 00 02 9d 03
			23 00 00 00 00 00 02 9e 23
			23 00 00 00 00 00 02 9f 03
			23 00 00 00 00 00 02 a0 51
			23 00 00 00 00 00 02 a2 03
			23 00 00 00 00 00 02 a3 5e
			23 00 00 00 00 00 02 a4 03
			23 00 00 00 00 00 02 a5 6d
			23 00 00 00 00 00 02 a6 03
			23 00 00 00 00 00 02 a7 7e
			23 00 00 00 00 00 02 a9 03
			23 00 00 00 00 00 02 aa 92
			23 00 00 00 00 00 02 ab 03
			23 00 00 00 00 00 02 ac a9
			23 00 00 00 00 00 02 ad 03
			23 00 00 00 00 00 02 ae c0
			23 00 00 00 00 00 02 af 03
			23 00 00 00 00 00 02 b0 ce
			23 00 00 00 00 00 02 b1 03
			23 00 00 00 00 00 02 b2 cf
			23 00 00 00 00 00 02 b3 00
			23 00 00 00 00 00 02 b4 64
			23 00 00 00 00 00 02 b5 00
			23 00 00 00 00 00 02 b6 70
			23 00 00 00 00 00 02 b7 00
			23 00 00 00 00 00 02 b8 85
			23 00 00 00 00 00 02 b9 00
			23 00 00 00 00 00 02 ba 98
			23 00 00 00 00 00 02 bb 00
			23 00 00 00 00 00 02 bc a9
			23 00 00 00 00 00 02 bd 00
			23 00 00 00 00 00 02 be b9
			23 00 00 00 00 00 02 bf 00
			23 00 00 00 00 00 02 c0 c7
			23 00 00 00 00 00 02 c1 00
			23 00 00 00 00 00 02 c2 d5
			23 00 00 00 00 00 02 c3 00
			23 00 00 00 00 00 02 c4 e2
			23 00 00 00 00 00 02 c5 01
			23 00 00 00 00 00 02 c6 0e
			23 00 00 00 00 00 02 c7 01
			23 00 00 00 00 00 02 c8 32
			23 00 00 00 00 00 02 c9 01
			23 00 00 00 00 00 02 ca 6d
			23 00 00 00 00 00 02 cb 01
			23 00 00 00 00 00 02 cc 9b
			23 00 00 00 00 00 02 cd 01
			23 00 00 00 00 00 02 ce e5
			23 00 00 00 00 00 02 cf 02
			23 00 00 00 00 00 02 d0 21
			23 00 00 00 00 00 02 d1 02
			23 00 00 00 00 00 02 d2 23
			23 00 00 00 00 00 02 d3 02
			23 00 00 00 00 00 02 d4 5b
			23 00 00 00 00 00 02 d5 02
			23 00 00 00 00 00 02 d6 9b
			23 00 00 00 00 00 02 d7 02
			23 00 00 00 00 00 02 d8 c4
			23 00 00 00 00 00 02 d9 02
			23 00 00 00 00 00 02 da fd
			23 00 00 00 00 00 02 db 03
			23 00 00 00 00 00 02 dc 23
			23 00 00 00 00 00 02 dd 03
			23 00 00 00 00 00 02 de 51
			23 00 00 00 00 00 02 df 03
			23 00 00 00 00 00 02 e0 5e
			23 00 00 00 00 00 02 e1 03
			23 00 00 00 00 00 02 e2 6d
			23 00 00 00 00 00 02 e3 03
			23 00 00 00 00 00 02 e4 7e
			23 00 00 00 00 00 02 e5 03
			23 00 00 00 00 00 02 e6 92
			23 00 00 00 00 00 02 e7 03
			23 00 00 00 00 00 02 e8 a9
			23 00 00 00 00 00 02 e9 03
			23 00 00 00 00 00 02 ea c0
			23 00 00 00 00 00 02 eb 03
			23 00 00 00 00 00 02 ec ce
			23 00 00 00 00 00 02 ed 03
			23 01 00 00 00 00 02 ee cf
			23 00 00 00 00 00 02 ef 00
			23 00 00 00 00 00 02 f0 00
			23 00 00 00 00 00 02 f1 00
			23 00 00 00 00 00 02 f2 1d
			23 00 00 00 00 00 02 f3 00
			23 00 00 00 00 00 02 f4 44
			23 00 00 00 00 00 02 f5 00
			23 00 00 00 00 00 02 f6 61
			23 00 00 00 00 00 02 f7 00
			23 00 00 00 00 00 02 f8 78
			23 00 00 00 00 00 02 f9 00
			23 00 00 00 00 00 02 fa 8d
			23 00 00 00 00 00 02 ff 02
			23 00 00 00 00 00 02 fb 01
			23 00 00 00 00 00 02 00 00
			23 00 00 00 00 00 02 01 9f
			23 00 00 00 00 00 02 02 00
			23 00 00 00 00 00 02 03 b0
			23 00 00 00 00 00 02 04 00
			23 00 00 00 00 00 02 05 bf
			23 00 00 00 00 00 02 06 00
			23 00 00 00 00 00 02 07 f3
			23 00 00 00 00 00 02 08 01
			23 00 00 00 00 00 02 09 1c
			23 00 00 00 00 00 02 0a 01
			23 00 00 00 00 00 02 0b 5d
			23 00 00 00 00 00 02 0c 01
			23 00 00 00 00 00 02 0d 8f
			23 00 00 00 00 00 02 0e 01
			23 00 00 00 00 00 02 0f df
			23 00 00 00 00 00 02 10 02
			23 00 00 00 00 00 02 11 1c
			23 00 00 00 00 00 02 12 02
			23 00 00 00 00 00 02 13 1e
			23 00 00 00 00 00 02 14 02
			23 00 00 00 00 00 02 15 58
			23 00 00 00 00 00 02 16 02
			23 00 00 00 00 00 02 17 99
			23 00 00 00 00 00 02 18 02
			23 00 00 00 00 00 02 19 c3
			23 00 00 00 00 00 02 1a 02
			23 00 00 00 00 00 02 1b fc
			23 00 00 00 00 00 02 1c 03
			23 00 00 00 00 00 02 1d 21
			23 00 00 00 00 00 02 1e 03
			23 00 00 00 00 00 02 1f 4f
			23 00 00 00 00 00 02 20 03
			23 00 00 00 00 00 02 21 5c
			23 00 00 00 00 00 02 22 03
			23 00 00 00 00 00 02 23 6b
			23 00 00 00 00 00 02 24 03
			23 00 00 00 00 00 02 25 7c
			23 00 00 00 00 00 02 26 03
			23 00 00 00 00 00 02 27 8f
			23 00 00 00 00 00 02 28 03
			23 00 00 00 00 00 02 29 a5
			23 00 00 00 00 00 02 2a 03
			23 00 00 00 00 00 02 2b be
			23 00 00 00 00 00 02 2d 03
			23 00 00 00 00 00 02 2f cd
			23 00 00 00 00 00 02 30 03
			23 00 00 00 00 00 02 31 cf
			23 00 00 00 00 00 02 32 00
			23 00 00 00 00 00 02 33 00
			23 00 00 00 00 00 02 34 00
			23 00 00 00 00 00 02 35 1d
			23 00 00 00 00 00 02 36 00
			23 00 00 00 00 00 02 37 44
			23 00 00 00 00 00 02 38 00
			23 00 00 00 00 00 02 39 61
			23 00 00 00 00 00 02 3a 00
			23 00 00 00 00 00 02 3b 78
			23 00 00 00 00 00 02 3d 00
			23 00 00 00 00 00 02 3f 8d
			23 00 00 00 00 00 02 40 00
			23 00 00 00 00 00 02 41 9f
			23 00 00 00 00 00 02 42 00
			23 00 00 00 00 00 02 43 b0
			23 00 00 00 00 00 02 44 00
			23 00 00 00 00 00 02 45 bf
			23 00 00 00 00 00 02 46 00
			23 00 00 00 00 00 02 47 f3
			23 00 00 00 00 00 02 48 01
			23 00 00 00 00 00 02 49 1c
			23 00 00 00 00 00 02 4a 01
			23 00 00 00 00 00 02 4b 5d
			23 00 00 00 00 00 02 4c 01
			23 00 00 00 00 00 02 4d 8f
			23 00 00 00 00 00 02 4e 01
			23 00 00 00 00 00 02 4f df
			23 00 00 00 00 00 02 50 02
			23 00 00 00 00 00 02 51 1c
			23 00 00 00 00 00 02 52 02
			23 00 00 00 00 00 02 53 1e
			23 00 00 00 00 00 02 54 02
			23 00 00 00 00 00 02 55 58
			23 00 00 00 00 00 02 56 02
			23 00 00 00 00 00 02 58 99
			23 00 00 00 00 00 02 59 02
			23 00 00 00 00 00 02 5a c3
			23 00 00 00 00 00 02 5b 02
			23 00 00 00 00 00 02 5c fc
			23 00 00 00 00 00 02 5d 03
			23 00 00 00 00 00 02 5e 21
			23 00 00 00 00 00 02 5f 03
			23 00 00 00 00 00 02 60 4f
			23 00 00 00 00 00 02 61 03
			23 00 00 00 00 00 02 62 5c
			23 00 00 00 00 00 02 63 03
			23 00 00 00 00 00 02 64 6b
			23 00 00 00 00 00 02 65 03
			23 00 00 00 00 00 02 66 7c
			23 00 00 00 00 00 02 67 03
			23 00 00 00 00 00 02 68 8f
			23 00 00 00 00 00 02 69 03
			23 00 00 00 00 00 02 6a a5
			23 00 00 00 00 00 02 6b 03
			23 00 00 00 00 00 02 6c be
			23 00 00 00 00 00 02 6d 03
			23 00 00 00 00 00 02 6e cd
			23 00 00 00 00 00 02 6f 03
			23 01 00 00 00 00 02 70 cf
			23 00 00 00 00 00 02 71 01
			23 00 00 00 00 00 02 72 b8
			23 00 00 00 00 00 02 73 01
			23 00 00 00 00 00 02 74 ba
			23 00 00 00 00 00 02 75 01
			23 00 00 00 00 00 02 76 bd
			23 00 00 00 00 00 02 77 01
			23 00 00 00 00 00 02 78 c0
			23 00 00 00 00 00 02 79 01
			23 00 00 00 00 00 02 7a c4
			23 00 00 00 00 00 02 7b 01
			23 00 00 00 00 00 02 7c c7
			23 00 00 00 00 00 02 7d 01
			23 00 00 00 00 00 02 7e ca
			23 00 00 00 00 00 02 7f 01
			23 00 00 00 00 00 02 80 cd
			23 00 00 00 00 00 02 81 01
			23 00 00 00 00 00 02 82 d1
			23 00 00 00 00 00 02 83 01
			23 00 00 00 00 00 02 84 dd
			23 00 00 00 00 00 02 85 01
			23 00 00 00 00 00 02 86 e9
			23 00 00 00 00 00 02 87 01
			23 00 00 00 00 00 02 88 fe
			23 00 00 00 00 00 02 89 02
			23 00 00 00 00 00 02 8a 13
			23 00 00 00 00 00 02 8b 02
			23 00 00 00 00 00 02 8c 3b
			23 00 00 00 00 00 02 8d 02
			23 00 00 00 00 00 02 8e 64
			23 00 00 00 00 00 02 8f 02
			23 00 00 00 00 00 02 90 65
			23 00 00 00 00 00 02 91 02
			23 00 00 00 00 00 02 92 92
			23 00 00 00 00 00 02 93 02
			23 00 00 00 00 00 02 94 cc
			23 00 00 00 00 00 02 95 02
			23 00 00 00 00 00 02 96 f3
			23 00 00 00 00 00 02 97 03
			23 00 00 00 00 00 02 98 27
			23 00 00 00 00 00 02 99 03
			23 00 00 00 00 00 02 9a 47
			23 00 00 00 00 00 02 9b 03
			23 00 00 00 00 00 02 9c 6d
			23 00 00 00 00 00 02 9d 03
			23 00 00 00 00 00 02 9e 78
			23 00 00 00 00 00 02 9f 03
			23 00 00 00 00 00 02 a0 84
			23 00 00 00 00 00 02 a2 03
			23 00 00 00 00 00 02 a3 91
			23 00 00 00 00 00 02 a4 03
			23 00 00 00 00 00 02 a5 9f
			23 00 00 00 00 00 02 a6 03
			23 00 00 00 00 00 02 a7 af
			23 00 00 00 00 00 02 a9 03
			23 00 00 00 00 00 02 aa c0
			23 00 00 00 00 00 02 ab 03
			23 00 00 00 00 00 02 ac ce
			23 00 00 00 00 00 02 ad 03
			23 00 00 00 00 00 02 ae cf
			23 00 00 00 00 00 02 af 01
			23 00 00 00 00 00 02 b0 b8
			23 00 00 00 00 00 02 b1 01
			23 00 00 00 00 00 02 b2 ba
			23 00 00 00 00 00 02 b3 01
			23 00 00 00 00 00 02 b4 bd
			23 00 00 00 00 00 02 b5 01
			23 00 00 00 00 00 02 b6 c0
			23 00 00 00 00 00 02 b7 01
			23 00 00 00 00 00 02 b8 c4
			23 00 00 00 00 00 02 b9 01
			23 00 00 00 00 00 02 ba c7
			23 00 00 00 00 00 02 bb 01
			23 00 00 00 00 00 02 bc ca
			23 00 00 00 00 00 02 bd 01
			23 00 00 00 00 00 02 be cd
			23 00 00 00 00 00 02 bf 01
			23 00 00 00 00 00 02 c0 d1
			23 00 00 00 00 00 02 c1 01
			23 00 00 00 00 00 02 c2 dd
			23 00 00 00 00 00 02 c3 01
			23 00 00 00 00 00 02 c4 e9
			23 00 00 00 00 00 02 c5 01
			23 00 00 00 00 00 02 c6 fe
			23 00 00 00 00 00 02 c7 02
			23 00 00 00 00 00 02 c8 13
			23 00 00 00 00 00 02 c9 02
			23 00 00 00 00 00 02 ca 3b
			23 00 00 00 00 00 02 cb 02
			23 00 00 00 00 00 02 cc 64
			23 00 00 00 00 00 02 cd 02
			23 00 00 00 00 00 02 ce 65
			23 00 00 00 00 00 02 cf 02
			23 00 00 00 00 00 02 d0 92
			23 00 00 00 00 00 02 d1 02
			23 00 00 00 00 00 02 d2 cc
			23 00 00 00 00 00 02 d3 02
			23 00 00 00 00 00 02 d4 f3
			23 00 00 00 00 00 02 d5 03
			23 00 00 00 00 00 02 d6 27
			23 00 00 00 00 00 02 d7 03
			23 00 00 00 00 00 02 d8 47
			23 00 00 00 00 00 02 d9 03
			23 00 00 00 00 00 02 da 6d
			23 00 00 00 00 00 02 db 03
			23 00 00 00 00 00 02 dc 78
			23 00 00 00 00 00 02 dd 03
			23 00 00 00 00 00 02 de 84
			23 00 00 00 00 00 02 df 03
			23 00 00 00 00 00 02 e0 91
			23 00 00 00 00 00 02 e1 03
			23 00 00 00 00 00 02 e2 9f
			23 00 00 00 00 00 02 e3 03
			23 00 00 00 00 00 02 e4 af
			23 00 00 00 00 00 02 e5 03
			23 00 00 00 00 00 02 e6 c0
			23 00 00 00 00 00 02 e7 03
			23 00 00 00 00 00 02 e8 ce
			23 00 00 00 00 00 02 e9 03
			23 01 00 00 00 00 02 ea cf
		];
		qcom,mdss-dsi-eyecare-level7-command = [
			23 00 00 00 00 00 02 ff 01
			23 00 00 00 00 00 02 fb 01
			23 00 00 00 00 00 02 75 00
			23 00 00 00 00 00 02 76 75
			23 00 00 00 00 00 02 77 00
			23 00 00 00 00 00 02 78 80
			23 00 00 00 00 00 02 79 00
			23 00 00 00 00 00 02 7a 93
			23 00 00 00 00 00 02 7b 00
			23 00 00 00 00 00 02 7c a4
			23 00 00 00 00 00 02 7d 00
			23 00 00 00 00 00 02 7e b4
			23 00 00 00 00 00 02 7f 00
			23 00 00 00 00 00 02 80 c3
			23 00 00 00 00 00 02 81 00
			23 00 00 00 00 00 02 82 d1
			23 00 00 00 00 00 02 83 00
			23 00 00 00 00 00 02 84 de
			23 00 00 00 00 00 02 85 00
			23 00 00 00 00 00 02 86 ea
			23 00 00 00 00 00 02 87 01
			23 00 00 00 00 00 02 88 14
			23 00 00 00 00 00 02 89 01
			23 00 00 00 00 00 02 8a 38
			23 00 00 00 00 00 02 8b 01
			23 00 00 00 00 00 02 8c 70
			23 00 00 00 00 00 02 8d 01
			23 00 00 00 00 00 02 8e 9e
			23 00 00 00 00 00 02 8f 01
			23 00 00 00 00 00 02 90 e7
			23 00 00 00 00 00 02 91 02
			23 00 00 00 00 00 02 92 22
			23 00 00 00 00 00 02 93 02
			23 00 00 00 00 00 02 94 24
			23 00 00 00 00 00 02 95 02
			23 00 00 00 00 00 02 96 5c
			23 00 00 00 00 00 02 97 02
			23 00 00 00 00 00 02 98 9c
			23 00 00 00 00 00 02 99 02
			23 00 00 00 00 00 02 9a c5
			23 00 00 00 00 00 02 9b 02
			23 00 00 00 00 00 02 9c fe
			23 00 00 00 00 00 02 9d 03
			23 00 00 00 00 00 02 9e 23
			23 00 00 00 00 00 02 9f 03
			23 00 00 00 00 00 02 a0 51
			23 00 00 00 00 00 02 a2 03
			23 00 00 00 00 00 02 a3 5f
			23 00 00 00 00 00 02 a4 03
			23 00 00 00 00 00 02 a5 6e
			23 00 00 00 00 00 02 a6 03
			23 00 00 00 00 00 02 a7 7f
			23 00 00 00 00 00 02 a9 03
			23 00 00 00 00 00 02 aa 92
			23 00 00 00 00 00 02 ab 03
			23 00 00 00 00 00 02 ac a9
			23 00 00 00 00 00 02 ad 03
			23 00 00 00 00 00 02 ae c0
			23 00 00 00 00 00 02 af 03
			23 00 00 00 00 00 02 b0 ce
			23 00 00 00 00 00 02 b1 03
			23 00 00 00 00 00 02 b2 cf
			23 00 00 00 00 00 02 b3 00
			23 00 00 00 00 00 02 b4 75
			23 00 00 00 00 00 02 b5 00
			23 00 00 00 00 00 02 b6 80
			23 00 00 00 00 00 02 b7 00
			23 00 00 00 00 00 02 b8 93
			23 00 00 00 00 00 02 b9 00
			23 00 00 00 00 00 02 ba a4
			23 00 00 00 00 00 02 bb 00
			23 00 00 00 00 00 02 bc b4
			23 00 00 00 00 00 02 bd 00
			23 00 00 00 00 00 02 be c3
			23 00 00 00 00 00 02 bf 00
			23 00 00 00 00 00 02 c0 d1
			23 00 00 00 00 00 02 c1 00
			23 00 00 00 00 00 02 c2 de
			23 00 00 00 00 00 02 c3 00
			23 00 00 00 00 00 02 c4 ea
			23 00 00 00 00 00 02 c5 01
			23 00 00 00 00 00 02 c6 14
			23 00 00 00 00 00 02 c7 01
			23 00 00 00 00 00 02 c8 38
			23 00 00 00 00 00 02 c9 01
			23 00 00 00 00 00 02 ca 70
			23 00 00 00 00 00 02 cb 01
			23 00 00 00 00 00 02 cc 9e
			23 00 00 00 00 00 02 cd 01
			23 00 00 00 00 00 02 ce e7
			23 00 00 00 00 00 02 cf 02
			23 00 00 00 00 00 02 d0 22
			23 00 00 00 00 00 02 d1 02
			23 00 00 00 00 00 02 d2 24
			23 00 00 00 00 00 02 d3 02
			23 00 00 00 00 00 02 d4 5c
			23 00 00 00 00 00 02 d5 02
			23 00 00 00 00 00 02 d6 9c
			23 00 00 00 00 00 02 d7 02
			23 00 00 00 00 00 02 d8 c5
			23 00 00 00 00 00 02 d9 02
			23 00 00 00 00 00 02 da fe
			23 00 00 00 00 00 02 db 03
			23 00 00 00 00 00 02 dc 23
			23 00 00 00 00 00 02 dd 03
			23 00 00 00 00 00 02 de 51
			23 00 00 00 00 00 02 df 03
			23 00 00 00 00 00 02 e0 5f
			23 00 00 00 00 00 02 e1 03
			23 00 00 00 00 00 02 e2 6e
			23 00 00 00 00 00 02 e3 03
			23 00 00 00 00 00 02 e4 7f
			23 00 00 00 00 00 02 e5 03
			23 00 00 00 00 00 02 e6 92
			23 00 00 00 00 00 02 e7 03
			23 00 00 00 00 00 02 e8 a9
			23 00 00 00 00 00 02 e9 03
			23 00 00 00 00 00 02 ea c0
			23 00 00 00 00 00 02 eb 03
			23 00 00 00 00 00 02 ec ce
			23 00 00 00 00 00 02 ed 03
			23 01 00 00 00 00 02 ee cf
			23 00 00 00 00 00 02 ef 00
			23 00 00 00 00 00 02 f0 00
			23 00 00 00 00 00 02 f1 00
			23 00 00 00 00 00 02 f2 1d
			23 00 00 00 00 00 02 f3 00
			23 00 00 00 00 00 02 f4 44
			23 00 00 00 00 00 02 f5 00
			23 00 00 00 00 00 02 f6 61
			23 00 00 00 00 00 02 f7 00
			23 00 00 00 00 00 02 f8 78
			23 00 00 00 00 00 02 f9 00
			23 00 00 00 00 00 02 fa 8d
			23 00 00 00 00 00 02 ff 02
			23 00 00 00 00 00 02 fb 01
			23 00 00 00 00 00 02 00 00
			23 00 00 00 00 00 02 01 9f
			23 00 00 00 00 00 02 02 00
			23 00 00 00 00 00 02 03 b0
			23 00 00 00 00 00 02 04 00
			23 00 00 00 00 00 02 05 bf
			23 00 00 00 00 00 02 06 00
			23 00 00 00 00 00 02 07 f3
			23 00 00 00 00 00 02 08 01
			23 00 00 00 00 00 02 09 1c
			23 00 00 00 00 00 02 0a 01
			23 00 00 00 00 00 02 0b 5d
			23 00 00 00 00 00 02 0c 01
			23 00 00 00 00 00 02 0d 8f
			23 00 00 00 00 00 02 0e 01
			23 00 00 00 00 00 02 0f df
			23 00 00 00 00 00 02 10 02
			23 00 00 00 00 00 02 11 1c
			23 00 00 00 00 00 02 12 02
			23 00 00 00 00 00 02 13 1e
			23 00 00 00 00 00 02 14 02
			23 00 00 00 00 00 02 15 58
			23 00 00 00 00 00 02 16 02
			23 00 00 00 00 00 02 17 99
			23 00 00 00 00 00 02 18 02
			23 00 00 00 00 00 02 19 c3
			23 00 00 00 00 00 02 1a 02
			23 00 00 00 00 00 02 1b fc
			23 00 00 00 00 00 02 1c 03
			23 00 00 00 00 00 02 1d 21
			23 00 00 00 00 00 02 1e 03
			23 00 00 00 00 00 02 1f 4f
			23 00 00 00 00 00 02 20 03
			23 00 00 00 00 00 02 21 5c
			23 00 00 00 00 00 02 22 03
			23 00 00 00 00 00 02 23 6b
			23 00 00 00 00 00 02 24 03
			23 00 00 00 00 00 02 25 7c
			23 00 00 00 00 00 02 26 03
			23 00 00 00 00 00 02 27 8f
			23 00 00 00 00 00 02 28 03
			23 00 00 00 00 00 02 29 a5
			23 00 00 00 00 00 02 2a 03
			23 00 00 00 00 00 02 2b be
			23 00 00 00 00 00 02 2d 03
			23 00 00 00 00 00 02 2f cd
			23 00 00 00 00 00 02 30 03
			23 00 00 00 00 00 02 31 cf
			23 00 00 00 00 00 02 32 00
			23 00 00 00 00 00 02 33 00
			23 00 00 00 00 00 02 34 00
			23 00 00 00 00 00 02 35 1d
			23 00 00 00 00 00 02 36 00
			23 00 00 00 00 00 02 37 44
			23 00 00 00 00 00 02 38 00
			23 00 00 00 00 00 02 39 61
			23 00 00 00 00 00 02 3a 00
			23 00 00 00 00 00 02 3b 78
			23 00 00 00 00 00 02 3d 00
			23 00 00 00 00 00 02 3f 8d
			23 00 00 00 00 00 02 40 00
			23 00 00 00 00 00 02 41 9f
			23 00 00 00 00 00 02 42 00
			23 00 00 00 00 00 02 43 b0
			23 00 00 00 00 00 02 44 00
			23 00 00 00 00 00 02 45 bf
			23 00 00 00 00 00 02 46 00
			23 00 00 00 00 00 02 47 f3
			23 00 00 00 00 00 02 48 01
			23 00 00 00 00 00 02 49 1c
			23 00 00 00 00 00 02 4a 01
			23 00 00 00 00 00 02 4b 5d
			23 00 00 00 00 00 02 4c 01
			23 00 00 00 00 00 02 4d 8f
			23 00 00 00 00 00 02 4e 01
			23 00 00 00 00 00 02 4f df
			23 00 00 00 00 00 02 50 02
			23 00 00 00 00 00 02 51 1c
			23 00 00 00 00 00 02 52 02
			23 00 00 00 00 00 02 53 1e
			23 00 00 00 00 00 02 54 02
			23 00 00 00 00 00 02 55 58
			23 00 00 00 00 00 02 56 02
			23 00 00 00 00 00 02 58 99
			23 00 00 00 00 00 02 59 02
			23 00 00 00 00 00 02 5a c3
			23 00 00 00 00 00 02 5b 02
			23 00 00 00 00 00 02 5c fc
			23 00 00 00 00 00 02 5d 03
			23 00 00 00 00 00 02 5e 21
			23 00 00 00 00 00 02 5f 03
			23 00 00 00 00 00 02 60 4f
			23 00 00 00 00 00 02 61 03
			23 00 00 00 00 00 02 62 5c
			23 00 00 00 00 00 02 63 03
			23 00 00 00 00 00 02 64 6b
			23 00 00 00 00 00 02 65 03
			23 00 00 00 00 00 02 66 7c
			23 00 00 00 00 00 02 67 03
			23 00 00 00 00 00 02 68 8f
			23 00 00 00 00 00 02 69 03
			23 00 00 00 00 00 02 6a a5
			23 00 00 00 00 00 02 6b 03
			23 00 00 00 00 00 02 6c be
			23 00 00 00 00 00 02 6d 03
			23 00 00 00 00 00 02 6e cd
			23 00 00 00 00 00 02 6f 03
			23 01 00 00 00 00 02 70 cf
			23 00 00 00 00 00 02 71 01
			23 00 00 00 00 00 02 72 d5
			23 00 00 00 00 00 02 73 01
			23 00 00 00 00 00 02 74 d6
			23 00 00 00 00 00 02 75 01
			23 00 00 00 00 00 02 76 d9
			23 00 00 00 00 00 02 77 01
			23 00 00 00 00 00 02 78 dc
			23 00 00 00 00 00 02 79 01
			23 00 00 00 00 00 02 7a df
			23 00 00 00 00 00 02 7b 01
			23 00 00 00 00 00 02 7c e2
			23 00 00 00 00 00 02 7d 01
			23 00 00 00 00 00 02 7e e4
			23 00 00 00 00 00 02 7f 01
			23 00 00 00 00 00 02 80 e7
			23 00 00 00 00 00 02 81 01
			23 00 00 00 00 00 02 82 ea
			23 00 00 00 00 00 02 83 01
			23 00 00 00 00 00 02 84 f3
			23 00 00 00 00 00 02 85 01
			23 00 00 00 00 00 02 86 fe
			23 00 00 00 00 00 02 87 02
			23 00 00 00 00 00 02 88 11
			23 00 00 00 00 00 02 89 02
			23 00 00 00 00 00 02 8a 24
			23 00 00 00 00 00 02 8b 02
			23 00 00 00 00 00 02 8c 49
			23 00 00 00 00 00 02 8d 02
			23 00 00 00 00 00 02 8e 6f
			23 00 00 00 00 00 02 8f 02
			23 00 00 00 00 00 02 90 71
			23 00 00 00 00 00 02 91 02
			23 00 00 00 00 00 02 92 9c
			23 00 00 00 00 00 02 93 02
			23 00 00 00 00 00 02 94 d6
			23 00 00 00 00 00 02 95 02
			23 00 00 00 00 00 02 96 fc
			23 00 00 00 00 00 02 97 03
			23 00 00 00 00 00 02 98 2f
			23 00 00 00 00 00 02 99 03
			23 00 00 00 00 00 02 9a 4e
			23 00 00 00 00 00 02 9b 03
			23 00 00 00 00 00 02 9c 73
			23 00 00 00 00 00 02 9d 03
			23 00 00 00 00 00 02 9e 7d
			23 00 00 00 00 00 02 9f 03
			23 00 00 00 00 00 02 a0 89
			23 00 00 00 00 00 02 a2 03
			23 00 00 00 00 00 02 a3 95
			23 00 00 00 00 00 02 a4 03
			23 00 00 00 00 00 02 a5 a3
			23 00 00 00 00 00 02 a6 03
			23 00 00 00 00 00 02 a7 b2
			23 00 00 00 00 00 02 a9 03
			23 00 00 00 00 00 02 aa c2
			23 00 00 00 00 00 02 ab 03
			23 00 00 00 00 00 02 ac ce
			23 00 00 00 00 00 02 ad 03
			23 00 00 00 00 00 02 ae cf
			23 00 00 00 00 00 02 af 01
			23 00 00 00 00 00 02 b0 d5
			23 00 00 00 00 00 02 b1 01
			23 00 00 00 00 00 02 b2 d6
			23 00 00 00 00 00 02 b3 01
			23 00 00 00 00 00 02 b4 d9
			23 00 00 00 00 00 02 b5 01
			23 00 00 00 00 00 02 b6 dc
			23 00 00 00 00 00 02 b7 01
			23 00 00 00 00 00 02 b8 df
			23 00 00 00 00 00 02 b9 01
			23 00 00 00 00 00 02 ba e2
			23 00 00 00 00 00 02 bb 01
			23 00 00 00 00 00 02 bc e4
			23 00 00 00 00 00 02 bd 01
			23 00 00 00 00 00 02 be e7
			23 00 00 00 00 00 02 bf 01
			23 00 00 00 00 00 02 c0 ea
			23 00 00 00 00 00 02 c1 01
			23 00 00 00 00 00 02 c2 f3
			23 00 00 00 00 00 02 c3 01
			23 00 00 00 00 00 02 c4 fe
			23 00 00 00 00 00 02 c5 02
			23 00 00 00 00 00 02 c6 11
			23 00 00 00 00 00 02 c7 02
			23 00 00 00 00 00 02 c8 24
			23 00 00 00 00 00 02 c9 02
			23 00 00 00 00 00 02 ca 49
			23 00 00 00 00 00 02 cb 02
			23 00 00 00 00 00 02 cc 6f
			23 00 00 00 00 00 02 cd 02
			23 00 00 00 00 00 02 ce 71
			23 00 00 00 00 00 02 cf 02
			23 00 00 00 00 00 02 d0 9c
			23 00 00 00 00 00 02 d1 02
			23 00 00 00 00 00 02 d2 d6
			23 00 00 00 00 00 02 d3 02
			23 00 00 00 00 00 02 d4 fc
			23 00 00 00 00 00 02 d5 03
			23 00 00 00 00 00 02 d6 2f
			23 00 00 00 00 00 02 d7 03
			23 00 00 00 00 00 02 d8 4e
			23 00 00 00 00 00 02 d9 03
			23 00 00 00 00 00 02 da 73
			23 00 00 00 00 00 02 db 03
			23 00 00 00 00 00 02 dc 7d
			23 00 00 00 00 00 02 dd 03
			23 00 00 00 00 00 02 de 89
			23 00 00 00 00 00 02 df 03
			23 00 00 00 00 00 02 e0 95
			23 00 00 00 00 00 02 e1 03
			23 00 00 00 00 00 02 e2 a3
			23 00 00 00 00 00 02 e3 03
			23 00 00 00 00 00 02 e4 b2
			23 00 00 00 00 00 02 e5 03
			23 00 00 00 00 00 02 e6 c2
			23 00 00 00 00 00 02 e7 03
			23 00 00 00 00 00 02 e8 ce
			23 00 00 00 00 00 02 e9 03
			23 01 00 00 00 00 02 ea cf
		];
		qcom,mdss-dsi-eyecare-level8-command = [
			23 00 00 00 00 00 02 ff 01
			23 00 00 00 00 00 02 fb 01
			23 00 00 00 00 00 02 75 00
			23 00 00 00 00 00 02 76 87
			23 00 00 00 00 00 02 77 00
			23 00 00 00 00 00 02 78 90
			23 00 00 00 00 00 02 79 00
			23 00 00 00 00 00 02 7a a2
			23 00 00 00 00 00 02 7b 00
			23 00 00 00 00 00 02 7c b2
			23 00 00 00 00 00 02 7d 00
			23 00 00 00 00 00 02 7e c1
			23 00 00 00 00 00 02 7f 00
			23 00 00 00 00 00 02 80 cf
			23 00 00 00 00 00 02 81 00
			23 00 00 00 00 00 02 82 dc
			23 00 00 00 00 00 02 83 00
			23 00 00 00 00 00 02 84 e8
			23 00 00 00 00 00 02 85 00
			23 00 00 00 00 00 02 86 f4
			23 00 00 00 00 00 02 87 01
			23 00 00 00 00 00 02 88 1c
			23 00 00 00 00 00 02 89 01
			23 00 00 00 00 00 02 8a 3e
			23 00 00 00 00 00 02 8b 01
			23 00 00 00 00 00 02 8c 75
			23 00 00 00 00 00 02 8d 01
			23 00 00 00 00 00 02 8e a2
			23 00 00 00 00 00 02 8f 01
			23 00 00 00 00 00 02 90 ea
			23 00 00 00 00 00 02 91 02
			23 00 00 00 00 00 02 92 24
			23 00 00 00 00 00 02 93 02
			23 00 00 00 00 00 02 94 25
			23 00 00 00 00 00 02 95 02
			23 00 00 00 00 00 02 96 5d
			23 00 00 00 00 00 02 97 02
			23 00 00 00 00 00 02 98 9d
			23 00 00 00 00 00 02 99 02
			23 00 00 00 00 00 02 9a c6
			23 00 00 00 00 00 02 9b 02
			23 00 00 00 00 00 02 9c fe
			23 00 00 00 00 00 02 9d 03
			23 00 00 00 00 00 02 9e 24
			23 00 00 00 00 00 02 9f 03
			23 00 00 00 00 00 02 a0 52
			23 00 00 00 00 00 02 a2 03
			23 00 00 00 00 00 02 a3 5f
			23 00 00 00 00 00 02 a4 03
			23 00 00 00 00 00 02 a5 6e
			23 00 00 00 00 00 02 a6 03
			23 00 00 00 00 00 02 a7 7f
			23 00 00 00 00 00 02 a9 03
			23 00 00 00 00 00 02 aa 93
			23 00 00 00 00 00 02 ab 03
			23 00 00 00 00 00 02 ac a9
			23 00 00 00 00 00 02 ad 03
			23 00 00 00 00 00 02 ae c0
			23 00 00 00 00 00 02 af 03
			23 00 00 00 00 00 02 b0 ce
			23 00 00 00 00 00 02 b1 03
			23 00 00 00 00 00 02 b2 cf
			23 00 00 00 00 00 02 b3 00
			23 00 00 00 00 00 02 b4 87
			23 00 00 00 00 00 02 b5 00
			23 00 00 00 00 00 02 b6 90
			23 00 00 00 00 00 02 b7 00
			23 00 00 00 00 00 02 b8 a2
			23 00 00 00 00 00 02 b9 00
			23 00 00 00 00 00 02 ba b2
			23 00 00 00 00 00 02 bb 00
			23 00 00 00 00 00 02 bc c1
			23 00 00 00 00 00 02 bd 00
			23 00 00 00 00 00 02 be cf
			23 00 00 00 00 00 02 bf 00
			23 00 00 00 00 00 02 c0 dc
			23 00 00 00 00 00 02 c1 00
			23 00 00 00 00 00 02 c2 e8
			23 00 00 00 00 00 02 c3 00
			23 00 00 00 00 00 02 c4 f4
			23 00 00 00 00 00 02 c5 01
			23 00 00 00 00 00 02 c6 1c
			23 00 00 00 00 00 02 c7 01
			23 00 00 00 00 00 02 c8 3e
			23 00 00 00 00 00 02 c9 01
			23 00 00 00 00 00 02 ca 75
			23 00 00 00 00 00 02 cb 01
			23 00 00 00 00 00 02 cc a2
			23 00 00 00 00 00 02 cd 01
			23 00 00 00 00 00 02 ce ea
			23 00 00 00 00 00 02 cf 02
			23 00 00 00 00 00 02 d0 24
			23 00 00 00 00 00 02 d1 02
			23 00 00 00 00 00 02 d2 25
			23 00 00 00 00 00 02 d3 02
			23 00 00 00 00 00 02 d4 5d
			23 00 00 00 00 00 02 d5 02
			23 00 00 00 00 00 02 d6 9d
			23 00 00 00 00 00 02 d7 02
			23 00 00 00 00 00 02 d8 c6
			23 00 00 00 00 00 02 d9 02
			23 00 00 00 00 00 02 da fe
			23 00 00 00 00 00 02 db 03
			23 00 00 00 00 00 02 dc 24
			23 00 00 00 00 00 02 dd 03
			23 00 00 00 00 00 02 de 52
			23 00 00 00 00 00 02 df 03
			23 00 00 00 00 00 02 e0 5f
			23 00 00 00 00 00 02 e1 03
			23 00 00 00 00 00 02 e2 6e
			23 00 00 00 00 00 02 e3 03
			23 00 00 00 00 00 02 e4 7f
			23 00 00 00 00 00 02 e5 03
			23 00 00 00 00 00 02 e6 93
			23 00 00 00 00 00 02 e7 03
			23 00 00 00 00 00 02 e8 a9
			23 00 00 00 00 00 02 e9 03
			23 00 00 00 00 00 02 ea c0
			23 00 00 00 00 00 02 eb 03
			23 00 00 00 00 00 02 ec ce
			23 00 00 00 00 00 02 ed 03
			23 01 00 00 00 00 02 ee cf
			23 00 00 00 00 00 02 ef 00
			23 00 00 00 00 00 02 f0 00
			23 00 00 00 00 00 02 f1 00
			23 00 00 00 00 00 02 f2 1d
			23 00 00 00 00 00 02 f3 00
			23 00 00 00 00 00 02 f4 44
			23 00 00 00 00 00 02 f5 00
			23 00 00 00 00 00 02 f6 61
			23 00 00 00 00 00 02 f7 00
			23 00 00 00 00 00 02 f8 78
			23 00 00 00 00 00 02 f9 00
			23 00 00 00 00 00 02 fa 8d
			23 00 00 00 00 00 02 ff 02
			23 00 00 00 00 00 02 fb 01
			23 00 00 00 00 00 02 00 00
			23 00 00 00 00 00 02 01 9f
			23 00 00 00 00 00 02 02 00
			23 00 00 00 00 00 02 03 b0
			23 00 00 00 00 00 02 04 00
			23 00 00 00 00 00 02 05 bf
			23 00 00 00 00 00 02 06 00
			23 00 00 00 00 00 02 07 f3
			23 00 00 00 00 00 02 08 01
			23 00 00 00 00 00 02 09 1c
			23 00 00 00 00 00 02 0a 01
			23 00 00 00 00 00 02 0b 5d
			23 00 00 00 00 00 02 0c 01
			23 00 00 00 00 00 02 0d 8f
			23 00 00 00 00 00 02 0e 01
			23 00 00 00 00 00 02 0f df
			23 00 00 00 00 00 02 10 02
			23 00 00 00 00 00 02 11 1c
			23 00 00 00 00 00 02 12 02
			23 00 00 00 00 00 02 13 1e
			23 00 00 00 00 00 02 14 02
			23 00 00 00 00 00 02 15 58
			23 00 00 00 00 00 02 16 02
			23 00 00 00 00 00 02 17 99
			23 00 00 00 00 00 02 18 02
			23 00 00 00 00 00 02 19 c3
			23 00 00 00 00 00 02 1a 02
			23 00 00 00 00 00 02 1b fc
			23 00 00 00 00 00 02 1c 03
			23 00 00 00 00 00 02 1d 21
			23 00 00 00 00 00 02 1e 03
			23 00 00 00 00 00 02 1f 4f
			23 00 00 00 00 00 02 20 03
			23 00 00 00 00 00 02 21 5c
			23 00 00 00 00 00 02 22 03
			23 00 00 00 00 00 02 23 6b
			23 00 00 00 00 00 02 24 03
			23 00 00 00 00 00 02 25 7c
			23 00 00 00 00 00 02 26 03
			23 00 00 00 00 00 02 27 8f
			23 00 00 00 00 00 02 28 03
			23 00 00 00 00 00 02 29 a5
			23 00 00 00 00 00 02 2a 03
			23 00 00 00 00 00 02 2b be
			23 00 00 00 00 00 02 2d 03
			23 00 00 00 00 00 02 2f cd
			23 00 00 00 00 00 02 30 03
			23 00 00 00 00 00 02 31 cf
			23 00 00 00 00 00 02 32 00
			23 00 00 00 00 00 02 33 00
			23 00 00 00 00 00 02 34 00
			23 00 00 00 00 00 02 35 1d
			23 00 00 00 00 00 02 36 00
			23 00 00 00 00 00 02 37 44
			23 00 00 00 00 00 02 38 00
			23 00 00 00 00 00 02 39 61
			23 00 00 00 00 00 02 3a 00
			23 00 00 00 00 00 02 3b 78
			23 00 00 00 00 00 02 3d 00
			23 00 00 00 00 00 02 3f 8d
			23 00 00 00 00 00 02 40 00
			23 00 00 00 00 00 02 41 9f
			23 00 00 00 00 00 02 42 00
			23 00 00 00 00 00 02 43 b0
			23 00 00 00 00 00 02 44 00
			23 00 00 00 00 00 02 45 bf
			23 00 00 00 00 00 02 46 00
			23 00 00 00 00 00 02 47 f3
			23 00 00 00 00 00 02 48 01
			23 00 00 00 00 00 02 49 1c
			23 00 00 00 00 00 02 4a 01
			23 00 00 00 00 00 02 4b 5d
			23 00 00 00 00 00 02 4c 01
			23 00 00 00 00 00 02 4d 8f
			23 00 00 00 00 00 02 4e 01
			23 00 00 00 00 00 02 4f df
			23 00 00 00 00 00 02 50 02
			23 00 00 00 00 00 02 51 1c
			23 00 00 00 00 00 02 52 02
			23 00 00 00 00 00 02 53 1e
			23 00 00 00 00 00 02 54 02
			23 00 00 00 00 00 02 55 58
			23 00 00 00 00 00 02 56 02
			23 00 00 00 00 00 02 58 99
			23 00 00 00 00 00 02 59 02
			23 00 00 00 00 00 02 5a c3
			23 00 00 00 00 00 02 5b 02
			23 00 00 00 00 00 02 5c fc
			23 00 00 00 00 00 02 5d 03
			23 00 00 00 00 00 02 5e 21
			23 00 00 00 00 00 02 5f 03
			23 00 00 00 00 00 02 60 4f
			23 00 00 00 00 00 02 61 03
			23 00 00 00 00 00 02 62 5c
			23 00 00 00 00 00 02 63 03
			23 00 00 00 00 00 02 64 6b
			23 00 00 00 00 00 02 65 03
			23 00 00 00 00 00 02 66 7c
			23 00 00 00 00 00 02 67 03
			23 00 00 00 00 00 02 68 8f
			23 00 00 00 00 00 02 69 03
			23 00 00 00 00 00 02 6a a5
			23 00 00 00 00 00 02 6b 03
			23 00 00 00 00 00 02 6c be
			23 00 00 00 00 00 02 6d 03
			23 00 00 00 00 00 02 6e cd
			23 00 00 00 00 00 02 6f 03
			23 01 00 00 00 00 02 70 cf
			23 00 00 00 00 00 02 71 01
			23 00 00 00 00 00 02 72 ec
			23 00 00 00 00 00 02 73 01
			23 00 00 00 00 00 02 74 ed
			23 00 00 00 00 00 02 75 01
			23 00 00 00 00 00 02 76 f0
			23 00 00 00 00 00 02 77 01
			23 00 00 00 00 00 02 78 f2
			23 00 00 00 00 00 02 79 01
			23 00 00 00 00 00 02 7a f4
			23 00 00 00 00 00 02 7b 01
			23 00 00 00 00 00 02 7c f6
			23 00 00 00 00 00 02 7d 01
			23 00 00 00 00 00 02 7e f8
			23 00 00 00 00 00 02 7f 01
			23 00 00 00 00 00 02 80 fb
			23 00 00 00 00 00 02 81 01
			23 00 00 00 00 00 02 82 fd
			23 00 00 00 00 00 02 83 02
			23 00 00 00 00 00 02 84 06
			23 00 00 00 00 00 02 85 02
			23 00 00 00 00 00 02 86 10
			23 00 00 00 00 00 02 87 02
			23 00 00 00 00 00 02 88 21
			23 00 00 00 00 00 02 89 02
			23 00 00 00 00 00 02 8a 32
			23 00 00 00 00 00 02 8b 02
			23 00 00 00 00 00 02 8c 55
			23 00 00 00 00 00 02 8d 02
			23 00 00 00 00 00 02 8e 7a
			23 00 00 00 00 00 02 8f 02
			23 00 00 00 00 00 02 90 7b
			23 00 00 00 00 00 02 91 02
			23 00 00 00 00 00 02 92 a6
			23 00 00 00 00 00 02 93 02
			23 00 00 00 00 00 02 94 df
			23 00 00 00 00 00 02 95 03
			23 00 00 00 00 00 02 96 04
			23 00 00 00 00 00 02 97 03
			23 00 00 00 00 00 02 98 37
			23 00 00 00 00 00 02 99 03
			23 00 00 00 00 00 02 9a 55
			23 00 00 00 00 00 02 9b 03
			23 00 00 00 00 00 02 9c 78
			23 00 00 00 00 00 02 9d 03
			23 00 00 00 00 00 02 9e 82
			23 00 00 00 00 00 02 9f 03
			23 00 00 00 00 00 02 a0 8d
			23 00 00 00 00 00 02 a2 03
			23 00 00 00 00 00 02 a3 99
			23 00 00 00 00 00 02 a4 03
			23 00 00 00 00 00 02 a5 a6
			23 00 00 00 00 00 02 a6 03
			23 00 00 00 00 00 02 a7 b4
			23 00 00 00 00 00 02 a9 03
			23 00 00 00 00 00 02 aa c4
			23 00 00 00 00 00 02 ab 03
			23 00 00 00 00 00 02 ac ce
			23 00 00 00 00 00 02 ad 03
			23 00 00 00 00 00 02 ae cf
			23 00 00 00 00 00 02 af 01
			23 00 00 00 00 00 02 b0 ec
			23 00 00 00 00 00 02 b1 01
			23 00 00 00 00 00 02 b2 ed
			23 00 00 00 00 00 02 b3 01
			23 00 00 00 00 00 02 b4 f0
			23 00 00 00 00 00 02 b5 01
			23 00 00 00 00 00 02 b6 f2
			23 00 00 00 00 00 02 b7 01
			23 00 00 00 00 00 02 b8 f4
			23 00 00 00 00 00 02 b9 01
			23 00 00 00 00 00 02 ba f6
			23 00 00 00 00 00 02 bb 01
			23 00 00 00 00 00 02 bc f8
			23 00 00 00 00 00 02 bd 01
			23 00 00 00 00 00 02 be fb
			23 00 00 00 00 00 02 bf 01
			23 00 00 00 00 00 02 c0 fd
			23 00 00 00 00 00 02 c1 02
			23 00 00 00 00 00 02 c2 06
			23 00 00 00 00 00 02 c3 02
			23 00 00 00 00 00 02 c4 10
			23 00 00 00 00 00 02 c5 02
			23 00 00 00 00 00 02 c6 21
			23 00 00 00 00 00 02 c7 02
			23 00 00 00 00 00 02 c8 32
			23 00 00 00 00 00 02 c9 02
			23 00 00 00 00 00 02 ca 55
			23 00 00 00 00 00 02 cb 02
			23 00 00 00 00 00 02 cc 7a
			23 00 00 00 00 00 02 cd 02
			23 00 00 00 00 00 02 ce 7b
			23 00 00 00 00 00 02 cf 02
			23 00 00 00 00 00 02 d0 a6
			23 00 00 00 00 00 02 d1 02
			23 00 00 00 00 00 02 d2 df
			23 00 00 00 00 00 02 d3 03
			23 00 00 00 00 00 02 d4 04
			23 00 00 00 00 00 02 d5 03
			23 00 00 00 00 00 02 d6 37
			23 00 00 00 00 00 02 d7 03
			23 00 00 00 00 00 02 d8 55
			23 00 00 00 00 00 02 d9 03
			23 00 00 00 00 00 02 da 78
			23 00 00 00 00 00 02 db 03
			23 00 00 00 00 00 02 dc 82
			23 00 00 00 00 00 02 dd 03
			23 00 00 00 00 00 02 de 8d
			23 00 00 00 00 00 02 df 03
			23 00 00 00 00 00 02 e0 99
			23 00 00 00 00 00 02 e1 03
			23 00 00 00 00 00 02 e2 a6
			23 00 00 00 00 00 02 e3 03
			23 00 00 00 00 00 02 e4 b4
			23 00 00 00 00 00 02 e5 03
			23 00 00 00 00 00 02 e6 c4
			23 00 00 00 00 00 02 e7 03
			23 00 00 00 00 00 02 e8 ce
			23 00 00 00 00 00 02 e9 03
			23 01 00 00 00 00 02 ea cf
		];
		qcom,mdss-dsi-cold-command-state = "dsi_hs_mode";
		qcom,mdss-dsi-warm-command-state = "dsi_hs_mode";
		qcom,mdss-dsi-default-command-state = "dsi_hs_mode";
		qcom,mdss-dsi-ceon-command-state = "dsi_hs_mode";
		qcom,mdss-dsi-ceoff-command-state = "dsi_hs_mode";
		qcom,mdss-dsi-eyecare-off-command-state = "dsi_hs_mode";
		qcom,mdss-dsi-eyecare-level1-command-state = "dsi_hs_mode";
		qcom,mdss-dsi-eyecare-level2-command-state = "dsi_hs_mode";
		qcom,mdss-dsi-eyecare-level3-command-state = "dsi_hs_mode";
		qcom,mdss-dsi-eyecare-level4-command-state = "dsi_hs_mode";
		qcom,mdss-dsi-eyecare-level5-command-state = "dsi_hs_mode";
		qcom,mdss-dsi-eyecare-level6-command-state = "dsi_hs_mode";
		qcom,mdss-dsi-eyecare-level7-command-state = "dsi_hs_mode";
		qcom,mdss-dsi-eyecare-level8-command-state = "dsi_hs_mode";
		qcom,mdss-dsi-panel-name = "tianma nt35596 1080p video mode dsi panel";
		qcom,mdss-dsi-panel-type = "dsi_video_mode";
		qcom,mdss-dsi-panel-framerate = <60>;
		qcom,mdss-dsi-virtual-channel-id = <0>;
		qcom,mdss-dsi-stream = <0>;
		qcom,mdss-dsi-panel-width = <1080>;
		qcom,mdss-dsi-panel-height = <1920>;
		qcom,mdss-dsi-h-front-porch = <98>;
		qcom,mdss-dsi-h-back-porch = <200>;
		qcom,mdss-dsi-h-pulse-width = <8>;
		qcom,mdss-dsi-h-sync-skew = <0>;
		qcom,mdss-dsi-v-back-porch = <8>;
		qcom,mdss-dsi-v-front-porch = <10>;
		qcom,mdss-dsi-v-pulse-width = <2>;
		qcom,mdss-dsi-h-left-border = <0>;
		qcom,mdss-dsi-h-right-border = <0>;
		qcom,mdss-dsi-v-top-border = <0>;
		qcom,mdss-dsi-v-bottom-border = <0>;
		qcom,mdss-dsi-bpp = <24>;
		qcom,mdss-dsi-underflow-color = <0xff>;
		qcom,mdss-dsi-border-color = <0>;
		qcom,mdss-dsi-h-sync-pulse = <0>;
		qcom,mdss-dsi-traffic-mode = "burst_mode";
		qcom,mdss-dsi-bllp-eof-power-mode;
		qcom,mdss-dsi-bllp-power-mode;
		qcom,mdss-dsi-lane-0-state;
		qcom,mdss-dsi-lane-1-state;
		qcom,mdss-dsi-lane-2-state;
		qcom,mdss-dsi-lane-3-state;
		qcom,mdss-dsi-panel-timings = [f8 3c 28 00 6e 72 2e 40 30 03 04 00];
		qcom,mdss-dsi-t-clk-post = <0x2>;
		qcom,mdss-dsi-t-clk-pre = <0x2d>;
		qcom,mdss-dsi-bl-min-level = <1>;
		qcom,mdss-dsi-bl-max-level = <4095>;
		qcom,mdss-dsi-dma-trigger = "trigger_sw";
		qcom,mdss-dsi-mdp-trigger = "none";
		qcom,mdss-dsi-on-command = [
			23 01 00 00 00 00 02 ff ee
			23 01 00 00 0a 00 02 18 40
			23 01 00 00 14 00 02 18 00
			23 00 00 00 00 00 02 fb 01
			23 00 00 00 00 00 02 7c 31
			23 00 00 00 00 00 02 25 03
			23 00 00 00 00 00 02 ff 01
			23 00 00 00 00 00 02 fb 01
			23 00 00 00 00 00 02 75 00
			23 00 00 00 00 00 02 76 00
			23 00 00 00 00 00 02 77 00
			23 00 00 00 00 00 02 78 21
			23 00 00 00 00 00 02 79 00
			23 00 00 00 00 00 02 7a 4a
			23 00 00 00 00 00 02 7b 00
			23 00 00 00 00 00 02 7c 66
			23 00 00 00 00 00 02 7d 00
			23 00 00 00 00 00 02 7e 7f
			23 00 00 00 00 00 02 7f 00
			23 00 00 00 00 00 02 80 94
			23 00 00 00 00 00 02 81 00
			23 00 00 00 00 00 02 82 a7
			23 00 00 00 00 00 02 83 00
			23 00 00 00 00 00 02 84 b8
			23 00 00 00 00 00 02 85 00
			23 00 00 00 00 00 02 86 c7
			23 00 00 00 00 00 02 87 00
			23 00 00 00 00 00 02 88 fb
			23 00 00 00 00 00 02 89 01
			23 00 00 00 00 00 02 8a 25
			23 00 00 00 00 00 02 8b 01
			23 00 00 00 00 00 02 8c 61
			23 00 00 00 00 00 02 8d 01
			23 00 00 00 00 00 02 8e 94
			23 00 00 00 00 00 02 8f 01
			23 00 00 00 00 00 02 90 e2
			23 00 00 00 00 00 02 91 02
			23 00 00 00 00 00 02 92 20
			23 00 00 00 00 00 02 93 02
			23 00 00 00 00 00 02 94 22
			23 00 00 00 00 00 02 95 02
			23 00 00 00 00 00 02 96 5c
			23 00 00 00 00 00 02 97 02
			23 00 00 00 00 00 02 98 9e
			23 00 00 00 00 00 02 99 02
			23 00 00 00 00 00 02 9a c9
			23 00 00 00 00 00 02 9b 03
			23 00 00 00 00 00 02 9c 01
			23 00 00 00 00 00 02 9d 03
			23 00 00 00 00 00 02 9e 28
			23 00 00 00 00 00 02 9f 03
			23 00 00 00 00 00 02 a0 55
			23 00 00 00 00 00 02 a2 03
			23 00 00 00 00 00 02 a3 62
			23 00 00 00 00 00 02 a4 03
			23 00 00 00 00 00 02 a5 6f
			23 00 00 00 00 00 02 a6 03
			23 00 00 00 00 00 02 a7 7e
			23 00 00 00 00 00 02 a9 03
			23 00 00 00 00 00 02 aa 8f
			23 00 00 00 00 00 02 ab 03
			23 00 00 00 00 00 02 ac 9c
			23 00 00 00 00 00 02 ad 03
			23 00 00 00 00 00 02 ae a2
			23 00 00 00 00 00 02 af 03
			23 00 00 00 00 00 02 b0 ab
			23 00 00 00 00 00 02 b1 03
			23 00 00 00 00 00 02 b2 b2
			23 00 00 00 00 00 02 b3 00
			23 00 00 00 00 00 02 b4 00
			23 00 00 00 00 00 02 b5 00
			23 00 00 00 00 00 02 b6 21
			23 00 00 00 00 00 02 b7 00
			23 00 00 00 00 00 02 b8 4a
			23 00 00 00 00 00 02 b9 00
			23 00 00 00 00 00 02 ba 66
			23 00 00 00 00 00 02 bb 00
			23 00 00 00 00 00 02 bc 7f
			23 00 00 00 00 00 02 bd 00
			23 00 00 00 00 00 02 be 94
			23 00 00 00 00 00 02 bf 00
			23 00 00 00 00 00 02 c0 a7
			23 00 00 00 00 00 02 c1 00
			23 00 00 00 00 00 02 c2 b8
			23 00 00 00 00 00 02 c3 00
			23 00 00 00 00 00 02 c4 c7
			23 00 00 00 00 00 02 c5 00
			23 00 00 00 00 00 02 c6 fb
			23 00 00 00 00 00 02 c7 01
			23 00 00 00 00 00 02 c8 25
			23 00 00 00 00 00 02 c9 01
			23 00 00 00 00 00 02 ca 61
			23 00 00 00 00 00 02 cb 01
			23 00 00 00 00 00 02 cc 94
			23 00 00 00 00 00 02 cd 01
			23 00 00 00 00 00 02 ce e2
			23 00 00 00 00 00 02 cf 02
			23 00 00 00 00 00 02 d0 20
			23 00 00 00 00 00 02 d1 02
			23 00 00 00 00 00 02 d2 22
			23 00 00 00 00 00 02 d3 02
			23 00 00 00 00 00 02 d4 5c
			23 00 00 00 00 00 02 d5 02
			23 00 00 00 00 00 02 d6 9e
			23 00 00 00 00 00 02 d7 02
			23 00 00 00 00 00 02 d8 c9
			23 00 00 00 00 00 02 d9 03
			23 00 00 00 00 00 02 da 01
			23 00 00 00 00 00 02 db 03
			23 00 00 00 00 00 02 dc 28
			23 00 00 00 00 00 02 dd 03
			23 00 00 00 00 00 02 de 55
			23 00 00 00 00 00 02 df 03
			23 00 00 00 00 00 02 e0 62
			23 00 00 00 00 00 02 e1 03
			23 00 00 00 00 00 02 e2 6f
			23 00 00 00 00 00 02 e3 03
			23 00 00 00 00 00 02 e4 7e
			23 00 00 00 00 00 02 e5 03
			23 00 00 00 00 00 02 e6 8f
			23 00 00 00 00 00 02 e7 03
			23 00 00 00 00 00 02 e8 9c
			23 00 00 00 00 00 02 e9 03
			23 00 00 00 00 00 02 ea a2
			23 00 00 00 00 00 02 eb 03
			23 00 00 00 00 00 02 ec ab
			23 00 00 00 00 00 02 ed 03
			23 00 00 00 00 00 02 ee b2
			23 00 00 00 00 00 02 ef 00
			23 00 00 00 00 00 02 f0 00
			23 00 00 00 00 00 02 f1 00
			23 00 00 00 00 00 02 f2 21
			23 00 00 00 00 00 02 f3 00
			23 00 00 00 00 00 02 f4 4a
			23 00 00 00 00 00 02 f5 00
			23 00 00 00 00 00 02 f6 66
			23 00 00 00 00 00 02 f7 00
			23 00 00 00 00 00 02 f8 7f
			23 00 00 00 00 00 02 f9 00
			23 00 00 00 00 00 02 fa 94
			23 00 00 00 00 00 02 ff 02
			23 00 00 00 00 00 02 fb 01
			23 00 00 00 00 00 02 00 00
			23 00 00 00 00 00 02 01 a7
			23 00 00 00 00 00 02 02 00
			23 00 00 00 00 00 02 03 b8
			23 00 00 00 00 00 02 04 00
			23 00 00 00 00 00 02 05 c7
			23 00 00 00 00 00 02 06 00
			23 00 00 00 00 00 02 07 fb
			23 00 00 00 00 00 02 08 01
			23 00 00 00 00 00 02 09 25
			23 00 00 00 00 00 02 0a 01
			23 00 00 00 00 00 02 0b 61
			23 00 00 00 00 00 02 0c 01
			23 00 00 00 00 00 02 0d 94
			23 00 00 00 00 00 02 0e 01
			23 00 00 00 00 00 02 0f e2
			23 00 00 00 00 00 02 10 02
			23 00 00 00 00 00 02 11 20
			23 00 00 00 00 00 02 12 02
			23 00 00 00 00 00 02 13 22
			23 00 00 00 00 00 02 14 02
			23 00 00 00 00 00 02 15 5c
			23 00 00 00 00 00 02 16 02
			23 00 00 00 00 00 02 17 9e
			23 00 00 00 00 00 02 18 02
			23 00 00 00 00 00 02 19 c9
			23 00 00 00 00 00 02 1a 03
			23 00 00 00 00 00 02 1b 01
			23 00 00 00 00 00 02 1c 03
			23 00 00 00 00 00 02 1d 28
			23 00 00 00 00 00 02 1e 03
			23 00 00 00 00 00 02 1f 55
			23 00 00 00 00 00 02 20 03
			23 00 00 00 00 00 02 21 62
			23 00 00 00 00 00 02 22 03
			23 00 00 00 00 00 02 23 6f
			23 00 00 00 00 00 02 24 03
			23 00 00 00 00 00 02 25 7e
			23 00 00 00 00 00 02 26 03
			23 00 00 00 00 00 02 27 8f
			23 00 00 00 00 00 02 28 03
			23 00 00 00 00 00 02 29 9c
			23 00 00 00 00 00 02 2a 03
			23 00 00 00 00 00 02 2b a2
			23 00 00 00 00 00 02 2d 03
			23 00 00 00 00 00 02 2f ab
			23 00 00 00 00 00 02 30 03
			23 00 00 00 00 00 02 31 b2
			23 00 00 00 00 00 02 32 00
			23 00 00 00 00 00 02 33 00
			23 00 00 00 00 00 02 34 00
			23 00 00 00 00 00 02 35 21
			23 00 00 00 00 00 02 36 00
			23 00 00 00 00 00 02 37 4a
			23 00 00 00 00 00 02 38 00
			23 00 00 00 00 00 02 39 66
			23 00 00 00 00 00 02 3a 00
			23 00 00 00 00 00 02 3b 7f
			23 00 00 00 00 00 02 3d 00
			23 00 00 00 00 00 02 3f 94
			23 00 00 00 00 00 02 40 00
			23 00 00 00 00 00 02 41 a7
			23 00 00 00 00 00 02 42 00
			23 00 00 00 00 00 02 43 b8
			23 00 00 00 00 00 02 44 00
			23 00 00 00 00 00 02 45 c7
			23 00 00 00 00 00 02 46 00
			23 00 00 00 00 00 02 47 fb
			23 00 00 00 00 00 02 48 01
			23 00 00 00 00 00 02 49 25
			23 00 00 00 00 00 02 4a 01
			23 00 00 00 00 00 02 4b 61
			23 00 00 00 00 00 02 4c 01
			23 00 00 00 00 00 02 4d 94
			23 00 00 00 00 00 02 4e 01
			23 00 00 00 00 00 02 4f e2
			23 00 00 00 00 00 02 50 02
			23 00 00 00 00 00 02 51 20
			23 00 00 00 00 00 02 52 02
			23 00 00 00 00 00 02 53 22
			23 00 00 00 00 00 02 54 02
			23 00 00 00 00 00 02 55 5c
			23 00 00 00 00 00 02 56 02
			23 00 00 00 00 00 02 58 9e
			23 00 00 00 00 00 02 59 02
			23 00 00 00 00 00 02 5a c9
			23 00 00 00 00 00 02 5b 03
			23 00 00 00 00 00 02 5c 01
			23 00 00 00 00 00 02 5d 03
			23 00 00 00 00 00 02 5e 28
			23 00 00 00 00 00 02 5f 03
			23 00 00 00 00 00 02 60 55
			23 00 00 00 00 00 02 61 03
			23 00 00 00 00 00 02 62 62
			23 00 00 00 00 00 02 63 03
			23 00 00 00 00 00 02 64 6f
			23 00 00 00 00 00 02 65 03
			23 00 00 00 00 00 02 66 7e
			23 00 00 00 00 00 02 67 03
			23 00 00 00 00 00 02 68 8f
			23 00 00 00 00 00 02 69 03
			23 00 00 00 00 00 02 6a 9c
			23 00 00 00 00 00 02 6b 03
			23 00 00 00 00 00 02 6c a2
			23 00 00 00 00 00 02 6d 03
			23 00 00 00 00 00 02 6e ab
			23 00 00 00 00 00 02 6f 03
			23 00 00 00 00 00 02 70 b2
			23 00 00 00 00 00 02 71 00
			23 00 00 00 00 00 02 72 00
			23 00 00 00 00 00 02 73 00
			23 00 00 00 00 00 02 74 1e
			23 00 00 00 00 00 02 75 00
			23 00 00 00 00 00 02 76 48
			23 00 00 00 00 00 02 77 00
			23 00 00 00 00 00 02 78 57
			23 00 00 00 00 00 02 79 00
			23 00 00 00 00 00 02 7a 6a
			23 00 00 00 00 00 02 7b 00
			23 00 00 00 00 00 02 7c 80
			23 00 00 00 00 00 02 7d 00
			23 00 00 00 00 00 02 7e 90
			23 00 00 00 00 00 02 7f 00
			23 00 00 00 00 00 02 80 a0
			23 00 00 00 00 00 02 81 00
			23 00 00 00 00 00 02 82 ae
			23 00 00 00 00 00 02 83 00
			23 00 00 00 00 00 02 84 e3
			23 00 00 00 00 00 02 85 01
			23 00 00 00 00 00 02 86 0e
			23 00 00 00 00 00 02 87 01
			23 00 00 00 00 00 02 88 50
			23 00 00 00 00 00 02 89 01
			23 00 00 00 00 00 02 8a 88
			23 00 00 00 00 00 02 8b 01
			23 00 00 00 00 00 02 8c da
			23 00 00 00 00 00 02 8d 02
			23 00 00 00 00 00 02 8e 19
			23 00 00 00 00 00 02 8f 02
			23 00 00 00 00 00 02 90 1b
			23 00 00 00 00 00 02 91 02
			23 00 00 00 00 00 02 92 58
			23 00 00 00 00 00 02 93 02
			23 00 00 00 00 00 02 94 9c
			23 00 00 00 00 00 02 95 02
			23 00 00 00 00 00 02 96 c6
			23 00 00 00 00 00 02 97 03
			23 00 00 00 00 00 02 98 01
			23 00 00 00 00 00 02 99 03
			23 00 00 00 00 00 02 9a 28
			23 00 00 00 00 00 02 9b 03
			23 00 00 00 00 00 02 9c 55
			23 00 00 00 00 00 02 9d 03
			23 00 00 00 00 00 02 9e 62
			23 00 00 00 00 00 02 9f 03
			23 00 00 00 00 00 02 a0 6f
			23 00 00 00 00 00 02 a2 03
			23 00 00 00 00 00 02 a3 7e
			23 00 00 00 00 00 02 a4 03
			23 00 00 00 00 00 02 a5 8f
			23 00 00 00 00 00 02 a6 03
			23 00 00 00 00 00 02 a7 9c
			23 00 00 00 00 00 02 a9 03
			23 00 00 00 00 00 02 aa a2
			23 00 00 00 00 00 02 ab 03
			23 00 00 00 00 00 02 ac ab
			23 00 00 00 00 00 02 ad 03
			23 00 00 00 00 00 02 ae b2
			23 00 00 00 00 00 02 af 00
			23 00 00 00 00 00 02 b0 00
			23 00 00 00 00 00 02 b1 00
			23 00 00 00 00 00 02 b2 1e
			23 00 00 00 00 00 02 b3 00
			23 00 00 00 00 00 02 b4 48
			23 00 00 00 00 00 02 b5 00
			23 00 00 00 00 00 02 b6 57
			23 00 00 00 00 00 02 b7 00
			23 00 00 00 00 00 02 b8 6a
			23 00 00 00 00 00 02 b9 00
			23 00 00 00 00 00 02 ba 80
			23 00 00 00 00 00 02 bb 00
			23 00 00 00 00 00 02 bc 90
			23 00 00 00 00 00 02 bd 00
			23 00 00 00 00 00 02 be a0
			23 00 00 00 00 00 02 bf 00
			23 00 00 00 00 00 02 c0 ae
			23 00 00 00 00 00 02 c1 00
			23 00 00 00 00 00 02 c2 e3
			23 00 00 00 00 00 02 c3 01
			23 00 00 00 00 00 02 c4 0e
			23 00 00 00 00 00 02 c5 01
			23 00 00 00 00 00 02 c6 50
			23 00 00 00 00 00 02 c7 01
			23 00 00 00 00 00 02 c8 88
			23 00 00 00 00 00 02 c9 01
			23 00 00 00 00 00 02 ca da
			23 00 00 00 00 00 02 cb 02
			23 00 00 00 00 00 02 cc 19
			23 00 00 00 00 00 02 cd 02
			23 00 00 00 00 00 02 ce 1b
			23 00 00 00 00 00 02 cf 02
			23 00 00 00 00 00 02 d0 58
			23 00 00 00 00 00 02 d1 02
			23 00 00 00 00 00 02 d2 9c
			23 00 00 00 00 00 02 d3 02
			23 00 00 00 00 00 02 d4 c6
			23 00 00 00 00 00 02 d5 03
			23 00 00 00 00 00 02 d6 01
			23 00 00 00 00 00 02 d7 03
			23 00 00 00 00 00 02 d8 28
			23 00 00 00 00 00 02 d9 03
			23 00 00 00 00 00 02 da 55
			23 00 00 00 00 00 02 db 03
			23 00 00 00 00 00 02 dc 62
			23 00 00 00 00 00 02 dd 03
			23 00 00 00 00 00 02 de 6f
			23 00 00 00 00 00 02 df 03
			23 00 00 00 00 00 02 e0 7e
			23 00 00 00 00 00 02 e1 03
			23 00 00 00 00 00 02 e2 8f
			23 00 00 00 00 00 02 e3 03
			23 00 00 00 00 00 02 e4 9c
			23 00 00 00 00 00 02 e5 03
			23 00 00 00 00 00 02 e6 a2
			23 00 00 00 00 00 02 e7 03
			23 00 00 00 00 00 02 e8 ab
			23 00 00 00 00 00 02 e9 03
			23 00 00 00 00 00 02 ea b2
			23 00 00 00 00 00 02 ff 00
			23 00 00 00 00 00 02 ff 00
			23 00 00 00 00 00 02 51 00
			23 00 00 00 00 00 02 53 2c
			23 00 00 00 00 00 02 55 00
			23 00 00 00 00 00 02 ff 00
			23 00 00 00 00 00 02 d3 0a
			23 01 00 00 00 00 02 d4 0a
			05 01 00 00 64 00 02 11 00
			05 01 00 00 00 00 02 29 00
		];
		qcom,mdss-dsi-off-command = [
			05 01 00 00 96 00 02 28 00
			05 01 00 00 3c 00 02 10 00
		];
		qcom,mdss-dsi-on-command-state = "dsi_lp_mode";
		qcom,mdss-dsi-off-command-state = "dsi_lp_mode";
		qcom,mdss-dsi-bl-pmic-control-type = "bl_ctrl_wled";
		qcom,mdss-dsi-reset-sequence = <1 10 0 1 1 10 0 1 1 20>;
		qcom,mdss-dsi-tx-eot-append;
		qcom,cont-splash-enabled;
		qcom,panel-supply-entries = <&dsi_panel_pwr_supply>;
		qcom,mdss-pan-physical-width-dimension = <70>;
		qcom,mdss-pan-physical-height-dimension = <128>;
		qcom,mdss-dsi-hbp-power-mode;
		qcom,mdss-dsi-panel-status-command = [
			06 01 00 01 05 00 02 0a 08
		];
		qcom,mdss-dsi-panel-status-command-state = "dsi_hs_mode";
		qcom,mdss-dsi-panel-status-check-mode = "reg_read";
		qcom,mdss-dsi-panel-status-value = <0x9c>;
		qcom,mdss-night-brightness = <0x9 0x1b 0x2d 0x3f>;
	};
};
