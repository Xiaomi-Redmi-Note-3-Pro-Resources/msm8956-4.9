/*
 * kenzo/kate Sunwoda 4000mAh battery profile
 * Generated by scripts/gen_panels.py from the stock kenzo device tree.
 * Do not edit by hand.
 */

qcom,2162464_longcheer_ct865sunwoda_4000mah_averaged_masterslave_oct12th2015 {
	qcom,max-voltage-uv = <4400000>;
	qcom,nom-batt-capacity-mah = <4000>;
	qcom,batt-id-kohm = <50>;
	qcom,battery-beta = <4150>;
	qcom,battery-type = "2162464_longcheer_ct865sunwoda_4000mah_averaged_masterslave_oct12th2015";
	qcom,chg-rslow-comp-c1 = <2905279>;
	qcom,chg-rslow-comp-c2 = <3467482>;
	qcom,chg-rs-to-rslow = <911611>;
	qcom,chg-rslow-comp-thr = <0x99>;
	qcom,fastchg-current-ma = <2000>;
	qcom,checksum = <0x43de>;
	qcom,gui-version = "PMI8950GUI - 2.0.0.14";
	qcom,fg-profile-data = [
		f1 83 7d 7d
		99 81 1c 7c
		5e 83 ec 6c
		bf 83 11 8e
		21 82 c9 99
		98 bc f1 c8
		5b 0f 14 88
		0f 7f b1 82
		1b 7d 4b 83
		67 71 ac 67
		f3 76 56 82
		5a 99 8f bc
		44 c9 5e 0d
		ed 0f b5 5a
		14 70 ee fc
		04 36 d6 45
		de 3b 00 00
		1c 47 94 3b
		3f 21 00 00
		00 00 00 00
		00 00 00 00
		aa 6b 27 6a
		31 6a 65 88
		b9 74 5a 69
		e8 62 9a 80
		88 6e 96 62
		dc 7f fb a0
		1d 5d 63 18
		65 a0 71 0c
		28 00 ff 36
		f0 11 30 03
		00 00 00 0c
	];
};
