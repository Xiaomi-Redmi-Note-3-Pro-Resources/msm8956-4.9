/*
 * kenzo/kate Coslight 4000mAh 10k battery profile
 * Generated by scripts/gen_panels.py from the stock kenzo device tree.
 * Do not edit by hand.
 */

qcom,ct865_coslight_4000mah_10k_averaged_masterslave_oct2nd2015 {
	qcom,max-voltage-uv = <4400000>;
	qcom,nom-batt-capacity-mah = <4000>;
	qcom,batt-id-kohm = <10>;
	qcom,battery-beta = <4150>;
	qcom,battery-type = "ct865_coslight_4000mah_10k_averaged_masterslave_oct2nd2015";
	qcom,chg-rslow-comp-c1 = <2733744>;
	qcom,chg-rslow-comp-c2 = <3185429>;
	qcom,chg-rs-to-rslow = <896437>;
	qcom,chg-rslow-comp-thr = <0x99>;
	qcom,fastchg-current-ma = <2000>;
	qcom,checksum = <0xa7be>;
	qcom,gui-version = "PMI8950GUI - 2.0.0.14";
	qcom,fg-profile-data = [
		db 83 8c 7c
		cd 80 94 76
		68 83 49 75
		f5 89 e2 94
		11 82 0a 9a
		b1 bc e5 c8
		56 12 f0 83
		cb 7c dc 80
		7f 76 5a 83
		f1 60 60 81
		e3 8d 55 82
		79 99 b6 bc
		7c c9 54 0e
		86 10 d1 59
		14 70 f4 fd
		ea 3c 35 46
		56 42 00 00
		0a 45 09 3b
		8d 3e 00 00
		00 00 00 00
		00 00 00 00
		00 70 2c 6a
		1c 57 ea 88
		70 75 fd 6a
		25 65 c2 7b
		1f 6f 29 68
		e2 6d 66 a3
		1e d7 61 12
		65 a0 71 0c
		28 00 ff 36
		f0 11 30 03
		00 00 00 0c
	];
};
