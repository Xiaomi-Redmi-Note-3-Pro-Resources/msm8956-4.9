/*
 * Copyright (c) 2015, The Linux Foundation. All rights reserved.
 * Copyright (c) 2023, Irawans Prjkt. All rights reserved.
 *
 * This program is free software; you can redistribute it and/or modify
 * it under the terms of the GNU General Public License version 2 and
 * only version 2 as published by the Free Software Foundation.
 *
 * This program is distributed in the hope that it will be useful,
 * but WITHOUT ANY WARRANTY; without even the implied warranty of
 * MERCHANTABILITY or FITNESS FOR A PARTICULAR PURPOSE.  See the
 * GNU General Public License for more details.
 */

#include "panels/dsi-panel-boe-nt35532-1080p-video.dtsi"
#include "panels/dsi-panel-tianma-nt35596-1080p-video.dtsi"

&dsi_panel_pwr_supply {
    /delete-node/ qcom,panel-supply-entry@0;
};
