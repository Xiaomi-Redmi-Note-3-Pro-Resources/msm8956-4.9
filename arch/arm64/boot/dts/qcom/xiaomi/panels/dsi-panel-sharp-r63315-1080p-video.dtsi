/*
 * Copyright (c) 2015, The Linux Foundation. All rights reserved.
 * Copyright (C) 2016, XiaoMi, Inc.
 * Copyright (c) 2023, Irawans Prjkt. All rights reserved.
 *
 * This program is free software; you can redistribute it and/or modify
 * it under the terms of the GNU General Public License version 2 and
 * only version 2 as published by the Free Software Foundation.
 *
 * This program is distributed in the hope that it will be useful,
 * but WITHOUT ANY WARRANTY; without even the implied warranty of
 * MERCHANTABILITY or FITNESS FOR A PARTICULAR PURPOSE.  See the
 * GNU General Public License for more details.
 */
&mdss_mdp {
    dsi_sharp_r63315_1080_video: qcom,mdss_dsi_sharp_r63315_1080p_video {
        qcom,mdss-dsi-panel-name = "sharp r63315 1080p video mode dsi panel";
        qcom,mdss-dsi-panel-type = "dsi_video_mode";
        qcom,mdss-dsi-panel-framerate = <60>;
        qcom,mdss-dsi-virtual-channel-id = <0>;
        qcom,mdss-dsi-stream = <0>;
        qcom,mdss-dsi-panel-width = <1080>;
        qcom,mdss-dsi-panel-height = <1920>;
        qcom,mdss-dsi-h-front-porch = <98>;
        qcom,mdss-dsi-h-back-porch = <98>;
        qcom,mdss-dsi-h-pulse-width = <8>;
        qcom,mdss-dsi-h-sync-skew = <0>;
        qcom,mdss-dsi-v-back-porch = <8>;
        qcom,mdss-dsi-v-front-porch = <10>;
        qcom,mdss-dsi-v-pulse-width = <2>;
        qcom,mdss-dsi-h-left-border = <0>;
        qcom,mdss-dsi-h-right-border = <0>;
        qcom,mdss-dsi-v-top-border = <0>;
        qcom,mdss-dsi-v-bottom-border = <0>;
        qcom,mdss-dsi-bpp = <24>;
        qcom,mdss-dsi-underflow-color = <255>;
        qcom,mdss-dsi-border-color = <0>;
        qcom,mdss-dsi-h-sync-pulse = <0>;
        qcom,mdss-dsi-traffic-mode = "burst_mode";
        qcom,mdss-dsi-bllp-eof-power-mode;
        qcom,mdss-dsi-bllp-power-mode;
        qcom,mdss-dsi-lane-0-state;
        qcom,mdss-dsi-lane-1-state;
        qcom,mdss-dsi-lane-2-state;
        qcom,mdss-dsi-lane-3-state;
        qcom,mdss-dsi-panel-timings = <0xe6382600 0x686c2a3c 0x2c030400>;
        qcom,mdss-dsi-t-clk-post = <0x02>;
        qcom,mdss-dsi-t-clk-pre = <0x2d>;
        qcom,mdss-dsi-bl-min-level = <1>;
        qcom,mdss-dsi-bl-max-level = <4095>;
        qcom,mdss-dsi-dma-trigger = "trigger_sw";
        qcom,mdss-dsi-mdp-trigger = "none";
        qcom,mdss-dsi-on-command = [29 01 00 00 00 00 02 b0 00 29 01 00 00 00 00 1f c7 05 14 1e 2a 3b 4a 54 62 47 50 5d 69 70 74 77 07 16 20 2a 3b 4a 54 62 47 4f 5a 66 6d 70 73 29 01 00 00 00 00 14 c8 01 00 00 fd 02 fc 00 00 ff 01 ff fc 00 00 01 f5 f6 fc 00 29 01 00 00 00 00 02 35 00 29 01 00 00 00 00 02 55 00 05 01 00 00 14 00 02 29 00 05 01 00 00 78 00 02 11 00];
        qcom,mdss-dsi-off-command = [05 01 00 00 96 00 02 28 00 05 01 00 00 96 00 02 10 00];
        qcom,mdss-dsi-cold-command = [29 00 00 00 00 00 02 b0 00 29 00 00 00 00 00 1f c7 05 16 21 2c 3d 4c 55 63 48 51 5d 69 70 74 77 07 17 22 2d 3e 4c 55 63 48 4f 5a 66 6d 71 73 29 01 00 00 00 00 14 c8 01 01 00 05 09 e6 0f 01 00 05 07 d0 1f 01 00 fe 03 fc 0f];
        qcom,mdss-dsi-warm-command = [29 00 00 00 00 00 02 b0 00 29 00 00 00 00 00 1f c7 05 13 1c 29 39 47 52 60 44 4e 5b 66 6d 72 77 07 15 1e 29 39 47 52 60 44 4c 58 63 69 6e 73 29 01 00 00 00 00 14 c8 01 00 ff 01 ff fc 00 00 02 01 fe ad 00 00 05 fa fd 92 00];
        qcom,mdss-dsi-default-command = [29 00 00 00 00 00 02 b0 00 29 00 00 00 00 00 1f c7 05 14 1e 2a 3b 4a 54 62 47 50 5d 69 70 74 77 07 16 20 2a 3b 4a 54 62 47 4f 5a 66 6d 70 73 29 01 00 00 00 00 14 c8 01 00 00 fd 02 fc 00 00 ff 01 ff fc 00 00 01 f5 f6 fc 00];
        qcom,mdss-dsi-ceon-command = [29 01 00 00 00 00 02 b0 00 29 01 00 00 00 00 21 ca 01 80 dc f0 dc f0 dc f0 0c 3f 14 80 0a 4a 37 a0 55 f8 0c 0c 20 10 3f 3f 00 00 10 10 3f 3f 3f 3f];
        qcom,mdss-dsi-ceoff-command = [29 01 00 00 00 00 02 b0 00 29 01 00 00 00 00 21 ca 00 80 dc f0 dc f0 dc f0 0c 3f 14 80 0a 4a 37 a0 55 f8 0c 0c 20 10 3f 3f 00 00 10 10 3f 3f 3f 3f];
        qcom,mdss-dsi-on-command-state = "dsi_lp_mode";
        qcom,mdss-dsi-off-command-state = "dsi_lp_mode";
        qcom,mdss-dsi-bl-pmic-control-type = "bl_ctrl_wled";
        qcom,mdss-dsi-reset-sequence = <1 30>;
        qcom,mdss-dsi-tx-eot-append;
        qcom,cont-splash-enabled;
        qcom,panel-supply-entries = <&dsi_panel_pwr_supply>;
        qcom,mdss-pan-physical-width-dimension = <70>;
        qcom,mdss-pan-physical-height-dimension = <128>;
        qcom,mdss-dsi-cold-command-state = "dsi_hs_mode";
        qcom,mdss-dsi-warm-command-state = "dsi_hs_mode";
        qcom,mdss-dsi-default-command-state = "dsi_hs_mode";
        qcom,mdss-dsi-ceon-command-state = "dsi_lp_mode";
        qcom,mdss-dsi-ceoff-command-state = "dsi_lp_mode";
        qcom,mdss-dsi-panel-status-command = [06 01 00 01 05 00 02 0a 08];
        qcom,mdss-dsi-panel-status-command-state = "dsi_hs_mode";
        qcom,mdss-dsi-panel-status-check-mode = "reg_read";
        qcom,mdss-dsi-panel-status-value = <0x1c>;
        qcom,esd-check-enabled;
        qcom,mdss-night-brightness = <0x09 0x1b 0x2d 0x3f>;
    };
};
