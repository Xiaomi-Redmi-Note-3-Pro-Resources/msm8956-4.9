/*
 * Copyright (c) 2015, The Linux Foundation. All rights reserved.
 * Copyright (C) 2016, XiaoMi, Inc.
 * Copyright (c) 2023, Irawans Prjkt. All rights reserved.
 *
 * This program is free software; you can redistribute it and/or modify
 * it under the terms of the GNU General Public License version 2 and
 * only version 2 as published by the Free Software Foundation.
 *
 * This program is distributed in the hope that it will be useful,
 * but WITHOUT ANY WARRANTY; without even the implied warranty of
 * MERCHANTABILITY or FITNESS FOR A PARTICULAR PURPOSE.  See the
 * GNU General Public License for more details.
 */
&mdss_mdp {
    dsi_tianma_nt35596_1080_video: qcom,mdss_dsi_tianma_nt35596_1080p_video {
        qcom,mdss-dsi-cold-command = [23 00 00 00 00 00 02 ff 01 23 00 00 00 00 00 02 fb 01 23 00 00 00 00 00 02 75 00 23 00 00 00 00 00 02 76 e1 23 00 00 00 00 00 02 77 00 23 00 00 00 00 00 02 78 e7 23 00 00 00 00 00 02 79 00 23 00 00 00 00 00 02 7a f2 23 00 00 00 00 00 02 7b 00 23 00 00 00 00 00 02 7c fc 23 00 00 00 00 00 02 7d 01 23 00 00 00 00 00 02 7e 06 23 00 00 00 00 00 02 7f 01 23 00 00 00 00 00 02 80 0f 23 00 00 00 00 00 02 81 01 23 00 00 00 00 00 02 82 18 23 00 00 00 00 00 02 83 01 23 00 00 00 00 00 02 84 21 23 00 00 00 00 00 02 85 01 23 00 00 00 00 00 02 86 29 23 00 00 00 00 00 02 87 01 23 00 00 00 00 00 02 88 47 23 00 00 00 00 00 02 89 01 23 00 00 00 00 00 02 8a 62 23 00 00 00 00 00 02 8b 01 23 00 00 00 00 00 02 8c 91 23 00 00 00 00 00 02 8d 01 23 00 00 00 00 00 02 8e b7 23 00 00 00 00 00 02 8f 01 23 00 00 00 00 00 02 90 f8 23 00 00 00 00 00 02 91 02 23 00 00 00 00 00 02 92 2f 23 00 00 00 00 00 02 93 02 23 00 00 00 00 00 02 94 31 23 00 00 00 00 00 02 95 02 23 00 00 00 00 00 02 96 66 23 00 00 00 00 00 02 97 02 23 00 00 00 00 00 02 98 a6 23 00 00 00 00 00 02 99 02 23 00 00 00 00 00 02 9a cf 23 00 00 00 00 00 02 9b 03 23 00 00 00 00 00 02 9c 07 23 00 00 00 00 00 02 9d 03 23 00 00 00 00 00 02 9e 2b 23 00 00 00 00 00 02 9f 03 23 00 00 00 00 00 02 a0 58 23 00 00 00 00 00 02 a2 03 23 00 00 00 00 00 02 a3 65 23 00 00 00 00 00 02 a4 03 23 00 00 00 00 00 02 a5 70 23 00 00 00 00 00 02 a6 03 23 00 00 00 00 00 02 a7 79 23 00 00 00 00 00 02 a9 03 23 00 00 00 00 00 02 aa 8b 23 00 00 00 00 00 02 ab 03 23 00 00 00 00 00 02 ac 91 23 00 00 00 00 00 02 ad 03 23 00 00 00 00 00 02 ae 95 23 00 00 00 00 00 02 af 03 23 00 00 00 00 00 02 b0 a1 23 00 00 00 00 00 02 b1 03 23 00 00 00 00 00 02 b2 b2 23 00 00 00 00 00 02 b3 00 23 00 00 00 00 00 02 b4 e1 23 00 00 00 00 00 02 b5 00 23 00 00 00 00 00 02 b6 e7 23 00 00 00 00 00 02 b7 00 23 00 00 00 00 00 02 b8 f2 23 00 00 00 00 00 02 b9 00 23 00 00 00 00 00 02 ba fc 23 00 00 00 00 00 02 bb 01 23 00 00 00 00 00 02 bc 06 23 00 00 00 00 00 02 bd 01 23 00 00 00 00 00 02 be 0f 23 00 00 00 00 00 02 bf 01 23 00 00 00 00 00 02 c0 18 23 00 00 00 00 00 02 c1 01 23 00 00 00 00 00 02 c2 21 23 00 00 00 00 00 02 c3 01 23 00 00 00 00 00 02 c4 29 23 00 00 00 00 00 02 c5 01 23 00 00 00 00 00 02 c6 47 23 00 00 00 00 00 02 c7 01 23 00 00 00 00 00 02 c8 62 23 00 00 00 00 00 02 c9 01 23 00 00 00 00 00 02 ca 91 23 00 00 00 00 00 02 cb 01 23 00 00 00 00 00 02 cc b7 23 00 00 00 00 00 02 cd 01 23 00 00 00 00 00 02 ce f8 23 00 00 00 00 00 02 cf 02 23 00 00 00 00 00 02 d0 2f 23 00 00 00 00 00 02 d1 02 23 00 00 00 00 00 02 d2 31 23 00 00 00 00 00 02 d3 02 23 00 00 00 00 00 02 d4 66 23 00 00 00 00 00 02 d5 02 23 00 00 00 00 00 02 d6 a6 23 00 00 00 00 00 02 d7 02 23 00 00 00 00 00 02 d8 cf 23 00 00 00 00 00 02 d9 03 23 00 00 00 00 00 02 da 07 23 00 00 00 00 00 02 db 03 23 00 00 00 00 00 02 dc 2b 23 00 00 00 00 00 02 dd 03 23 00 00 00 00 00 02 de 58 23 00 00 00 00 00 02 df 03 23 00 00 00 00 00 02 e0 65 23 00 00 00 00 00 02 e1 03 23 00 00 00 00 00 02 e2 70 23 00 00 00 00 00 02 e3 03 23 00 00 00 00 00 02 e4 79 23 00 00 00 00 00 02 e5 03 23 00 00 00 00 00 02 e6 8b 23 00 00 00 00 00 02 e7 03 23 00 00 00 00 00 02 e8 91 23 00 00 00 00 00 02 e9 03 23 00 00 00 00 00 02 ea 95 23 00 00 00 00 00 02 eb 03 23 00 00 00 00 00 02 ec a1 23 00 00 00 00 00 02 ed 03 23 01 00 00 00 00 02 ee b2 23 00 00 00 00 00 02 ef 00 23 00 00 00 00 00 02 f0 a1 23 00 00 00 00 00 02 f1 00 23 00 00 00 00 00 02 f2 a9 23 00 00 00 00 00 02 f3 00 23 00 00 00 00 00 02 f4 b8 23 00 00 00 00 00 02 f5 00 23 00 00 00 00 00 02 f6 c6 23 00 00 00 00 00 02 f7 00 23 00 00 00 00 00 02 f8 d3 23 00 00 00 00 00 02 f9 00 23 00 00 00 00 00 02 fa df 23 00 00 00 00 00 02 ff 02 23 00 00 00 00 00 02 fb 01 23 00 00 00 00 00 02 00 00 23 00 00 00 00 00 02 01 ea 23 00 00 00 00 00 02 02 00 23 00 00 00 00 00 02 03 f5 23 00 00 00 00 00 02 04 00 23 00 00 00 00 00 02 05 ff 23 00 00 00 00 00 02 06 01 23 00 00 00 00 00 02 07 25 23 00 00 00 00 00 02 08 01 23 00 00 00 00 00 02 09 44 23 00 00 00 00 00 02 0a 01 23 00 00 00 00 00 02 0b 79 23 00 00 00 00 00 02 0c 01 23 00 00 00 00 00 02 0d a5 23 00 00 00 00 00 02 0e 01 23 00 00 00 00 00 02 0f ec 23 00 00 00 00 00 02 10 02 23 00 00 00 00 00 02 11 26 23 00 00 00 00 00 02 12 02 23 00 00 00 00 00 02 13 28 23 00 00 00 00 00 02 14 02 23 00 00 00 00 00 02 15 60 23 00 00 00 00 00 02 16 02 23 00 00 00 00 00 02 17 a1 23 00 00 00 00 00 02 18 02 23 00 00 00 00 00 02 19 cb 23 00 00 00 00 00 02 1a 03 23 00 00 00 00 00 02 1b 03 23 00 00 00 00 00 02 1c 03 23 00 00 00 00 00 02 1d 28 23 00 00 00 00 00 02 1e 03 23 00 00 00 00 00 02 1f 53 23 00 00 00 00 00 02 20 03 23 00 00 00 00 00 02 21 60 23 00 00 00 00 00 02 22 03 23 00 00 00 00 00 02 23 6f 23 00 00 00 00 00 02 24 03 23 00 00 00 00 00 02 25 7d 23 00 00 00 00 00 02 26 03 23 00 00 00 00 00 02 27 8d 23 00 00 00 00 00 02 28 03 23 00 00 00 00 00 02 29 9b 23 00 00 00 00 00 02 2a 03 23 00 00 00 00 00 02 2b a9 23 00 00 00 00 00 02 2d 03 23 00 00 00 00 00 02 2f aa 23 00 00 00 00 00 02 30 03 23 00 00 00 00 00 02 31 b2 23 00 00 00 00 00 02 32 00 23 00 00 00 00 00 02 33 a1 23 00 00 00 00 00 02 34 00 23 00 00 00 00 00 02 35 a9 23 00 00 00 00 00 02 36 00 23 00 00 00 00 00 02 37 b8 23 00 00 00 00 00 02 38 00 23 00 00 00 00 00 02 39 c6 23 00 00 00 00 00 02 3a 00 23 00 00 00 00 00 02 3b d3 23 00 00 00 00 00 02 3d 00 23 00 00 00 00 00 02 3f df 23 00 00 00 00 00 02 40 00 23 00 00 00 00 00 02 41 ea 23 00 00 00 00 00 02 42 00 23 00 00 00 00 00 02 43 f5 23 00 00 00 00 00 02 44 00 23 00 00 00 00 00 02 45 ff 23 00 00 00 00 00 02 46 01 23 00 00 00 00 00 02 47 25 23 00 00 00 00 00 02 48 01 23 00 00 00 00 00 02 49 44 23 00 00 00 00 00 02 4a 01 23 00 00 00 00 00 02 4b 79 23 00 00 00 00 00 02 4c 01 23 00 00 00 00 00 02 4d a5 23 00 00 00 00 00 02 4e 01 23 00 00 00 00 00 02 4f ec 23 00 00 00 00 00 02 50 02 23 00 00 00 00 00 02 51 26 23 00 00 00 00 00 02 52 02 23 00 00 00 00 00 02 53 28 23 00 00 00 00 00 02 54 02 23 00 00 00 00 00 02 55 60 23 00 00 00 00 00 02 56 02 23 00 00 00 00 00 02 58 a1 23 00 00 00 00 00 02 59 02 23 00 00 00 00 00 02 5a cb 23 00 00 00 00 00 02 5b 03 23 00 00 00 00 00 02 5c 03 23 00 00 00 00 00 02 5d 03 23 00 00 00 00 00 02 5e 28 23 00 00 00 00 00 02 5f 03 23 00 00 00 00 00 02 60 53 23 00 00 00 00 00 02 61 03 23 00 00 00 00 00 02 62 60 23 00 00 00 00 00 02 63 03 23 00 00 00 00 00 02 64 6f 23 00 00 00 00 00 02 65 03 23 00 00 00 00 00 02 66 7d 23 00 00 00 00 00 02 67 03 23 00 00 00 00 00 02 68 8d 23 00 00 00 00 00 02 69 03 23 00 00 00 00 00 02 6a 9b 23 00 00 00 00 00 02 6b 03 23 00 00 00 00 00 02 6c a9 23 00 00 00 00 00 02 6d 03 23 00 00 00 00 00 02 6e aa 23 00 00 00 00 00 02 6f 03 23 01 00 00 00 00 02 70 b2 23 00 00 00 00 00 02 71 00 23 00 00 00 00 00 02 72 36 23 00 00 00 00 00 02 73 00 23 00 00 00 00 00 02 74 3a 23 00 00 00 00 00 02 75 00 23 00 00 00 00 00 02 76 52 23 00 00 00 00 00 02 77 00 23 00 00 00 00 00 02 78 69 23 00 00 00 00 00 02 79 00 23 00 00 00 00 00 02 7a 7d 23 00 00 00 00 00 02 7b 00 23 00 00 00 00 00 02 7c 90 23 00 00 00 00 00 02 7d 00 23 00 00 00 00 00 02 7e a0 23 00 00 00 00 00 02 7f 00 23 00 00 00 00 00 02 80 af 23 00 00 00 00 00 02 81 00 23 00 00 00 00 00 02 82 bd 23 00 00 00 00 00 02 83 00 23 00 00 00 00 00 02 84 ef 23 00 00 00 00 00 02 85 01 23 00 00 00 00 00 02 86 17 23 00 00 00 00 00 02 87 01 23 00 00 00 00 00 02 88 57 23 00 00 00 00 00 02 89 01 23 00 00 00 00 00 02 8a 8b 23 00 00 00 00 00 02 8b 01 23 00 00 00 00 00 02 8c db 23 00 00 00 00 00 02 8d 02 23 00 00 00 00 00 02 8e 1a 23 00 00 00 00 00 02 8f 02 23 00 00 00 00 00 02 90 1c 23 00 00 00 00 00 02 91 02 23 00 00 00 00 00 02 92 56 23 00 00 00 00 00 02 93 02 23 00 00 00 00 00 02 94 98 23 00 00 00 00 00 02 95 02 23 00 00 00 00 00 02 96 c3 23 00 00 00 00 00 02 97 02 23 00 00 00 00 00 02 98 fa 23 00 00 00 00 00 02 99 03 23 00 00 00 00 00 02 9a 1f 23 00 00 00 00 00 02 9b 03 23 00 00 00 00 00 02 9c 52 23 00 00 00 00 00 02 9d 03 23 00 00 00 00 00 02 9e 5f 23 00 00 00 00 00 02 9f 03 23 00 00 00 00 00 02 a0 79 23 00 00 00 00 00 02 a2 03 23 00 00 00 00 00 02 a3 7e 23 00 00 00 00 00 02 a4 03 23 00 00 00 00 00 02 a5 ae 23 00 00 00 00 00 02 a6 03 23 00 00 00 00 00 02 a7 b0 23 00 00 00 00 00 02 a9 03 23 00 00 00 00 00 02 aa b2 23 00 00 00 00 00 02 ab 03 23 00 00 00 00 00 02 ac b2 23 00 00 00 00 00 02 ad 03 23 00 00 00 00 00 02 ae b2 23 00 00 00 00 00 02 af 00 23 00 00 00 00 00 02 b0 36 23 00 00 00 00 00 02 b1 00 23 00 00 00 00 00 02 b2 3a 23 00 00 00 00 00 02 b3 00 23 00 00 00 00 00 02 b4 52 23 00 00 00 00 00 02 b5 00 23 00 00 00 00 00 02 b6 69 23 00 00 00 00 00 02 b7 00 23 00 00 00 00 00 02 b8 7d 23 00 00 00 00 00 02 b9 00 23 00 00 00 00 00 02 ba 90 23 00 00 00 00 00 02 bb 00 23 00 00 00 00 00 02 bc a0 23 00 00 00 00 00 02 bd 00 23 00 00 00 00 00 02 be af 23 00 00 00 00 00 02 bf 00 23 00 00 00 00 00 02 c0 bd 23 00 00 00 00 00 02 c1 00 23 00 00 00 00 00 02 c2 ef 23 00 00 00 00 00 02 c3 01 23 00 00 00 00 00 02 c4 17 23 00 00 00 00 00 02 c5 01 23 00 00 00 00 00 02 c6 57 23 00 00 00 00 00 02 c7 01 23 00 00 00 00 00 02 c8 8b 23 00 00 00 00 00 02 c9 01 23 00 00 00 00 00 02 ca db 23 00 00 00 00 00 02 cb 02 23 00 00 00 00 00 02 cc 1a 23 00 00 00 00 00 02 cd 02 23 00 00 00 00 00 02 ce 1c 23 00 00 00 00 00 02 cf 02 23 00 00 00 00 00 02 d0 56 23 00 00 00 00 00 02 d1 02 23 00 00 00 00 00 02 d2 98 23 00 00 00 00 00 02 d3 02 23 00 00 00 00 00 02 d4 c3 23 00 00 00 00 00 02 d5 02 23 00 00 00 00 00 02 d6 fa 23 00 00 00 00 00 02 d7 03 23 00 00 00 00 00 02 d8 1f 23 00 00 00 00 00 02 d9 03 23 00 00 00 00 00 02 da 52 23 00 00 00 00 00 02 db 03 23 00 00 00 00 00 02 dc 5f 23 00 00 00 00 00 02 dd 03 23 00 00 00 00 00 02 de 79 23 00 00 00 00 00 02 df 03 23 00 00 00 00 00 02 e0 7e 23 00 00 00 00 00 02 e1 03 23 00 00 00 00 00 02 e2 ae 23 00 00 00 00 00 02 e3 03 23 00 00 00 00 00 02 e4 b0 23 00 00 00 00 00 02 e5 03 23 00 00 00 00 00 02 e6 b2 23 00 00 00 00 00 02 e7 03 23 00 00 00 00 00 02 e8 b2 23 00 00 00 00 00 02 e9 03 23 00 00 00 00 00 02 ea b2 23 01 00 00 00 00 02 ff 00];
        qcom,mdss-dsi-warm-command = [23 00 00 00 00 00 02 ff 01 23 00 00 00 00 00 02 fb 01 23 00 00 00 00 00 02 75 00 23 00 00 00 00 00 02 76 24 23 00 00 00 00 00 02 77 00 23 00 00 00 00 00 02 78 35 23 00 00 00 00 00 02 79 00 23 00 00 00 00 00 02 7a 54 23 00 00 00 00 00 02 7b 00 23 00 00 00 00 00 02 7c 6c 23 00 00 00 00 00 02 7d 00 23 00 00 00 00 00 02 7e 81 23 00 00 00 00 00 02 7f 00 23 00 00 00 00 00 02 80 94 23 00 00 00 00 00 02 81 00 23 00 00 00 00 00 02 82 a4 23 00 00 00 00 00 02 83 00 23 00 00 00 00 00 02 84 b3 23 00 00 00 00 00 02 85 00 23 00 00 00 00 00 02 86 c1 23 00 00 00 00 00 02 87 00 23 00 00 00 00 00 02 88 f1 23 00 00 00 00 00 02 89 01 23 00 00 00 00 00 02 8a 17 23 00 00 00 00 00 02 8b 01 23 00 00 00 00 00 02 8c 55 23 00 00 00 00 00 02 8d 01 23 00 00 00 00 00 02 8e 86 23 00 00 00 00 00 02 8f 01 23 00 00 00 00 00 02 90 d3 23 00 00 00 00 00 02 91 02 23 00 00 00 00 00 02 92 11 23 00 00 00 00 00 02 93 02 23 00 00 00 00 00 02 94 13 23 00 00 00 00 00 02 95 02 23 00 00 00 00 00 02 96 4b 23 00 00 00 00 00 02 97 02 23 00 00 00 00 00 02 98 8a 23 00 00 00 00 00 02 99 02 23 00 00 00 00 00 02 9a b1 23 00 00 00 00 00 02 9b 02 23 00 00 00 00 00 02 9c e6 23 00 00 00 00 00 02 9d 03 23 00 00 00 00 00 02 9e 0a 23 00 00 00 00 00 02 9f 03 23 00 00 00 00 00 02 a0 38 23 00 00 00 00 00 02 a2 03 23 00 00 00 00 00 02 a3 45 23 00 00 00 00 00 02 a4 03 23 00 00 00 00 00 02 a5 55 23 00 00 00 00 00 02 a6 03 23 00 00 00 00 00 02 a7 64 23 00 00 00 00 00 02 a9 03 23 00 00 00 00 00 02 aa 77 23 00 00 00 00 00 02 ab 03 23 00 00 00 00 00 02 ac 90 23 00 00 00 00 00 02 ad 03 23 00 00 00 00 00 02 ae a2 23 00 00 00 00 00 02 af 03 23 00 00 00 00 00 02 b0 a5 23 00 00 00 00 00 02 b1 03 23 00 00 00 00 00 02 b2 b2 23 00 00 00 00 00 02 b3 00 23 00 00 00 00 00 02 b4 24 23 00 00 00 00 00 02 b5 00 23 00 00 00 00 00 02 b6 35 23 00 00 00 00 00 02 b7 00 23 00 00 00 00 00 02 b8 54 23 00 00 00 00 00 02 b9 00 23 00 00 00 00 00 02 ba 6c 23 00 00 00 00 00 02 bb 00 23 00 00 00 00 00 02 bc 81 23 00 00 00 00 00 02 bd 00 23 00 00 00 00 00 02 be 94 23 00 00 00 00 00 02 bf 00 23 00 00 00 00 00 02 c0 a4 23 00 00 00 00 00 02 c1 00 23 00 00 00 00 00 02 c2 b3 23 00 00 00 00 00 02 c3 00 23 00 00 00 00 00 02 c4 c1 23 00 00 00 00 00 02 c5 00 23 00 00 00 00 00 02 c6 f1 23 00 00 00 00 00 02 c7 01 23 00 00 00 00 00 02 c8 17 23 00 00 00 00 00 02 c9 01 23 00 00 00 00 00 02 ca 55 23 00 00 00 00 00 02 cb 01 23 00 00 00 00 00 02 cc 86 23 00 00 00 00 00 02 cd 01 23 00 00 00 00 00 02 ce d3 23 00 00 00 00 00 02 cf 02 23 00 00 00 00 00 02 d0 11 23 00 00 00 00 00 02 d1 02 23 00 00 00 00 00 02 d2 13 23 00 00 00 00 00 02 d3 02 23 00 00 00 00 00 02 d4 4b 23 00 00 00 00 00 02 d5 02 23 00 00 00 00 00 02 d6 8a 23 00 00 00 00 00 02 d7 02 23 00 00 00 00 00 02 d8 b1 23 00 00 00 00 00 02 d9 02 23 00 00 00 00 00 02 da e6 23 00 00 00 00 00 02 db 03 23 00 00 00 00 00 02 dc 0a 23 00 00 00 00 00 02 dd 03 23 00 00 00 00 00 02 de 38 23 00 00 00 00 00 02 df 03 23 00 00 00 00 00 02 e0 45 23 00 00 00 00 00 02 e1 03 23 00 00 00 00 00 02 e2 55 23 00 00 00 00 00 02 e3 03 23 00 00 00 00 00 02 e4 64 23 00 00 00 00 00 02 e5 03 23 00 00 00 00 00 02 e6 77 23 00 00 00 00 00 02 e7 03 23 00 00 00 00 00 02 e8 90 23 00 00 00 00 00 02 e9 03 23 00 00 00 00 00 02 ea a2 23 00 00 00 00 00 02 eb 03 23 00 00 00 00 00 02 ec a5 23 00 00 00 00 00 02 ed 03 23 01 00 00 00 00 02 ee b2 23 00 00 00 00 00 02 ef 00 23 00 00 00 00 00 02 f0 a0 23 00 00 00 00 00 02 f1 00 23 00 00 00 00 00 02 f2 a8 23 00 00 00 00 00 02 f3 00 23 00 00 00 00 00 02 f4 b5 23 00 00 00 00 00 02 f5 00 23 00 00 00 00 00 02 f6 c2 23 00 00 00 00 00 02 f7 00 23 00 00 00 00 00 02 f8 ce 23 00 00 00 00 00 02 f9 00 23 00 00 00 00 00 02 fa da 23 00 00 00 00 00 02 ff 02 23 00 00 00 00 00 02 fb 01 23 00 00 00 00 00 02 00 00 23 00 00 00 00 00 02 01 e5 23 00 00 00 00 00 02 02 00 23 00 00 00 00 00 02 03 ef 23 00 00 00 00 00 02 04 00 23 00 00 00 00 00 02 05 f8 23 00 00 00 00 00 02 06 01 23 00 00 00 00 00 02 07 1c 23 00 00 00 00 00 02 08 01 23 00 00 00 00 00 02 09 3a 23 00 00 00 00 00 02 0a 01 23 00 00 00 00 00 02 0b 6d 23 00 00 00 00 00 02 0c 01 23 00 00 00 00 00 02 0d 99 23 00 00 00 00 00 02 0e 01 23 00 00 00 00 00 02 0f df 23 00 00 00 00 00 02 10 02 23 00 00 00 00 00 02 11 19 23 00 00 00 00 00 02 12 02 23 00 00 00 00 00 02 13 1b 23 00 00 00 00 00 02 14 02 23 00 00 00 00 00 02 15 51 23 00 00 00 00 00 02 16 02 23 00 00 00 00 00 02 17 8f 23 00 00 00 00 00 02 18 02 23 00 00 00 00 00 02 19 b7 23 00 00 00 00 00 02 1a 02 23 00 00 00 00 00 02 1b ec 23 00 00 00 00 00 02 1c 03 23 00 00 00 00 00 02 1d 0f 23 00 00 00 00 00 02 1e 03 23 00 00 00 00 00 02 1f 3d 23 00 00 00 00 00 02 20 03 23 00 00 00 00 00 02 21 4a 23 00 00 00 00 00 02 22 03 23 00 00 00 00 00 02 23 5a 23 00 00 00 00 00 02 24 03 23 00 00 00 00 00 02 25 69 23 00 00 00 00 00 02 26 03 23 00 00 00 00 00 02 27 7b 23 00 00 00 00 00 02 28 03 23 00 00 00 00 00 02 29 8d 23 00 00 00 00 00 02 2a 03 23 00 00 00 00 00 02 2b a3 23 00 00 00 00 00 02 2d 03 23 00 00 00 00 00 02 2f b1 23 00 00 00 00 00 02 30 03 23 00 00 00 00 00 02 31 b2 23 00 00 00 00 00 02 32 00 23 00 00 00 00 00 02 33 a0 23 00 00 00 00 00 02 34 00 23 00 00 00 00 00 02 35 a8 23 00 00 00 00 00 02 36 00 23 00 00 00 00 00 02 37 b5 23 00 00 00 00 00 02 38 00 23 00 00 00 00 00 02 39 c2 23 00 00 00 00 00 02 3a 00 23 00 00 00 00 00 02 3b ce 23 00 00 00 00 00 02 3d 00 23 00 00 00 00 00 02 3f da 23 00 00 00 00 00 02 40 00 23 00 00 00 00 00 02 41 e5 23 00 00 00 00 00 02 42 00 23 00 00 00 00 00 02 43 ef 23 00 00 00 00 00 02 44 00 23 00 00 00 00 00 02 45 f8 23 00 00 00 00 00 02 46 01 23 00 00 00 00 00 02 47 1c 23 00 00 00 00 00 02 48 01 23 00 00 00 00 00 02 49 3a 23 00 00 00 00 00 02 4a 01 23 00 00 00 00 00 02 4b 6d 23 00 00 00 00 00 02 4c 01 23 00 00 00 00 00 02 4d 99 23 00 00 00 00 00 02 4e 01 23 00 00 00 00 00 02 4f df 23 00 00 00 00 00 02 50 02 23 00 00 00 00 00 02 51 19 23 00 00 00 00 00 02 52 02 23 00 00 00 00 00 02 53 1b 23 00 00 00 00 00 02 54 02 23 00 00 00 00 00 02 55 51 23 00 00 00 00 00 02 56 02 23 00 00 00 00 00 02 58 8f 23 00 00 00 00 00 02 59 02 23 00 00 00 00 00 02 5a b7 23 00 00 00 00 00 02 5b 02 23 00 00 00 00 00 02 5c ec 23 00 00 00 00 00 02 5d 03 23 00 00 00 00 00 02 5e 0f 23 00 00 00 00 00 02 5f 03 23 00 00 00 00 00 02 60 3d 23 00 00 00 00 00 02 61 03 23 00 00 00 00 00 02 62 4a 23 00 00 00 00 00 02 63 03 23 00 00 00 00 00 02 64 5a 23 00 00 00 00 00 02 65 03 23 00 00 00 00 00 02 66 69 23 00 00 00 00 00 02 67 03 23 00 00 00 00 00 02 68 7b 23 00 00 00 00 00 02 69 03 23 00 00 00 00 00 02 6a 8d 23 00 00 00 00 00 02 6b 03 23 00 00 00 00 00 02 6c a3 23 00 00 00 00 00 02 6d 03 23 00 00 00 00 00 02 6e b1 23 00 00 00 00 00 02 6f 03 23 01 00 00 00 00 02 70 b2 23 00 00 00 00 00 02 71 00 23 00 00 00 00 00 02 72 d0 23 00 00 00 00 00 02 73 00 23 00 00 00 00 00 02 74 d9 23 00 00 00 00 00 02 75 00 23 00 00 00 00 00 02 76 e3 23 00 00 00 00 00 02 77 00 23 00 00 00 00 00 02 78 ed 23 00 00 00 00 00 02 79 00 23 00 00 00 00 00 02 7a f6 23 00 00 00 00 00 02 7b 00 23 00 00 00 00 00 02 7c ff 23 00 00 00 00 00 02 7d 01 23 00 00 00 00 00 02 7e 08 23 00 00 00 00 00 02 7f 01 23 00 00 00 00 00 02 80 10 23 00 00 00 00 00 02 81 01 23 00 00 00 00 00 02 82 19 23 00 00 00 00 00 02 83 01 23 00 00 00 00 00 02 84 36 23 00 00 00 00 00 02 85 01 23 00 00 00 00 00 02 86 50 23 00 00 00 00 00 02 87 01 23 00 00 00 00 00 02 88 7f 23 00 00 00 00 00 02 89 01 23 00 00 00 00 00 02 8a a6 23 00 00 00 00 00 02 8b 01 23 00 00 00 00 00 02 8c e9 23 00 00 00 00 00 02 8d 02 23 00 00 00 00 00 02 8e 20 23 00 00 00 00 00 02 8f 02 23 00 00 00 00 00 02 90 21 23 00 00 00 00 00 02 91 02 23 00 00 00 00 00 02 92 56 23 00 00 00 00 00 02 93 02 23 00 00 00 00 00 02 94 93 23 00 00 00 00 00 02 95 02 23 00 00 00 00 00 02 96 ba 23 00 00 00 00 00 02 97 02 23 00 00 00 00 00 02 98 ee 23 00 00 00 00 00 02 99 03 23 00 00 00 00 00 02 9a 10 23 00 00 00 00 00 02 9b 03 23 00 00 00 00 00 02 9c 39 23 00 00 00 00 00 02 9d 03 23 00 00 00 00 00 02 9e 48 23 00 00 00 00 00 02 9f 03 23 00 00 00 00 00 02 a0 51 23 00 00 00 00 00 02 a2 03 23 00 00 00 00 00 02 a3 5f 23 00 00 00 00 00 02 a4 03 23 00 00 00 00 00 02 a5 77 23 00 00 00 00 00 02 a6 03 23 00 00 00 00 00 02 a7 7d 23 00 00 00 00 00 02 a9 03 23 00 00 00 00 00 02 aa 80 23 00 00 00 00 00 02 ab 03 23 00 00 00 00 00 02 ac a2 23 00 00 00 00 00 02 ad 03 23 00 00 00 00 00 02 ae b2 23 00 00 00 00 00 02 af 00 23 00 00 00 00 00 02 b0 d0 23 00 00 00 00 00 02 b1 00 23 00 00 00 00 00 02 b2 d9 23 00 00 00 00 00 02 b3 00 23 00 00 00 00 00 02 b4 e3 23 00 00 00 00 00 02 b5 00 23 00 00 00 00 00 02 b6 ed 23 00 00 00 00 00 02 b7 00 23 00 00 00 00 00 02 b8 f6 23 00 00 00 00 00 02 b9 00 23 00 00 00 00 00 02 ba ff 23 00 00 00 00 00 02 bb 01 23 00 00 00 00 00 02 bc 08 23 00 00 00 00 00 02 bd 01 23 00 00 00 00 00 02 be 10 23 00 00 00 00 00 02 bf 01 23 00 00 00 00 00 02 c0 19 23 00 00 00 00 00 02 c1 01 23 00 00 00 00 00 02 c2 36 23 00 00 00 00 00 02 c3 01 23 00 00 00 00 00 02 c4 50 23 00 00 00 00 00 02 c5 01 23 00 00 00 00 00 02 c6 7f 23 00 00 00 00 00 02 c7 01 23 00 00 00 00 00 02 c8 a6 23 00 00 00 00 00 02 c9 01 23 00 00 00 00 00 02 ca e9 23 00 00 00 00 00 02 cb 02 23 00 00 00 00 00 02 cc 20 23 00 00 00 00 00 02 cd 02 23 00 00 00 00 00 02 ce 21 23 00 00 00 00 00 02 cf 02 23 00 00 00 00 00 02 d0 56 23 00 00 00 00 00 02 d1 02 23 00 00 00 00 00 02 d2 93 23 00 00 00 00 00 02 d3 02 23 00 00 00 00 00 02 d4 ba 23 00 00 00 00 00 02 d5 02 23 00 00 00 00 00 02 d6 ee 23 00 00 00 00 00 02 d7 03 23 00 00 00 00 00 02 d8 10 23 00 00 00 00 00 02 d9 03 23 00 00 00 00 00 02 da 39 23 00 00 00 00 00 02 db 03 23 00 00 00 00 00 02 dc 48 23 00 00 00 00 00 02 dd 03 23 00 00 00 00 00 02 de 51 23 00 00 00 00 00 02 df 03 23 00 00 00 00 00 02 e0 5f 23 00 00 00 00 00 02 e1 03 23 00 00 00 00 00 02 e2 77 23 00 00 00 00 00 02 e3 03 23 00 00 00 00 00 02 e4 7d 23 00 00 00 00 00 02 e5 03 23 00 00 00 00 00 02 e6 80 23 00 00 00 00 00 02 e7 03 23 00 00 00 00 00 02 e8 a2 23 00 00 00 00 00 02 e9 03 23 00 00 00 00 00 02 ea b2 23 01 00 00 00 00 02 ff 00];
        qcom,mdss-dsi-default-command = [23 00 00 00 00 00 02 ff 01 23 00 00 00 00 00 02 fb 01 23 00 00 00 00 00 02 75 00 23 00 00 00 00 00 02 76 00 23 00 00 00 00 00 02 77 00 23 00 00 00 00 00 02 78 21 23 00 00 00 00 00 02 79 00 23 00 00 00 00 00 02 7a 4a 23 00 00 00 00 00 02 7b 00 23 00 00 00 00 00 02 7c 66 23 00 00 00 00 00 02 7d 00 23 00 00 00 00 00 02 7e 7f 23 00 00 00 00 00 02 7f 00 23 00 00 00 00 00 02 80 94 23 00 00 00 00 00 02 81 00 23 00 00 00 00 00 02 82 a7 23 00 00 00 00 00 02 83 00 23 00 00 00 00 00 02 84 b8 23 00 00 00 00 00 02 85 00 23 00 00 00 00 00 02 86 c7 23 00 00 00 00 00 02 87 00 23 00 00 00 00 00 02 88 fb 23 00 00 00 00 00 02 89 01 23 00 00 00 00 00 02 8a 25 23 00 00 00 00 00 02 8b 01 23 00 00 00 00 00 02 8c 61 23 00 00 00 00 00 02 8d 01 23 00 00 00 00 00 02 8e 94 23 00 00 00 00 00 02 8f 01 23 00 00 00 00 00 02 90 e2 23 00 00 00 00 00 02 91 02 23 00 00 00 00 00 02 92 20 23 00 00 00 00 00 02 93 02 23 00 00 00 00 00 02 94 22 23 00 00 00 00 00 02 95 02 23 00 00 00 00 00 02 96 5c 23 00 00 00 00 00 02 97 02 23 00 00 00 00 00 02 98 9e 23 00 00 00 00 00 02 99 02 23 00 00 00 00 00 02 9a c9 23 00 00 00 00 00 02 9b 03 23 00 00 00 00 00 02 9c 01 23 00 00 00 00 00 02 9d 03 23 00 00 00 00 00 02 9e 28 23 00 00 00 00 00 02 9f 03 23 00 00 00 00 00 02 a0 55 23 00 00 00 00 00 02 a2 03 23 00 00 00 00 00 02 a3 62 23 00 00 00 00 00 02 a4 03 23 00 00 00 00 00 02 a5 6f 23 00 00 00 00 00 02 a6 03 23 00 00 00 00 00 02 a7 7e 23 00 00 00 00 00 02 a9 03 23 00 00 00 00 00 02 aa 8f 23 00 00 00 00 00 02 ab 03 23 00 00 00 00 00 02 ac 9c 23 00 00 00 00 00 02 ad 03 23 00 00 00 00 00 02 ae a2 23 00 00 00 00 00 02 af 03 23 00 00 00 00 00 02 b0 ab 23 00 00 00 00 00 02 b1 03 23 00 00 00 00 00 02 b2 b2 23 00 00 00 00 00 02 b3 00 23 00 00 00 00 00 02 b4 00 23 00 00 00 00 00 02 b5 00 23 00 00 00 00 00 02 b6 21 23 00 00 00 00 00 02 b7 00 23 00 00 00 00 00 02 b8 4a 23 00 00 00 00 00 02 b9 00 23 00 00 00 00 00 02 ba 66 23 00 00 00 00 00 02 bb 00 23 00 00 00 00 00 02 bc 7f 23 00 00 00 00 00 02 bd 00 23 00 00 00 00 00 02 be 94 23 00 00 00 00 00 02 bf 00 23 00 00 00 00 00 02 c0 a7 23 00 00 00 00 00 02 c1 00 23 00 00 00 00 00 02 c2 b8 23 00 00 00 00 00 02 c3 00 23 00 00 00 00 00 02 c4 c7 23 00 00 00 00 00 02 c5 00 23 00 00 00 00 00 02 c6 fb 23 00 00 00 00 00 02 c7 01 23 00 00 00 00 00 02 c8 25 23 00 00 00 00 00 02 c9 01 23 00 00 00 00 00 02 ca 61 23 00 00 00 00 00 02 cb 01 23 00 00 00 00 00 02 cc 94 23 00 00 00 00 00 02 cd 01 23 00 00 00 00 00 02 ce e2 23 00 00 00 00 00 02 cf 02 23 00 00 00 00 00 02 d0 20 23 00 00 00 00 00 02 d1 02 23 00 00 00 00 00 02 d2 22 23 00 00 00 00 00 02 d3 02 23 00 00 00 00 00 02 d4 5c 23 00 00 00 00 00 02 d5 02 23 00 00 00 00 00 02 d6 9e 23 00 00 00 00 00 02 d7 02 23 00 00 00 00 00 02 d8 c9 23 00 00 00 00 00 02 d9 03 23 00 00 00 00 00 02 da 01 23 00 00 00 00 00 02 db 03 23 00 00 00 00 00 02 dc 28 23 00 00 00 00 00 02 dd 03 23 00 00 00 00 00 02 de 55 23 00 00 00 00 00 02 df 03 23 00 00 00 00 00 02 e0 62 23 00 00 00 00 00 02 e1 03 23 00 00 00 00 00 02 e2 6f 23 00 00 00 00 00 02 e3 03 23 00 00 00 00 00 02 e4 7e 23 00 00 00 00 00 02 e5 03 23 00 00 00 00 00 02 e6 8f 23 00 00 00 00 00 02 e7 03 23 00 00 00 00 00 02 e8 9c 23 00 00 00 00 00 02 e9 03 23 00 00 00 00 00 02 ea a2 23 00 00 00 00 00 02 eb 03 23 00 00 00 00 00 02 ec ab 23 00 00 00 00 00 02 ed 03 23 01 00 00 00 00 02 ee b2 23 00 00 00 00 00 02 ef 00 23 00 00 00 00 00 02 f0 00 23 00 00 00 00 00 02 f1 00 23 00 00 00 00 00 02 f2 21 23 00 00 00 00 00 02 f3 00 23 00 00 00 00 00 02 f4 4a 23 00 00 00 00 00 02 f5 00 23 00 00 00 00 00 02 f6 66 23 00 00 00 00 00 02 f7 00 23 00 00 00 00 00 02 f8 7f 23 00 00 00 00 00 02 f9 00 23 00 00 00 00 00 02 fa 94 23 00 00 00 00 00 02 ff 02 23 00 00 00 00 00 02 fb 01 23 00 00 00 00 00 02 00 00 23 00 00 00 00 00 02 01 a7 23 00 00 00 00 00 02 02 00 23 00 00 00 00 00 02 03 b8 23 00 00 00 00 00 02 04 00 23 00 00 00 00 00 02 05 c7 23 00 00 00 00 00 02 06 00 23 00 00 00 00 00 02 07 fb 23 00 00 00 00 00 02 08 01 23 00 00 00 00 00 02 09 25 23 00 00 00 00 00 02 0a 01 23 00 00 00 00 00 02 0b 61 23 00 00 00 00 00 02 0c 01 23 00 00 00 00 00 02 0d 94 23 00 00 00 00 00 02 0e 01 23 00 00 00 00 00 02 0f e2 23 00 00 00 00 00 02 10 02 23 00 00 00 00 00 02 11 20 23 00 00 00 00 00 02 12 02 23 00 00 00 00 00 02 13 22 23 00 00 00 00 00 02 14 02 23 00 00 00 00 00 02 15 5c 23 00 00 00 00 00 02 16 02 23 00 00 00 00 00 02 17 9e 23 00 00 00 00 00 02 18 02 23 00 00 00 00 00 02 19 c9 23 00 00 00 00 00 02 1a 03 23 00 00 00 00 00 02 1b 01 23 00 00 00 00 00 02 1c 03 23 00 00 00 00 00 02 1d 28 23 00 00 00 00 00 02 1e 03 23 00 00 00 00 00 02 1f 55 23 00 00 00 00 00 02 20 03 23 00 00 00 00 00 02 21 62 23 00 00 00 00 00 02 22 03 23 00 00 00 00 00 02 23 6f 23 00 00 00 00 00 02 24 03 23 00 00 00 00 00 02 25 7e 23 00 00 00 00 00 02 26 03 23 00 00 00 00 00 02 27 8f 23 00 00 00 00 00 02 28 03 23 00 00 00 00 00 02 29 9c 23 00 00 00 00 00 02 2a 03 23 00 00 00 00 00 02 2b a2 23 00 00 00 00 00 02 2d 03 23 00 00 00 00 00 02 2f ab 23 00 00 00 00 00 02 30 03 23 00 00 00 00 00 02 31 b2 23 00 00 00 00 00 02 32 00 23 00 00 00 00 00 02 33 00 23 00 00 00 00 00 02 34 00 23 00 00 00 00 00 02 35 21 23 00 00 00 00 00 02 36 00 23 00 00 00 00 00 02 37 4a 23 00 00 00 00 00 02 38 00 23 00 00 00 00 00 02 39 66 23 00 00 00 00 00 02 3a 00 23 00 00 00 00 00 02 3b 7f 23 00 00 00 00 00 02 3d 00 23 00 00 00 00 00 02 3f 94 23 00 00 00 00 00 02 40 00 23 00 00 00 00 00 02 41 a7 23 00 00 00 00 00 02 42 00 23 00 00 00 00 00 02 43 b8 23 00 00 00 00 00 02 44 00 23 00 00 00 00 00 02 45 c7 23 00 00 00 00 00 02 46 00 23 00 00 00 00 00 02 47 fb 23 00 00 00 00 00 02 48 01 23 00 00 00 00 00 02 49 25 23 00 00 00 00 00 02 4a 01 23 00 00 00 00 00 02 4b 61 23 00 00 00 00 00 02 4c 01 23 00 00 00 00 00 02 4d 94 23 00 00 00 00 00 02 4e 01 23 00 00 00 00 00 02 4f e2 23 00 00 00 00 00 02 50 02 23 00 00 00 00 00 02 51 20 23 00 00 00 00 00 02 52 02 23 00 00 00 00 00 02 53 22 23 00 00 00 00 00 02 54 02 23 00 00 00 00 00 02 55 5c 23 00 00 00 00 00 02 56 02 23 00 00 00 00 00 02 58 9e 23 00 00 00 00 00 02 59 02 23 00 00 00 00 00 02 5a c9 23 00 00 00 00 00 02 5b 03 23 00 00 00 00 00 02 5c 01 23 00 00 00 00 00 02 5d 03 23 00 00 00 00 00 02 5e 28 23 00 00 00 00 00 02 5f 03 23 00 00 00 00 00 02 60 55 23 00 00 00 00 00 02 61 03 23 00 00 00 00 00 02 62 62 23 00 00 00 00 00 02 63 03 23 00 00 00 00 00 02 64 6f 23 00 00 00 00 00 02 65 03 23 00 00 00 00 00 02 66 7e 23 00 00 00 00 00 02 67 03 23 00 00 00 00 00 02 68 8f 23 00 00 00 00 00 02 69 03 23 00 00 00 00 00 02 6a 9c 23 00 00 00 00 00 02 6b 03 23 00 00 00 00 00 02 6c a2 23 00 00 00 00 00 02 6d 03 23 00 00 00 00 00 02 6e ab 23 00 00 00 00 00 02 6f 03 23 01 00 00 00 00 02 70 b2 23 00 00 00 00 00 02 71 00 23 00 00 00 00 00 02 72 00 23 00 00 00 00 00 02 73 00 23 00 00 00 00 00 02 74 1e 23 00 00 00 00 00 02 75 00 23 00 00 00 00 00 02 76 48 23 00 00 00 00 00 02 77 00 23 00 00 00 00 00 02 78 57 23 00 00 00 00 00 02 79 00 23 00 00 00 00 00 02 7a 6a 23 00 00 00 00 00 02 7b 00 23 00 00 00 00 00 02 7c 80 23 00 00 00 00 00 02 7d 00 23 00 00 00 00 00 02 7e 90 23 00 00 00 00 00 02 7f 00 23 00 00 00 00 00 02 80 a0 23 00 00 00 00 00 02 81 00 23 00 00 00 00 00 02 82 ae 23 00 00 00 00 00 02 83 00 23 00 00 00 00 00 02 84 e3 23 00 00 00 00 00 02 85 01 23 00 00 00 00 00 02 86 0e 23 00 00 00 00 00 02 87 01 23 00 00 00 00 00 02 88 50 23 00 00 00 00 00 02 89 01 23 00 00 00 00 00 02 8a 88 23 00 00 00 00 00 02 8b 01 23 00 00 00 00 00 02 8c da 23 00 00 00 00 00 02 8d 02 23 00 00 00 00 00 02 8e 19 23 00 00 00 00 00 02 8f 02 23 00 00 00 00 00 02 90 1b 23 00 00 00 00 00 02 91 02 23 00 00 00 00 00 02 92 58 23 00 00 00 00 00 02 93 02 23 00 00 00 00 00 02 94 9c 23 00 00 00 00 00 02 95 02 23 00 00 00 00 00 02 96 c6 23 00 00 00 00 00 02 97 03 23 00 00 00 00 00 02 98 01 23 00 00 00 00 00 02 99 03 23 00 00 00 00 00 02 9a 28 23 00 00 00 00 00 02 9b 03 23 00 00 00 00 00 02 9c 55 23 00 00 00 00 00 02 9d 03 23 00 00 00 00 00 02 9e 62 23 00 00 00 00 00 02 9f 03 23 00 00 00 00 00 02 a0 6f 23 00 00 00 00 00 02 a2 03 23 00 00 00 00 00 02 a3 7e 23 00 00 00 00 00 02 a4 03 23 00 00 00 00 00 02 a5 8f 23 00 00 00 00 00 02 a6 03 23 00 00 00 00 00 02 a7 9c 23 00 00 00 00 00 02 a9 03 23 00 00 00 00 00 02 aa a2 23 00 00 00 00 00 02 ab 03 23 00 00 00 00 00 02 ac ab 23 00 00 00 00 00 02 ad 03 23 00 00 00 00 00 02 ae b2 23 00 00 00 00 00 02 af 00 23 00 00 00 00 00 02 b0 00 23 00 00 00 00 00 02 b1 00 23 00 00 00 00 00 02 b2 1e 23 00 00 00 00 00 02 b3 00 23 00 00 00 00 00 02 b4 48 23 00 00 00 00 00 02 b5 00 23 00 00 00 00 00 02 b6 57 23 00 00 00 00 00 02 b7 00 23 00 00 00 00 00 02 b8 6a 23 00 00 00 00 00 02 b9 00 23 00 00 00 00 00 02 ba 80 23 00 00 00 00 00 02 bb 00 23 00 00 00 00 00 02 bc 90 23 00 00 00 00 00 02 bd 00 23 00 00 00 00 00 02 be a0 23 00 00 00 00 00 02 bf 00 23 00 00 00 00 00 02 c0 ae 23 00 00 00 00 00 02 c1 00 23 00 00 00 00 00 02 c2 e3 23 00 00 00 00 00 02 c3 01 23 00 00 00 00 00 02 c4 0e 23 00 00 00 00 00 02 c5 01 23 00 00 00 00 00 02 c6 50 23 00 00 00 00 00 02 c7 01 23 00 00 00 00 00 02 c8 88 23 00 00 00 00 00 02 c9 01 23 00 00 00 00 00 02 ca da 23 00 00 00 00 00 02 cb 02 23 00 00 00 00 00 02 cc 19 23 00 00 00 00 00 02 cd 02 23 00 00 00 00 00 02 ce 1b 23 00 00 00 00 00 02 cf 02 23 00 00 00 00 00 02 d0 58 23 00 00 00 00 00 02 d1 02 23 00 00 00 00 00 02 d2 9c 23 00 00 00 00 00 02 d3 02 23 00 00 00 00 00 02 d4 c6 23 00 00 00 00 00 02 d5 03 23 00 00 00 00 00 02 d6 01 23 00 00 00 00 00 02 d7 03 23 00 00 00 00 00 02 d8 28 23 00 00 00 00 00 02 d9 03 23 00 00 00 00 00 02 da 55 23 00 00 00 00 00 02 db 03 23 00 00 00 00 00 02 dc 62 23 00 00 00 00 00 02 dd 03 23 00 00 00 00 00 02 de 6f 23 00 00 00 00 00 02 df 03 23 00 00 00 00 00 02 e0 7e 23 00 00 00 00 00 02 e1 03 23 00 00 00 00 00 02 e2 8f 23 00 00 00 00 00 02 e3 03 23 00 00 00 00 00 02 e4 9c 23 00 00 00 00 00 02 e5 03 23 00 00 00 00 00 02 e6 a2 23 00 00 00 00 00 02 e7 03 23 00 00 00 00 00 02 e8 ab 23 00 00 00 00 00 02 e9 03 23 00 00 00 00 00 02 ea b2 23 01 00 00 00 00 02 ff 00];
        qcom,mdss-dsi-ceon-command = [23 01 00 00 00 00 02 55 80];
        qcom,mdss-dsi-ceoff-command = [23 01 00 00 00 00 02 55 00];
        qcom,mdss-dsi-eyecare-off-command = [23 00 00 00 00 00 02 ff 01 23 00 00 00 00 00 02 fb 01 23 00 00 00 00 00 02 75 00 23 00 00 00 00 00 02 76 00 23 00 00 00 00 00 02 77 00 23 00 00 00 00 00 02 78 21 23 00 00 00 00 00 02 79 00 23 00 00 00 00 00 02 7a 4a 23 00 00 00 00 00 02 7b 00 23 00 00 00 00 00 02 7c 66 23 00 00 00 00 00 02 7d 00 23 00 00 00 00 00 02 7e 7f 23 00 00 00 00 00 02 7f 00 23 00 00 00 00 00 02 80 94 23 00 00 00 00 00 02 81 00 23 00 00 00 00 00 02 82 a7 23 00 00 00 00 00 02 83 00 23 00 00 00 00 00 02 84 b8 23 00 00 00 00 00 02 85 00 23 00 00 00 00 00 02 86 c7 23 00 00 00 00 00 02 87 00 23 00 00 00 00 00 02 88 fb 23 00 00 00 00 00 02 89 01 23 00 00 00 00 00 02 8a 25 23 00 00 00 00 00 02 8b 01 23 00 00 00 00 00 02 8c 61 23 00 00 00 00 00 02 8d 01 23 00 00 00 00 00 02 8e 94 23 00 00 00 00 00 02 8f 01 23 00 00 00 00 00 02 90 e2 23 00 00 00 00 00 02 91 02 23 00 00 00 00 00 02 92 20 23 00 00 00 00 00 02 93 02 23 00 00 00 00 00 02 94 22 23 00 00 00 00 00 02 95 02 23 00 00 00 00 00 02 96 5c 23 00 00 00 00 00 02 97 02 23 00 00 00 00 00 02 98 9e 23 00 00 00 00 00 02 99 02 23 00 00 00 00 00 02 9a c9 23 00 00 00 00 00 02 9b 03 23 00 00 00 00 00 02 9c 01 23 00 00 00 00 00 02 9d 03 23 00 00 00 00 00 02 9e 28 23 00 00 00 00 00 02 9f 03 23 00 00 00 00 00 02 a0 55 23 00 00 00 00 00 02 a2 03 23 00 00 00 00 00 02 a3 62 23 00 00 00 00 00 02 a4 03 23 00 00 00 00 00 02 a5 6f 23 00 00 00 00 00 02 a6 03 23 00 00 00 00 00 02 a7 7e 23 00 00 00 00 00 02 a9 03 23 00 00 00 00 00 02 aa 8f 23 00 00 00 00 00 02 ab 03 23 00 00 00 00 00 02 ac 9c 23 00 00 00 00 00 02 ad 03 23 00 00 00 00 00 02 ae a2 23 00 00 00 00 00 02 af 03 23 00 00 00 00 00 02 b0 ab 23 00 00 00 00 00 02 b1 03 23 00 00 00 00 00 02 b2 b2 23 00 00 00 00 00 02 b3 00 23 00 00 00 00 00 02 b4 00 23 00 00 00 00 00 02 b5 00 23 00 00 00 00 00 02 b6 21 23 00 00 00 00 00 02 b7 00 23 00 00 00 00 00 02 b8 4a 23 00 00 00 00 00 02 b9 00 23 00 00 00 00 00 02 ba 66 23 00 00 00 00 00 02 bb 00 23 00 00 00 00 00 02 bc 7f 23 00 00 00 00 00 02 bd 00 23 00 00 00 00 00 02 be 94 23 00 00 00 00 00 02 bf 00 23 00 00 00 00 00 02 c0 a7 23 00 00 00 00 00 02 c1 00 23 00 00 00 00 00 02 c2 b8 23 00 00 00 00 00 02 c3 00 23 00 00 00 00 00 02 c4 c7 23 00 00 00 00 00 02 c5 00 23 00 00 00 00 00 02 c6 fb 23 00 00 00 00 00 02 c7 01 23 00 00 00 00 00 02 c8 25 23 00 00 00 00 00 02 c9 01 23 00 00 00 00 00 02 ca 61 23 00 00 00 00 00 02 cb 01 23 00 00 00 00 00 02 cc 94 23 00 00 00 00 00 02 cd 01 23 00 00 00 00 00 02 ce e2 23 00 00 00 00 00 02 cf 02 23 00 00 00 00 00 02 d0 20 23 00 00 00 00 00 02 d1 02 23 00 00 00 00 00 02 d2 22 23 00 00 00 00 00 02 d3 02 23 00 00 00 00 00 02 d4 5c 23 00 00 00 00 00 02 d5 02 23 00 00 00 00 00 02 d6 9e 23 00 00 00 00 00 02 d7 02 23 00 00 00 00 00 02 d8 c9 23 00 00 00 00 00 02 d9 03 23 00 00 00 00 00 02 da 01 23 00 00 00 00 00 02 db 03 23 00 00 00 00 00 02 dc 28 23 00 00 00 00 00 02 dd 03 23 00 00 00 00 00 02 de 55 23 00 00 00 00 00 02 df 03 23 00 00 00 00 00 02 e0 62 23 00 00 00 00 00 02 e1 03 23 00 00 00 00 00 02 e2 6f 23 00 00 00 00 00 02 e3 03 23 00 00 00 00 00 02 e4 7e 23 00 00 00 00 00 02 e5 03 23 00 00 00 00 00 02 e6 8f 23 00 00 00 00 00 02 e7 03 23 00 00 00 00 00 02 e8 9c 23 00 00 00 00 00 02 e9 03 23 00 00 00 00 00 02 ea a2 23 00 00 00 00 00 02 eb 03 23 00 00 00 00 00 02 ec ab 23 00 00 00 00 00 02 ed 03 23 01 00 00 00 00 02 ee b2 23 00 00 00 00 00 02 ef 00 23 00 00 00 00 00 02 f0 00 23 00 00 00 00 00 02 f1 00 23 00 00 00 00 00 02 f2 21 23 00 00 00 00 00 02 f3 00 23 00 00 00 00 00 02 f4 4a 23 00 00 00 00 00 02 f5 00 23 00 00 00 00 00 02 f6 66 23 00 00 00 00 00 02 f7 00 23 00 00 00 00 00 02 f8 7f 23 00 00 00 00 00 02 f9 00 23 00 00 00 00 00 02 fa 94 23 00 00 00 00 00 02 ff 02 23 00 00 00 00 00 02 fb 01 23 00 00 00 00 00 02 00 00 23 00 00 00 00 00 02 01 a7 23 00 00 00 00 00 02 02 00 23 00 00 00 00 00 02 03 b8 23 00 00 00 00 00 02 04 00 23 00 00 00 00 00 02 05 c7 23 00 00 00 00 00 02 06 00 23 00 00 00 00 00 02 07 fb 23 00 00 00 00 00 02 08 01 23 00 00 00 00 00 02 09 25 23 00 00 00 00 00 02 0a 01 23 00 00 00 00 00 02 0b 61 23 00 00 00 00 00 02 0c 01 23 00 00 00 00 00 02 0d 94 23 00 00 00 00 00 02 0e 01 23 00 00 00 00 00 02 0f e2 23 00 00 00 00 00 02 10 02 23 00 00 00 00 00 02 11 20 23 00 00 00 00 00 02 12 02 23 00 00 00 00 00 02 13 22 23 00 00 00 00 00 02 14 02 23 00 00 00 00 00 02 15 5c 23 00 00 00 00 00 02 16 02 23 00 00 00 00 00 02 17 9e 23 00 00 00 00 00 02 18 02 23 00 00 00 00 00 02 19 c9 23 00 00 00 00 00 02 1a 03 23 00 00 00 00 00 02 1b 01 23 00 00 00 00 00 02 1c 03 23 00 00 00 00 00 02 1d 28 23 00 00 00 00 00 02 1e 03 23 00 00 00 00 00 02 1f 55 23 00 00 00 00 00 02 20 03 23 00 00 00 00 00 02 21 62 23 00 00 00 00 00 02 22 03 23 00 00 00 00 00 02 23 6f 23 00 00 00 00 00 02 24 03 23 00 00 00 00 00 02 25 7e 23 00 00 00 00 00 02 26 03 23 00 00 00 00 00 02 27 8f 23 00 00 00 00 00 02 28 03 23 00 00 00 00 00 02 29 9c 23 00 00 00 00 00 02 2a 03 23 00 00 00 00 00 02 2b a2 23 00 00 00 00 00 02 2d 03 23 00 00 00 00 00 02 2f ab 23 00 00 00 00 00 02 30 03 23 00 00 00 00 00 02 31 b2 23 00 00 00 00 00 02 32 00 23 00 00 00 00 00 02 33 00 23 00 00 00 00 00 02 34 00 23 00 00 00 00 00 02 35 21 23 00 00 00 00 00 02 36 00 23 00 00 00 00 00 02 37 4a 23 00 00 00 00 00 02 38 00 23 00 00 00 00 00 02 39 66 23 00 00 00 00 00 02 3a 00 23 00 00 00 00 00 02 3b 7f 23 00 00 00 00 00 02 3d 00 23 00 00 00 00 00 02 3f 94 23 00 00 00 00 00 02 40 00 23 00 00 00 00 00 02 41 a7 23 00 00 00 00 00 02 42 00 23 00 00 00 00 00 02 43 b8 23 00 00 00 00 00 02 44 00 23 00 00 00 00 00 02 45 c7 23 00 00 00 00 00 02 46 00 23 00 00 00 00 00 02 47 fb 23 00 00 00 00 00 02 48 01 23 00 00 00 00 00 02 49 25 23 00 00 00 00 00 02 4a 01 23 00 00 00 00 00 02 4b 61 23 00 00 00 00 00 02 4c 01 23 00 00 00 00 00 02 4d 94 23 00 00 00 00 00 02 4e 01 23 00 00 00 00 00 02 4f e2 23 00 00 00 00 00 02 50 02 23 00 00 00 00 00 02 51 20 23 00 00 00 00 00 02 52 02 23 00 00 00 00 00 02 53 22 23 00 00 00 00 00 02 54 02 23 00 00 00 00 00 02 55 5c 23 00 00 00 00 00 02 56 02 23 00 00 00 00 00 02 58 9e 23 00 00 00 00 00 02 59 02 23 00 00 00 00 00 02 5a c9 23 00 00 00 00 00 02 5b 03 23 00 00 00 00 00 02 5c 01 23 00 00 00 00 00 02 5d 03 23 00 00 00 00 00 02 5e 28 23 00 00 00 00 00 02 5f 03 23 00 00 00 00 00 02 60 55 23 00 00 00 00 00 02 61 03 23 00 00 00 00 00 02 62 62 23 00 00 00 00 00 02 63 03 23 00 00 00 00 00 02 64 6f 23 00 00 00 00 00 02 65 03 23 00 00 00 00 00 02 66 7e 23 00 00 00 00 00 02 67 03 23 00 00 00 00 00 02 68 8f 23 00 00 00 00 00 02 69 03 23 00 00 00 00 00 02 6a 9c 23 00 00 00 00 00 02 6b 03 23 00 00 00 00 00 02 6c a2 23 00 00 00 00 00 02 6d 03 23 00 00 00 00 00 02 6e ab 23 00 00 00 00 00 02 6f 03 23 01 00 00 00 00 02 70 b2 23 00 00 00 00 00 02 71 00 23 00 00 00 00 00 02 72 00 23 00 00 00 00 00 02 73 00 23 00 00 00 00 00 02 74 1e 23 00 00 00 00 00 02 75 00 23 00 00 00 00 00 02 76 48 23 00 00 00 00 00 02 77 00 23 00 00 00 00 00 02 78 57 23 00 00 00 00 00 02 79 00 23 00 00 00 00 00 02 7a 6a 23 00 00 00 00 00 02 7b 00 23 00 00 00 00 00 02 7c 80 23 00 00 00 00 00 02 7d 00 23 00 00 00 00 00 02 7e 90 23 00 00 00 00 00 02 7f 00 23 00 00 00 00 00 02 80 a0 23 00 00 00 00 00 02 81 00 23 00 00 00 00 00 02 82 ae 23 00 00 00 00 00 02 83 00 23 00 00 00 00 00 02 84 e3 23 00 00 00 00 00 02 85 01 23 00 00 00 00 00 02 86 0e 23 00 00 00 00 00 02 87 01 23 00 00 00 00 00 02 88 50 23 00 00 00 00 00 02 89 01 23 00 00 00 00 00 02 8a 88 23 00 00 00 00 00 02 8b 01 23 00 00 00 00 00 02 8c da 23 00 00 00 00 00 02 8d 02 23 00 00 00 00 00 02 8e 19 23 00 00 00 00 00 02 8f 02 23 00 00 00 00 00 02 90 1b 23 00 00 00 00 00 02 91 02 23 00 00 00 00 00 02 92 58 23 00 00 00 00 00 02 93 02 23 00 00 00 00 00 02 94 9c 23 00 00 00 00 00 02 95 02 23 00 00 00 00 00 02 96 c6 23 00 00 00 00 00 02 97 03 23 00 00 00 00 00 02 98 01 23 00 00 00 00 00 02 99 03 23 00 00 00 00 00 02 9a 28 23 00 00 00 00 00 02 9b 03 23 00 00 00 00 00 02 9c 55 23 00 00 00 00 00 02 9d 03 23 00 00 00 00 00 02 9e 62 23 00 00 00 00 00 02 9f 03 23 00 00 00 00 00 02 a0 6f 23 00 00 00 00 00 02 a2 03 23 00 00 00 00 00 02 a3 7e 23 00 00 00 00 00 02 a4 03 23 00 00 00 00 00 02 a5 8f 23 00 00 00 00 00 02 a6 03 23 00 00 00 00 00 02 a7 9c 23 00 00 00 00 00 02 a9 03 23 00 00 00 00 00 02 aa a2 23 00 00 00 00 00 02 ab 03 23 00 00 00 00 00 02 ac ab 23 00 00 00 00 00 02 ad 03 23 00 00 00 00 00 02 ae b2 23 00 00 00 00 00 02 af 00 23 00 00 00 00 00 02 b0 00 23 00 00 00 00 00 02 b1 00 23 00 00 00 00 00 02 b2 1e 23 00 00 00 00 00 02 b3 00 23 00 00 00 00 00 02 b4 48 23 00 00 00 00 00 02 b5 00 23 00 00 00 00 00 02 b6 57 23 00 00 00 00 00 02 b7 00 23 00 00 00 00 00 02 b8 6a 23 00 00 00 00 00 02 b9 00 23 00 00 00 00 00 02 ba 80 23 00 00 00 00 00 02 bb 00 23 00 00 00 00 00 02 bc 90 23 00 00 00 00 00 02 bd 00 23 00 00 00 00 00 02 be a0 23 00 00 00 00 00 02 bf 00 23 00 00 00 00 00 02 c0 ae 23 00 00 00 00 00 02 c1 00 23 00 00 00 00 00 02 c2 e3 23 00 00 00 00 00 02 c3 01 23 00 00 00 00 00 02 c4 0e 23 00 00 00 00 00 02 c5 01 23 00 00 00 00 00 02 c6 50 23 00 00 00 00 00 02 c7 01 23 00 00 00 00 00 02 c8 88 23 00 00 00 00 00 02 c9 01 23 00 00 00 00 00 02 ca da 23 00 00 00 00 00 02 cb 02 23 00 00 00 00 00 02 cc 19 23 00 00 00 00 00 02 cd 02 23 00 00 00 00 00 02 ce 1b 23 00 00 00 00 00 02 cf 02 23 00 00 00 00 00 02 d0 58 23 00 00 00 00 00 02 d1 02 23 00 00 00 00 00 02 d2 9c 23 00 00 00 00 00 02 d3 02 23 00 00 00 00 00 02 d4 c6 23 00 00 00 00 00 02 d5 03 23 00 00 00 00 00 02 d6 01 23 00 00 00 00 00 02 d7 03 23 00 00 00 00 00 02 d8 28 23 00 00 00 00 00 02 d9 03 23 00 00 00 00 00 02 da 55 23 00 00 00 00 00 02 db 03 23 00 00 00 00 00 02 dc 62 23 00 00 00 00 00 02 dd 03 23 00 00 00 00 00 02 de 6f 23 00 00 00 00 00 02 df 03 23 00 00 00 00 00 02 e0 7e 23 00 00 00 00 00 02 e1 03 23 00 00 00 00 00 02 e2 8f 23 00 00 00 00 00 02 e3 03 23 00 00 00 00 00 02 e4 9c 23 00 00 00 00 00 02 e5 03 23 00 00 00 00 00 02 e6 a2 23 00 00 00 00 00 02 e7 03 23 00 00 00 00 00 02 e8 ab 23 00 00 00 00 00 02 e9 03 23 00 00 00 00 00 02 ea b2 23 01 00 00 00 00 02 ff 00];
        qcom,mdss-dsi-eyecare-level1-command = <0x23000000 0x2ff 0x1230000 0x02 0xfb012300 0x00 0x2750023 0x00 0x27611 0x23000000 0x277 0x230000 0x02 0x78292300 0x00 0x2790023 0x00 0x27a4b 0x23000000 0x27b 0x230000 0x02 0x7c662300 0x00 0x27d0023 0x00 0x27e7c 0x23000000 0x27f 0x230000 0x02 0x80912300 0x00 0x2810023 0x00 0x282a3 0x23000000 0x283 0x230000 0x02 0x84b32300 0x00 0x2850023 0x00 0x286c3 0x23000000 0x287 0x230000 0x02 0x88f62300 0x00 0x2890123 0x00 0x28a1f 0x23000000 0x28b 0x1230000 0x02 0x8c5f2300 0x00 0x28d0123 0x00 0x28e91 0x23000000 0x28f 0x1230000 0x02 0x90df2300 0x00 0x2910223 0x00 0x2921c 0x23000000 0x293 0x2230000 0x02 0x941e2300 0x00 0x2950223 0x00 0x29658 0x23000000 0x297 0x2230000 0x02 0x98982300 0x00 0x2990223 0x00 0x29ac2 0x23000000 0x29b 0x2230000 0x02 0x9cfa2300 0x00 0x29d0323 0x00 0x29e1f 0x23000000 0x29f 0x3230000 0x02 0xa04f2300 0x00 0x2a20323 0x00 0x2a35c 0x23000000 0x2a4 0x3230000 0x02 0xa56b2300 0x00 0x2a60323 0x00 0x2a77c 0x23000000 0x2a9 0x3230000 0x02 0xaa902300 0x00 0x2ab0323 0x00 0x2aca7 0x23000000 0x2ad 0x3230000 0x02 0xaebf2300 0x00 0x2af0323 0x00 0x2b0ce 0x23000000 0x2b1 0x3230000 0x02 0xb2cf2300 0x00 0x2b30023 0x00 0x2b411 0x23000000 0x2b5 0x230000 0x02 0xb6292300 0x00 0x2b70023 0x00 0x2b84b 0x23000000 0x2b9 0x230000 0x02 0xba662300 0x00 0x2bb0023 0x00 0x2bc7c 0x23000000 0x2bd 0x230000 0x02 0xbe912300 0x00 0x2bf0023 0x00 0x2c0a3 0x23000000 0x2c1 0x230000 0x02 0xc2b32300 0x00 0x2c30023 0x00 0x2c4c3 0x23000000 0x2c5 0x230000 0x02 0xc6f62300 0x00 0x2c70123 0x00 0x2c81f 0x23000000 0x2c9 0x1230000 0x02 0xca5f2300 0x00 0x2cb0123 0x00 0x2cc91 0x23000000 0x2cd 0x1230000 0x02 0xcedf2300 0x00 0x2cf0223 0x00 0x2d01c 0x23000000 0x2d1 0x2230000 0x02 0xd21e2300 0x00 0x2d30223 0x00 0x2d458 0x23000000 0x2d5 0x2230000 0x02 0xd6982300 0x00 0x2d70223 0x00 0x2d8c2 0x23000000 0x2d9 0x2230000 0x02 0xdafa2300 0x00 0x2db0323 0x00 0x2dc1f 0x23000000 0x2dd 0x3230000 0x02 0xde4f2300 0x00 0x2df0323 0x00 0x2e05c 0x23000000 0x2e1 0x3230000 0x02 0xe26b2300 0x00 0x2e30323 0x00 0x2e47c 0x23000000 0x2e5 0x3230000 0x02 0xe6902300 0x00 0x2e70323 0x00 0x2e8a7 0x23000000 0x2e9 0x3230000 0x02 0xeabf2300 0x00 0x2eb0323 0x00 0x2ecce 0x23000000 0x2ed 0x3230100 0x02 0xeecf2300 0x00 0x2ef0023 0x00 0x2f000 0x23000000 0x2f1 0x230000 0x02 0xf21d2300 0x00 0x2f30023 0x00 0x2f444 0x23000000 0x2f5 0x230000 0x02 0xf6612300 0x00 0x2f70023 0x00 0x2f878 0x23000000 0x2f9 0x230000 0x02 0xfa8d2300 0x00 0x2ff0223 0x00 0x2fb01 0x23000000 0x200 0x230000 0x02 0x19f2300 0x00 0x2020023 0x00 0x203b0 0x23000000 0x204 0x230000 0x02 0x5bf2300 0x00 0x2060023 0x00 0x207f3 0x23000000 0x208 0x1230000 0x02 0x91c2300 0x00 0x20a0123 0x00 0x20b5d 0x23000000 0x20c 0x1230000 0x02 0xd8f2300 0x00 0x20e0123 0x00 0x20fdf 0x23000000 0x210 0x2230000 0x02 0x111c2300 0x00 0x2120223 0x00 0x2131e 0x23000000 0x214 0x2230000 0x02 0x15582300 0x00 0x2160223 0x00 0x21799 0x23000000 0x218 0x2230000 0x02 0x19c32300 0x00 0x21a0223 0x00 0x21bfc 0x23000000 0x21c 0x3230000 0x02 0x1d212300 0x00 0x21e0323 0x00 0x21f4f 0x23000000 0x220 0x3230000 0x02 0x215c2300 0x00 0x2220323 0x00 0x2236b 0x23000000 0x224 0x3230000 0x02 0x257c2300 0x00 0x2260323 0x00 0x2278f 0x23000000 0x228 0x3230000 0x02 0x29a52300 0x00 0x22a0323 0x00 0x22bbe 0x23000000 0x22d 0x3230000 0x02 0x2fcd2300 0x00 0x2300323 0x00 0x231cf 0x23000000 0x232 0x230000 0x02 0x33002300 0x00 0x2340023 0x00 0x2351d 0x23000000 0x236 0x230000 0x02 0x37442300 0x00 0x2380023 0x00 0x23961 0x23000000 0x23a 0x230000 0x02 0x3b782300 0x00 0x23d0023 0x00 0x23f8d 0x23000000 0x240 0x230000 0x02 0x419f2300 0x00 0x2420023 0x00 0x243b0 0x23000000 0x244 0x230000 0x02 0x45bf2300 0x00 0x2460023 0x00 0x247f3 0x23000000 0x248 0x1230000 0x02 0x491c2300 0x00 0x24a0123 0x00 0x24b5d 0x23000000 0x24c 0x1230000 0x02 0x4d8f2300 0x00 0x24e0123 0x00 0x24fdf 0x23000000 0x250 0x2230000 0x02 0x511c2300 0x00 0x2520223 0x00 0x2531e 0x23000000 0x254 0x2230000 0x02 0x55582300 0x00 0x2560223 0x00 0x25899 0x23000000 0x259 0x2230000 0x02 0x5ac32300 0x00 0x25b0223 0x00 0x25cfc 0x23000000 0x25d 0x3230000 0x02 0x5e212300 0x00 0x25f0323 0x00 0x2604f 0x23000000 0x261 0x3230000 0x02 0x625c2300 0x00 0x2630323 0x00 0x2646b 0x23000000 0x265 0x3230000 0x02 0x667c2300 0x00 0x2670323 0x00 0x2688f 0x23000000 0x269 0x3230000 0x02 0x6aa52300 0x00 0x26b0323 0x00 0x26cbe 0x23000000 0x26d 0x3230000 0x02 0x6ecd2300 0x00 0x26f0323 0x1000000 0x270cf 0x23000000 0x271 0x230000 0x02 0x72d82300 0x00 0x2730023 0x00 0x274de 0x23000000 0x275 0x230000 0x02 0x76e92300 0x00 0x2770023 0x00 0x278f3 0x23000000 0x279 0x230000 0x02 0x7afd2300 0x00 0x27b0123 0x00 0x27c07 0x23000000 0x27d 0x1230000 0x02 0x7e102300 0x00 0x27f0123 0x00 0x28019 0x23000000 0x281 0x1230000 0x02 0x82212300 0x00 0x2830123 0x00 0x28440 0x23000000 0x285 0x1230000 0x02 0x865c2300 0x00 0x2870123 0x00 0x2888b 0x23000000 0x289 0x1230000 0x02 0x8ab32300 0x00 0x28b0123 0x00 0x28cf5 0x23000000 0x28d 0x2230000 0x02 0x8e2c2300 0x00 0x28f0223 0x00 0x2902e 0x23000000 0x291 0x2230000 0x02 0x92642300 0x00 0x2930223 0x00 0x294a3 0x23000000 0x295 0x2230000 0x02 0x96cc2300 0x00 0x2970323 0x00 0x29802 0x23000000 0x299 0x3230000 0x02 0x9a272300 0x00 0x29b0323 0x00 0x29c54 0x23000000 0x29d 0x3230000 0x02 0x9e612300 0x00 0x29f0323 0x00 0x2a06f 0x23000000 0x2a2 0x3230000 0x02 0xa37e2300 0x00 0x2a40323 0x00 0x2a58e 0x23000000 0x2a6 0x3230000 0x02 0xa7a12300 0x00 0x2a90323 0x00 0x2aab7 0x23000000 0x2ab 0x3230000 0x02 0xaccc2300 0x00 0x2ad0323 0x00 0x2aecf 0x23000000 0x2af 0x230000 0x02 0xb0d82300 0x00 0x2b10023 0x00 0x2b2de 0x23000000 0x2b3 0x230000 0x02 0xb4e92300 0x00 0x2b50023 0x00 0x2b6f3 0x23000000 0x2b7 0x230000 0x02 0xb8fd2300 0x00 0x2b90123 0x00 0x2ba07 0x23000000 0x2bb 0x1230000 0x02 0xbc102300 0x00 0x2bd0123 0x00 0x2be19 0x23000000 0x2bf 0x1230000 0x02 0xc0212300 0x00 0x2c10123 0x00 0x2c240 0x23000000 0x2c3 0x1230000 0x02 0xc45c2300 0x00 0x2c50123 0x00 0x2c68b 0x23000000 0x2c7 0x1230000 0x02 0xc8b32300 0x00 0x2c90123 0x00 0x2caf5 0x23000000 0x2cb 0x2230000 0x02 0xcc2c2300 0x00 0x2cd0223 0x00 0x2ce2e 0x23000000 0x2cf 0x2230000 0x02 0xd0642300 0x00 0x2d10223 0x00 0x2d2a3 0x23000000 0x2d3 0x2230000 0x02 0xd4cc2300 0x00 0x2d50323 0x00 0x2d602 0x23000000 0x2d7 0x3230000 0x02 0xd8272300 0x00 0x2d90323 0x00 0x2da54 0x23000000 0x2db 0x3230000 0x02 0xdc612300 0x00 0x2dd0323 0x00 0x2de6f 0x23000000 0x2df 0x3230000 0x02 0xe07e2300 0x00 0x2e10323 0x00 0x2e28e 0x23000000 0x2e3 0x3230000 0x02 0xe4a12300 0x00 0x2e50323 0x00 0x2e6b7 0x23000000 0x2e7 0x3230000 0x02 0xe8cc2300 0x00 0x2e90323 0x1000000 0x2eacf>;
        qcom,mdss-dsi-eyecare-level2-command = <0x23000000 0x2ff 0x1230000 0x02 0xfb012300 0x00 0x2750023 0x00 0x27622 0x23000000 0x277 0x230000 0x02 0x78362300 0x00 0x2790023 0x00 0x27a54 0x23000000 0x27b 0x230000 0x02 0x7c6e2300 0x00 0x27d0023 0x00 0x27e83 0x23000000 0x27f 0x230000 0x02 0x80972300 0x00 0x2810023 0x00 0x282a8 0x23000000 0x283 0x230000 0x02 0x84b82300 0x00 0x2850023 0x00 0x286c7 0x23000000 0x287 0x230000 0x02 0x88fa2300 0x00 0x2890123 0x00 0x28a22 0x23000000 0x28b 0x1230000 0x02 0x8c612300 0x00 0x28d0123 0x00 0x28e93 0x23000000 0x28f 0x1230000 0x02 0x90e02300 0x00 0x2910223 0x00 0x2921d 0x23000000 0x293 0x2230000 0x02 0x941f2300 0x00 0x2950223 0x00 0x29658 0x23000000 0x297 0x2230000 0x02 0x98992300 0x00 0x2990223 0x00 0x29ac2 0x23000000 0x29b 0x2230000 0x02 0x9cfb2300 0x00 0x29d0323 0x00 0x29e21 0x23000000 0x29f 0x3230000 0x02 0xa04f2300 0x00 0x2a20323 0x00 0x2a35d 0x23000000 0x2a4 0x3230000 0x02 0xa56c2300 0x00 0x2a60323 0x00 0x2a77d 0x23000000 0x2a9 0x3230000 0x02 0xaa902300 0x00 0x2ab0323 0x00 0x2aca8 0x23000000 0x2ad 0x3230000 0x02 0xaebf2300 0x00 0x2af0323 0x00 0x2b0ce 0x23000000 0x2b1 0x3230000 0x02 0xb2cf2300 0x00 0x2b30023 0x00 0x2b422 0x23000000 0x2b5 0x230000 0x02 0xb6362300 0x00 0x2b70023 0x00 0x2b854 0x23000000 0x2b9 0x230000 0x02 0xba6e2300 0x00 0x2bb0023 0x00 0x2bc83 0x23000000 0x2bd 0x230000 0x02 0xbe972300 0x00 0x2bf0023 0x00 0x2c0a8 0x23000000 0x2c1 0x230000 0x02 0xc2b82300 0x00 0x2c30023 0x00 0x2c4c7 0x23000000 0x2c5 0x230000 0x02 0xc6fa2300 0x00 0x2c70123 0x00 0x2c822 0x23000000 0x2c9 0x1230000 0x02 0xca612300 0x00 0x2cb0123 0x00 0x2cc93 0x23000000 0x2cd 0x1230000 0x02 0xcee02300 0x00 0x2cf0223 0x00 0x2d01d 0x23000000 0x2d1 0x2230000 0x02 0xd21f2300 0x00 0x2d30223 0x00 0x2d458 0x23000000 0x2d5 0x2230000 0x02 0xd6992300 0x00 0x2d70223 0x00 0x2d8c2 0x23000000 0x2d9 0x2230000 0x02 0xdafb2300 0x00 0x2db0323 0x00 0x2dc21 0x23000000 0x2dd 0x3230000 0x02 0xde4f2300 0x00 0x2df0323 0x00 0x2e05d 0x23000000 0x2e1 0x3230000 0x02 0xe26c2300 0x00 0x2e30323 0x00 0x2e47d 0x23000000 0x2e5 0x3230000 0x02 0xe6902300 0x00 0x2e70323 0x00 0x2e8a8 0x23000000 0x2e9 0x3230000 0x02 0xeabf2300 0x00 0x2eb0323 0x00 0x2ecce 0x23000000 0x2ed 0x3230100 0x02 0xeecf2300 0x00 0x2ef0023 0x00 0x2f000 0x23000000 0x2f1 0x230000 0x02 0xf21d2300 0x00 0x2f30023 0x00 0x2f444 0x23000000 0x2f5 0x230000 0x02 0xf6612300 0x00 0x2f70023 0x00 0x2f878 0x23000000 0x2f9 0x230000 0x02 0xfa8d2300 0x00 0x2ff0223 0x00 0x2fb01 0x23000000 0x200 0x230000 0x02 0x19f2300 0x00 0x2020023 0x00 0x203b0 0x23000000 0x204 0x230000 0x02 0x5bf2300 0x00 0x2060023 0x00 0x207f3 0x23000000 0x208 0x1230000 0x02 0x91c2300 0x00 0x20a0123 0x00 0x20b5d 0x23000000 0x20c 0x1230000 0x02 0xd8f2300 0x00 0x20e0123 0x00 0x20fdf 0x23000000 0x210 0x2230000 0x02 0x111c2300 0x00 0x2120223 0x00 0x2131e 0x23000000 0x214 0x2230000 0x02 0x15582300 0x00 0x2160223 0x00 0x21799 0x23000000 0x218 0x2230000 0x02 0x19c32300 0x00 0x21a0223 0x00 0x21bfc 0x23000000 0x21c 0x3230000 0x02 0x1d212300 0x00 0x21e0323 0x00 0x21f4f 0x23000000 0x220 0x3230000 0x02 0x215c2300 0x00 0x2220323 0x00 0x2236b 0x23000000 0x224 0x3230000 0x02 0x257c2300 0x00 0x2260323 0x00 0x2278f 0x23000000 0x228 0x3230000 0x02 0x29a52300 0x00 0x22a0323 0x00 0x22bbe 0x23000000 0x22d 0x3230000 0x02 0x2fcd2300 0x00 0x2300323 0x00 0x231cf 0x23000000 0x232 0x230000 0x02 0x33002300 0x00 0x2340023 0x00 0x2351d 0x23000000 0x236 0x230000 0x02 0x37442300 0x00 0x2380023 0x00 0x23961 0x23000000 0x23a 0x230000 0x02 0x3b782300 0x00 0x23d0023 0x00 0x23f8d 0x23000000 0x240 0x230000 0x02 0x419f2300 0x00 0x2420023 0x00 0x243b0 0x23000000 0x244 0x230000 0x02 0x45bf2300 0x00 0x2460023 0x00 0x247f3 0x23000000 0x248 0x1230000 0x02 0x491c2300 0x00 0x24a0123 0x00 0x24b5d 0x23000000 0x24c 0x1230000 0x02 0x4d8f2300 0x00 0x24e0123 0x00 0x24fdf 0x23000000 0x250 0x2230000 0x02 0x511c2300 0x00 0x2520223 0x00 0x2531e 0x23000000 0x254 0x2230000 0x02 0x55582300 0x00 0x2560223 0x00 0x25899 0x23000000 0x259 0x2230000 0x02 0x5ac32300 0x00 0x25b0223 0x00 0x25cfc 0x23000000 0x25d 0x3230000 0x02 0x5e212300 0x00 0x25f0323 0x00 0x2604f 0x23000000 0x261 0x3230000 0x02 0x625c2300 0x00 0x2630323 0x00 0x2646b 0x23000000 0x265 0x3230000 0x02 0x667c2300 0x00 0x2670323 0x00 0x2688f 0x23000000 0x269 0x3230000 0x02 0x6aa52300 0x00 0x26b0323 0x00 0x26cbe 0x23000000 0x26d 0x3230000 0x02 0x6ecd2300 0x00 0x26f0323 0x1000000 0x270cf 0x23000000 0x271 0x1230000 0x02 0x72102300 0x00 0x2730123 0x00 0x27414 0x23000000 0x275 0x1230000 0x02 0x761d2300 0x00 0x2770123 0x00 0x27824 0x23000000 0x279 0x1230000 0x02 0x7a2c2300 0x00 0x27b0123 0x00 0x27c34 0x23000000 0x27d 0x1230000 0x02 0x7e3b2300 0x00 0x27f0123 0x00 0x28042 0x23000000 0x281 0x1230000 0x02 0x82492300 0x00 0x2830123 0x00 0x28462 0x23000000 0x285 0x1230000 0x02 0x86792300 0x00 0x2870123 0x00 0x288a2 0x23000000 0x289 0x1230000 0x02 0x8ac62300 0x00 0x28b0223 0x00 0x28c01 0x23000000 0x28d 0x2230000 0x02 0x8e362300 0x00 0x28f0223 0x00 0x29037 0x23000000 0x291 0x2230000 0x02 0x926b2300 0x00 0x2930223 0x00 0x294a9 0x23000000 0x295 0x2230000 0x02 0x96d22300 0x00 0x2970323 0x00 0x29807 0x23000000 0x299 0x3230000 0x02 0x9a2d2300 0x00 0x29b0323 0x00 0x29c58 0x23000000 0x29d 0x3230000 0x02 0x9e652300 0x00 0x29f0323 0x00 0x2a072 0x23000000 0x2a2 0x3230000 0x02 0xa3812300 0x00 0x2a40323 0x00 0x2a591 0x23000000 0x2a6 0x3230000 0x02 0xa7a32300 0x00 0x2a90323 0x00 0x2aab9 0x23000000 0x2ab 0x3230000 0x02 0xaccc2300 0x00 0x2ad0323 0x00 0x2aecf 0x23000000 0x2af 0x1230000 0x02 0xb0102300 0x00 0x2b10123 0x00 0x2b214 0x23000000 0x2b3 0x1230000 0x02 0xb41d2300 0x00 0x2b50123 0x00 0x2b624 0x23000000 0x2b7 0x1230000 0x02 0xb82c2300 0x00 0x2b90123 0x00 0x2ba34 0x23000000 0x2bb 0x1230000 0x02 0xbc3b2300 0x00 0x2bd0123 0x00 0x2be42 0x23000000 0x2bf 0x1230000 0x02 0xc0492300 0x00 0x2c10123 0x00 0x2c262 0x23000000 0x2c3 0x1230000 0x02 0xc4792300 0x00 0x2c50123 0x00 0x2c6a2 0x23000000 0x2c7 0x1230000 0x02 0xc8c62300 0x00 0x2c90223 0x00 0x2ca01 0x23000000 0x2cb 0x2230000 0x02 0xcc362300 0x00 0x2cd0223 0x00 0x2ce37 0x23000000 0x2cf 0x2230000 0x02 0xd06b2300 0x00 0x2d10223 0x00 0x2d2a9 0x23000000 0x2d3 0x2230000 0x02 0xd4d22300 0x00 0x2d50323 0x00 0x2d607 0x23000000 0x2d7 0x3230000 0x02 0xd82d2300 0x00 0x2d90323 0x00 0x2da58 0x23000000 0x2db 0x3230000 0x02 0xdc652300 0x00 0x2dd0323 0x00 0x2de72 0x23000000 0x2df 0x3230000 0x02 0xe0812300 0x00 0x2e10323 0x00 0x2e291 0x23000000 0x2e3 0x3230000 0x02 0xe4a32300 0x00 0x2e50323 0x00 0x2e6b9 0x23000000 0x2e7 0x3230000 0x02 0xe8cc2300 0x00 0x2e90323 0x1000000 0x2eacf>;
        qcom,mdss-dsi-eyecare-level3-command = <0x23000000 0x2ff 0x1230000 0x02 0xfb012300 0x00 0x2750023 0x00 0x27633 0x23000000 0x277 0x230000 0x02 0x78442300 0x00 0x2790023 0x00 0x27a60 0x23000000 0x27b 0x230000 0x02 0x7c772300 0x00 0x27d0023 0x00 0x27e8c 0x23000000 0x27f 0x230000 0x02 0x809e2300 0x00 0x2810023 0x00 0x282af 0x23000000 0x283 0x230000 0x02 0x84bf2300 0x00 0x2850023 0x00 0x286cd 0x23000000 0x287 0x230000 0x02 0x88fe2300 0x00 0x2890123 0x00 0x28a25 0x23000000 0x28b 0x1230000 0x02 0x8c642300 0x00 0x28d0123 0x00 0x28e94 0x23000000 0x28f 0x1230000 0x02 0x90e12300 0x00 0x2910223 0x00 0x2921e 0x23000000 0x293 0x2230000 0x02 0x94202300 0x00 0x2950223 0x00 0x29659 0x23000000 0x297 0x2230000 0x02 0x98992300 0x00 0x2990223 0x00 0x29ac3 0x23000000 0x29b 0x2230000 0x02 0x9cfb2300 0x00 0x29d0323 0x00 0x29e21 0x23000000 0x29f 0x3230000 0x02 0xa04f2300 0x00 0x2a20323 0x00 0x2a35d 0x23000000 0x2a4 0x3230000 0x02 0xa56c2300 0x00 0x2a60323 0x00 0x2a77d 0x23000000 0x2a9 0x3230000 0x02 0xaa912300 0x00 0x2ab0323 0x00 0x2aca8 0x23000000 0x2ad 0x3230000 0x02 0xaebf2300 0x00 0x2af0323 0x00 0x2b0ce 0x23000000 0x2b1 0x3230000 0x02 0xb2cf2300 0x00 0x2b30023 0x00 0x2b433 0x23000000 0x2b5 0x230000 0x02 0xb6442300 0x00 0x2b70023 0x00 0x2b860 0x23000000 0x2b9 0x230000 0x02 0xba772300 0x00 0x2bb0023 0x00 0x2bc8c 0x23000000 0x2bd 0x230000 0x02 0xbe9e2300 0x00 0x2bf0023 0x00 0x2c0af 0x23000000 0x2c1 0x230000 0x02 0xc2bf2300 0x00 0x2c30023 0x00 0x2c4cd 0x23000000 0x2c5 0x230000 0x02 0xc6fe2300 0x00 0x2c70123 0x00 0x2c825 0x23000000 0x2c9 0x1230000 0x02 0xca642300 0x00 0x2cb0123 0x00 0x2cc94 0x23000000 0x2cd 0x1230000 0x02 0xcee12300 0x00 0x2cf0223 0x00 0x2d01e 0x23000000 0x2d1 0x2230000 0x02 0xd2202300 0x00 0x2d30223 0x00 0x2d459 0x23000000 0x2d5 0x2230000 0x02 0xd6992300 0x00 0x2d70223 0x00 0x2d8c3 0x23000000 0x2d9 0x2230000 0x02 0xdafb2300 0x00 0x2db0323 0x00 0x2dc21 0x23000000 0x2dd 0x3230000 0x02 0xde4f2300 0x00 0x2df0323 0x00 0x2e05d 0x23000000 0x2e1 0x3230000 0x02 0xe26c2300 0x00 0x2e30323 0x00 0x2e47d 0x23000000 0x2e5 0x3230000 0x02 0xe6912300 0x00 0x2e70323 0x00 0x2e8a8 0x23000000 0x2e9 0x3230000 0x02 0xeabf2300 0x00 0x2eb0323 0x00 0x2ecce 0x23000000 0x2ed 0x3230100 0x02 0xeecf2300 0x00 0x2ef0023 0x00 0x2f000 0x23000000 0x2f1 0x230000 0x02 0xf21d2300 0x00 0x2f30023 0x00 0x2f444 0x23000000 0x2f5 0x230000 0x02 0xf6612300 0x00 0x2f70023 0x00 0x2f878 0x23000000 0x2f9 0x230000 0x02 0xfa8d2300 0x00 0x2ff0223 0x00 0x2fb01 0x23000000 0x200 0x230000 0x02 0x19f2300 0x00 0x2020023 0x00 0x203b0 0x23000000 0x204 0x230000 0x02 0x5bf2300 0x00 0x2060023 0x00 0x207f3 0x23000000 0x208 0x1230000 0x02 0x91c2300 0x00 0x20a0123 0x00 0x20b5d 0x23000000 0x20c 0x1230000 0x02 0xd8f2300 0x00 0x20e0123 0x00 0x20fdf 0x23000000 0x210 0x2230000 0x02 0x111c2300 0x00 0x2120223 0x00 0x2131e 0x23000000 0x214 0x2230000 0x02 0x15582300 0x00 0x2160223 0x00 0x21799 0x23000000 0x218 0x2230000 0x02 0x19c32300 0x00 0x21a0223 0x00 0x21bfc 0x23000000 0x21c 0x3230000 0x02 0x1d212300 0x00 0x21e0323 0x00 0x21f4f 0x23000000 0x220 0x3230000 0x02 0x215c2300 0x00 0x2220323 0x00 0x2236b 0x23000000 0x224 0x3230000 0x02 0x257c2300 0x00 0x2260323 0x00 0x2278f 0x23000000 0x228 0x3230000 0x02 0x29a52300 0x00 0x22a0323 0x00 0x22bbe 0x23000000 0x22d 0x3230000 0x02 0x2fcd2300 0x00 0x2300323 0x00 0x231cf 0x23000000 0x232 0x230000 0x02 0x33002300 0x00 0x2340023 0x00 0x2351d 0x23000000 0x236 0x230000 0x02 0x37442300 0x00 0x2380023 0x00 0x23961 0x23000000 0x23a 0x230000 0x02 0x3b782300 0x00 0x23d0023 0x00 0x23f8d 0x23000000 0x240 0x230000 0x02 0x419f2300 0x00 0x2420023 0x00 0x243b0 0x23000000 0x244 0x230000 0x02 0x45bf2300 0x00 0x2460023 0x00 0x247f3 0x23000000 0x248 0x1230000 0x02 0x491c2300 0x00 0x24a0123 0x00 0x24b5d 0x23000000 0x24c 0x1230000 0x02 0x4d8f2300 0x00 0x24e0123 0x00 0x24fdf 0x23000000 0x250 0x2230000 0x02 0x511c2300 0x00 0x2520223 0x00 0x2531e 0x23000000 0x254 0x2230000 0x02 0x55582300 0x00 0x2560223 0x00 0x25899 0x23000000 0x259 0x2230000 0x02 0x5ac32300 0x00 0x25b0223 0x00 0x25cfc 0x23000000 0x25d 0x3230000 0x02 0x5e212300 0x00 0x25f0323 0x00 0x2604f 0x23000000 0x261 0x3230000 0x02 0x625c2300 0x00 0x2630323 0x00 0x2646b 0x23000000 0x265 0x3230000 0x02 0x667c2300 0x00 0x2670323 0x00 0x2688f 0x23000000 0x269 0x3230000 0x02 0x6aa52300 0x00 0x26b0323 0x00 0x26cbe 0x23000000 0x26d 0x3230000 0x02 0x6ecd2300 0x00 0x26f0323 0x1000000 0x270cf 0x23000000 0x271 0x1230000 0x02 0x72402300 0x00 0x2730123 0x00 0x27443 0x23000000 0x275 0x1230000 0x02 0x764a2300 0x00 0x2770123 0x00 0x27850 0x23000000 0x279 0x1230000 0x02 0x7a562300 0x00 0x27b0123 0x00 0x27c5c 0x23000000 0x27d 0x1230000 0x02 0x7e622300 0x00 0x27f0123 0x00 0x28068 0x23000000 0x281 0x1230000 0x02 0x826d2300 0x00 0x2830123 0x00 0x28483 0x23000000 0x285 0x1230000 0x02 0x86962300 0x00 0x2870123 0x00 0x288ba 0x23000000 0x289 0x1230000 0x02 0x8ad92300 0x00 0x28b0223 0x00 0x28c0f 0x23000000 0x28d 0x2230000 0x02 0x8e402300 0x00 0x28f0223 0x00 0x29041 0x23000000 0x291 0x2230000 0x02 0x92732300 0x00 0x2930223 0x00 0x294b0 0x23000000 0x295 0x2230000 0x02 0x96d92300 0x00 0x2970323 0x00 0x2980d 0x23000000 0x299 0x3230000 0x02 0x9a322300 0x00 0x29b0323 0x00 0x29c5d 0x23000000 0x29d 0x3230000 0x02 0x9e692300 0x00 0x29f0323 0x00 0x2a076 0x23000000 0x2a2 0x3230000 0x02 0xa3842300 0x00 0x2a40323 0x00 0x2a594 0x23000000 0x2a6 0x3230000 0x02 0xa7a62300 0x00 0x2a90323 0x00 0x2aaba 0x23000000 0x2ab 0x3230000 0x02 0xaccd2300 0x00 0x2ad0323 0x00 0x2aecf 0x23000000 0x2af 0x1230000 0x02 0xb0402300 0x00 0x2b10123 0x00 0x2b243 0x23000000 0x2b3 0x1230000 0x02 0xb44a2300 0x00 0x2b50123 0x00 0x2b650 0x23000000 0x2b7 0x1230000 0x02 0xb8562300 0x00 0x2b90123 0x00 0x2ba5c 0x23000000 0x2bb 0x1230000 0x02 0xbc622300 0x00 0x2bd0123 0x00 0x2be68 0x23000000 0x2bf 0x1230000 0x02 0xc06d2300 0x00 0x2c10123 0x00 0x2c283 0x23000000 0x2c3 0x1230000 0x02 0xc4962300 0x00 0x2c50123 0x00 0x2c6ba 0x23000000 0x2c7 0x1230000 0x02 0xc8d92300 0x00 0x2c90223 0x00 0x2ca0f 0x23000000 0x2cb 0x2230000 0x02 0xcc402300 0x00 0x2cd0223 0x00 0x2ce41 0x23000000 0x2cf 0x2230000 0x02 0xd0732300 0x00 0x2d10223 0x00 0x2d2b0 0x23000000 0x2d3 0x2230000 0x02 0xd4d92300 0x00 0x2d50323 0x00 0x2d60d 0x23000000 0x2d7 0x3230000 0x02 0xd8322300 0x00 0x2d90323 0x00 0x2da5d 0x23000000 0x2db 0x3230000 0x02 0xdc692300 0x00 0x2dd0323 0x00 0x2de76 0x23000000 0x2df 0x3230000 0x02 0xe0842300 0x00 0x2e10323 0x00 0x2e294 0x23000000 0x2e3 0x3230000 0x02 0xe4a62300 0x00 0x2e50323 0x00 0x2e6ba 0x23000000 0x2e7 0x3230000 0x02 0xe8cd2300 0x00 0x2e90323 0x1000000 0x2eacf>;
        qcom,mdss-dsi-eyecare-level4-command = <0x23000000 0x2ff 0x1230000 0x02 0xfb012300 0x00 0x2750023 0x00 0x27643 0x23000000 0x277 0x230000 0x02 0x78522300 0x00 0x2790023 0x00 0x27a6b 0x23000000 0x27b 0x230000 0x02 0x7c812300 0x00 0x27d0023 0x00 0x27e95 0x23000000 0x27f 0x230000 0x02 0x80a62300 0x00 0x2810023 0x00 0x282b6 0x23000000 0x283 0x230000 0x02 0x84c52300 0x00 0x2850023 0x00 0x286d3 0x23000000 0x287 0x1230000 0x02 0x88032300 0x00 0x2890123 0x00 0x28a29 0x23000000 0x28b 0x1230000 0x02 0x8c662300 0x00 0x28d0123 0x00 0x28e96 0x23000000 0x28f 0x1230000 0x02 0x90e22300 0x00 0x2910223 0x00 0x2921f 0x23000000 0x293 0x2230000 0x02 0x94202300 0x00 0x2950223 0x00 0x2965a 0x23000000 0x297 0x2230000 0x02 0x989a2300 0x00 0x2990223 0x00 0x29ac3 0x23000000 0x29b 0x2230000 0x02 0x9cfc2300 0x00 0x29d0323 0x00 0x29e21 0x23000000 0x29f 0x3230000 0x02 0xa0502300 0x00 0x2a20323 0x00 0x2a35d 0x23000000 0x2a4 0x3230000 0x02 0xa56c2300 0x00 0x2a60323 0x00 0x2a77d 0x23000000 0x2a9 0x3230000 0x02 0xaa912300 0x00 0x2ab0323 0x00 0x2aca8 0x23000000 0x2ad 0x3230000 0x02 0xaebf2300 0x00 0x2af0323 0x00 0x2b0ce 0x23000000 0x2b1 0x3230000 0x02 0xb2cf2300 0x00 0x2b30023 0x00 0x2b443 0x23000000 0x2b5 0x230000 0x02 0xb6522300 0x00 0x2b70023 0x00 0x2b86b 0x23000000 0x2b9 0x230000 0x02 0xba812300 0x00 0x2bb0023 0x00 0x2bc95 0x23000000 0x2bd 0x230000 0x02 0xbea62300 0x00 0x2bf0023 0x00 0x2c0b6 0x23000000 0x2c1 0x230000 0x02 0xc2c52300 0x00 0x2c30023 0x00 0x2c4d3 0x23000000 0x2c5 0x1230000 0x02 0xc6032300 0x00 0x2c70123 0x00 0x2c829 0x23000000 0x2c9 0x1230000 0x02 0xca662300 0x00 0x2cb0123 0x00 0x2cc96 0x23000000 0x2cd 0x1230000 0x02 0xcee22300 0x00 0x2cf0223 0x00 0x2d01f 0x23000000 0x2d1 0x2230000 0x02 0xd2202300 0x00 0x2d30223 0x00 0x2d45a 0x23000000 0x2d5 0x2230000 0x02 0xd69a2300 0x00 0x2d70223 0x00 0x2d8c3 0x23000000 0x2d9 0x2230000 0x02 0xdafc2300 0x00 0x2db0323 0x00 0x2dc21 0x23000000 0x2dd 0x3230000 0x02 0xde502300 0x00 0x2df0323 0x00 0x2e05d 0x23000000 0x2e1 0x3230000 0x02 0xe26c2300 0x00 0x2e30323 0x00 0x2e47d 0x23000000 0x2e5 0x3230000 0x02 0xe6912300 0x00 0x2e70323 0x00 0x2e8a8 0x23000000 0x2e9 0x3230000 0x02 0xeabf2300 0x00 0x2eb0323 0x00 0x2ecce 0x23000000 0x2ed 0x3230100 0x02 0xeecf2300 0x00 0x2ef0023 0x00 0x2f000 0x23000000 0x2f1 0x230000 0x02 0xf21d2300 0x00 0x2f30023 0x00 0x2f444 0x23000000 0x2f5 0x230000 0x02 0xf6612300 0x00 0x2f70023 0x00 0x2f878 0x23000000 0x2f9 0x230000 0x02 0xfa8d2300 0x00 0x2ff0223 0x00 0x2fb01 0x23000000 0x200 0x230000 0x02 0x19f2300 0x00 0x2020023 0x00 0x203b0 0x23000000 0x204 0x230000 0x02 0x5bf2300 0x00 0x2060023 0x00 0x207f3 0x23000000 0x208 0x1230000 0x02 0x91c2300 0x00 0x20a0123 0x00 0x20b5d 0x23000000 0x20c 0x1230000 0x02 0xd8f2300 0x00 0x20e0123 0x00 0x20fdf 0x23000000 0x210 0x2230000 0x02 0x111c2300 0x00 0x2120223 0x00 0x2131e 0x23000000 0x214 0x2230000 0x02 0x15582300 0x00 0x2160223 0x00 0x21799 0x23000000 0x218 0x2230000 0x02 0x19c32300 0x00 0x21a0223 0x00 0x21bfc 0x23000000 0x21c 0x3230000 0x02 0x1d212300 0x00 0x21e0323 0x00 0x21f4f 0x23000000 0x220 0x3230000 0x02 0x215c2300 0x00 0x2220323 0x00 0x2236b 0x23000000 0x224 0x3230000 0x02 0x257c2300 0x00 0x2260323 0x00 0x2278f 0x23000000 0x228 0x3230000 0x02 0x29a52300 0x00 0x22a0323 0x00 0x22bbe 0x23000000 0x22d 0x3230000 0x02 0x2fcd2300 0x00 0x2300323 0x00 0x231cf 0x23000000 0x232 0x230000 0x02 0x33002300 0x00 0x2340023 0x00 0x2351d 0x23000000 0x236 0x230000 0x02 0x37442300 0x00 0x2380023 0x00 0x23961 0x23000000 0x23a 0x230000 0x02 0x3b782300 0x00 0x23d0023 0x00 0x23f8d 0x23000000 0x240 0x230000 0x02 0x419f2300 0x00 0x2420023 0x00 0x243b0 0x23000000 0x244 0x230000 0x02 0x45bf2300 0x00 0x2460023 0x00 0x247f3 0x23000000 0x248 0x1230000 0x02 0x491c2300 0x00 0x24a0123 0x00 0x24b5d 0x23000000 0x24c 0x1230000 0x02 0x4d8f2300 0x00 0x24e0123 0x00 0x24fdf 0x23000000 0x250 0x2230000 0x02 0x511c2300 0x00 0x2520223 0x00 0x2531e 0x23000000 0x254 0x2230000 0x02 0x55582300 0x00 0x2560223 0x00 0x25899 0x23000000 0x259 0x2230000 0x02 0x5ac32300 0x00 0x25b0223 0x00 0x25cfc 0x23000000 0x25d 0x3230000 0x02 0x5e212300 0x00 0x25f0323 0x00 0x2604f 0x23000000 0x261 0x3230000 0x02 0x625c2300 0x00 0x2630323 0x00 0x2646b 0x23000000 0x265 0x3230000 0x02 0x667c2300 0x00 0x2670323 0x00 0x2688f 0x23000000 0x269 0x3230000 0x02 0x6aa52300 0x00 0x26b0323 0x00 0x26cbe 0x23000000 0x26d 0x3230000 0x02 0x6ecd2300 0x00 0x26f0323 0x1000000 0x270cf 0x23000000 0x271 0x1230000 0x02 0x72702300 0x00 0x2730123 0x00 0x27473 0x23000000 0x275 0x1230000 0x02 0x76782300 0x00 0x2770123 0x00 0x2787d 0x23000000 0x279 0x1230000 0x02 0x7a812300 0x00 0x27b0123 0x00 0x27c86 0x23000000 0x27d 0x1230000 0x02 0x7e8b2300 0x00 0x27f0123 0x00 0x2808f 0x23000000 0x281 0x1230000 0x02 0x82942300 0x00 0x2830123 0x00 0x284a5 0x23000000 0x285 0x1230000 0x02 0x86b52300 0x00 0x2870123 0x00 0x288d3 0x23000000 0x289 0x1230000 0x02 0x8aef2300 0x00 0x28b0223 0x00 0x28c1e 0x23000000 0x28d 0x2230000 0x02 0x8e4c2300 0x00 0x28f0223 0x00 0x2904d 0x23000000 0x291 0x2230000 0x02 0x927e2300 0x00 0x2930223 0x00 0x294b9 0x23000000 0x295 0x2230000 0x02 0x96e22300 0x00 0x2970323 0x00 0x29815 0x23000000 0x299 0x3230000 0x02 0x9a392300 0x00 0x29b0323 0x00 0x29c62 0x23000000 0x29d 0x3230000 0x02 0x9e6e2300 0x00 0x29f0323 0x00 0x2a07b 0x23000000 0x2a2 0x3230000 0x02 0xa3882300 0x00 0x2a40323 0x00 0x2a597 0x23000000 0x2a6 0x3230000 0x02 0xa7a92300 0x00 0x2a90323 0x00 0x2aabc 0x23000000 0x2ab 0x3230000 0x02 0xaccd2300 0x00 0x2ad0323 0x00 0x2aecf 0x23000000 0x2af 0x1230000 0x02 0xb0702300 0x00 0x2b10123 0x00 0x2b273 0x23000000 0x2b3 0x1230000 0x02 0xb4782300 0x00 0x2b50123 0x00 0x2b67d 0x23000000 0x2b7 0x1230000 0x02 0xb8812300 0x00 0x2b90123 0x00 0x2ba86 0x23000000 0x2bb 0x1230000 0x02 0xbc8b2300 0x00 0x2bd0123 0x00 0x2be8f 0x23000000 0x2bf 0x1230000 0x02 0xc0942300 0x00 0x2c10123 0x00 0x2c2a5 0x23000000 0x2c3 0x1230000 0x02 0xc4b52300 0x00 0x2c50123 0x00 0x2c6d3 0x23000000 0x2c7 0x1230000 0x02 0xc8ef2300 0x00 0x2c90223 0x00 0x2ca1e 0x23000000 0x2cb 0x2230000 0x02 0xcc4c2300 0x00 0x2cd0223 0x00 0x2ce4d 0x23000000 0x2cf 0x2230000 0x02 0xd07e2300 0x00 0x2d10223 0x00 0x2d2b9 0x23000000 0x2d3 0x2230000 0x02 0xd4e22300 0x00 0x2d50323 0x00 0x2d615 0x23000000 0x2d7 0x3230000 0x02 0xd8392300 0x00 0x2d90323 0x00 0x2da62 0x23000000 0x2db 0x3230000 0x02 0xdc6e2300 0x00 0x2dd0323 0x00 0x2de7b 0x23000000 0x2df 0x3230000 0x02 0xe0882300 0x00 0x2e10323 0x00 0x2e297 0x23000000 0x2e3 0x3230000 0x02 0xe4a92300 0x00 0x2e50323 0x00 0x2e6bc 0x23000000 0x2e7 0x3230000 0x02 0xe8cd2300 0x00 0x2e90323 0x1000000 0x2eacf>;
        qcom,mdss-dsi-eyecare-level5-command = <0x23000000 0x2ff 0x1230000 0x02 0xfb012300 0x00 0x2750023 0x00 0x27653 0x23000000 0x277 0x230000 0x02 0x78602300 0x00 0x2790023 0x00 0x27a77 0x23000000 0x27b 0x230000 0x02 0x7c8c2300 0x00 0x27d0023 0x00 0x27e9e 0x23000000 0x27f 0x230000 0x02 0x80af2300 0x00 0x2810023 0x00 0x282be 0x23000000 0x283 0x230000 0x02 0x84cd2300 0x00 0x2850023 0x00 0x286da 0x23000000 0x287 0x1230000 0x02 0x88082300 0x00 0x2890123 0x00 0x28a2d 0x23000000 0x28b 0x1230000 0x02 0x8c692300 0x00 0x28d0123 0x00 0x28e99 0x23000000 0x28f 0x1230000 0x02 0x90e42300 0x00 0x2910223 0x00 0x29220 0x23000000 0x293 0x2230000 0x02 0x94212300 0x00 0x2950223 0x00 0x2965a 0x23000000 0x297 0x2230000 0x02 0x989a2300 0x00 0x2990223 0x00 0x29ac4 0x23000000 0x29b 0x2230000 0x02 0x9cfc2300 0x00 0x29d0323 0x00 0x29e22 0x23000000 0x29f 0x3230000 0x02 0xa0502300 0x00 0x2a20323 0x00 0x2a35e 0x23000000 0x2a4 0x3230000 0x02 0xa56d2300 0x00 0x2a60323 0x00 0x2a77e 0x23000000 0x2a9 0x3230000 0x02 0xaa912300 0x00 0x2ab0323 0x00 0x2aca8 0x23000000 0x2ad 0x3230000 0x02 0xaec02300 0x00 0x2af0323 0x00 0x2b0ce 0x23000000 0x2b1 0x3230000 0x02 0xb2cf2300 0x00 0x2b30023 0x00 0x2b453 0x23000000 0x2b5 0x230000 0x02 0xb6602300 0x00 0x2b70023 0x00 0x2b877 0x23000000 0x2b9 0x230000 0x02 0xba8c2300 0x00 0x2bb0023 0x00 0x2bc9e 0x23000000 0x2bd 0x230000 0x02 0xbeaf2300 0x00 0x2bf0023 0x00 0x2c0be 0x23000000 0x2c1 0x230000 0x02 0xc2cd2300 0x00 0x2c30023 0x00 0x2c4da 0x23000000 0x2c5 0x1230000 0x02 0xc6082300 0x00 0x2c70123 0x00 0x2c82d 0x23000000 0x2c9 0x1230000 0x02 0xca692300 0x00 0x2cb0123 0x00 0x2cc99 0x23000000 0x2cd 0x1230000 0x02 0xcee42300 0x00 0x2cf0223 0x00 0x2d020 0x23000000 0x2d1 0x2230000 0x02 0xd2212300 0x00 0x2d30223 0x00 0x2d45a 0x23000000 0x2d5 0x2230000 0x02 0xd69a2300 0x00 0x2d70223 0x00 0x2d8c4 0x23000000 0x2d9 0x2230000 0x02 0xdafc2300 0x00 0x2db0323 0x00 0x2dc22 0x23000000 0x2dd 0x3230000 0x02 0xde502300 0x00 0x2df0323 0x00 0x2e05e 0x23000000 0x2e1 0x3230000 0x02 0xe26d2300 0x00 0x2e30323 0x00 0x2e47e 0x23000000 0x2e5 0x3230000 0x02 0xe6912300 0x00 0x2e70323 0x00 0x2e8a8 0x23000000 0x2e9 0x3230000 0x02 0xeac02300 0x00 0x2eb0323 0x00 0x2ecce 0x23000000 0x2ed 0x3230100 0x02 0xeecf2300 0x00 0x2ef0023 0x00 0x2f000 0x23000000 0x2f1 0x230000 0x02 0xf21d2300 0x00 0x2f30023 0x00 0x2f444 0x23000000 0x2f5 0x230000 0x02 0xf6612300 0x00 0x2f70023 0x00 0x2f878 0x23000000 0x2f9 0x230000 0x02 0xfa8d2300 0x00 0x2ff0223 0x00 0x2fb01 0x23000000 0x200 0x230000 0x02 0x19f2300 0x00 0x2020023 0x00 0x203b0 0x23000000 0x204 0x230000 0x02 0x5bf2300 0x00 0x2060023 0x00 0x207f3 0x23000000 0x208 0x1230000 0x02 0x91c2300 0x00 0x20a0123 0x00 0x20b5d 0x23000000 0x20c 0x1230000 0x02 0xd8f2300 0x00 0x20e0123 0x00 0x20fdf 0x23000000 0x210 0x2230000 0x02 0x111c2300 0x00 0x2120223 0x00 0x2131e 0x23000000 0x214 0x2230000 0x02 0x15582300 0x00 0x2160223 0x00 0x21799 0x23000000 0x218 0x2230000 0x02 0x19c32300 0x00 0x21a0223 0x00 0x21bfc 0x23000000 0x21c 0x3230000 0x02 0x1d212300 0x00 0x21e0323 0x00 0x21f4f 0x23000000 0x220 0x3230000 0x02 0x215c2300 0x00 0x2220323 0x00 0x2236b 0x23000000 0x224 0x3230000 0x02 0x257c2300 0x00 0x2260323 0x00 0x2278f 0x23000000 0x228 0x3230000 0x02 0x29a52300 0x00 0x22a0323 0x00 0x22bbe 0x23000000 0x22d 0x3230000 0x02 0x2fcd2300 0x00 0x2300323 0x00 0x231cf 0x23000000 0x232 0x230000 0x02 0x33002300 0x00 0x2340023 0x00 0x2351d 0x23000000 0x236 0x230000 0x02 0x37442300 0x00 0x2380023 0x00 0x23961 0x23000000 0x23a 0x230000 0x02 0x3b782300 0x00 0x23d0023 0x00 0x23f8d 0x23000000 0x240 0x230000 0x02 0x419f2300 0x00 0x2420023 0x00 0x243b0 0x23000000 0x244 0x230000 0x02 0x45bf2300 0x00 0x2460023 0x00 0x247f3 0x23000000 0x248 0x1230000 0x02 0x491c2300 0x00 0x24a0123 0x00 0x24b5d 0x23000000 0x24c 0x1230000 0x02 0x4d8f2300 0x00 0x24e0123 0x00 0x24fdf 0x23000000 0x250 0x2230000 0x02 0x511c2300 0x00 0x2520223 0x00 0x2531e 0x23000000 0x254 0x2230000 0x02 0x55582300 0x00 0x2560223 0x00 0x25899 0x23000000 0x259 0x2230000 0x02 0x5ac32300 0x00 0x25b0223 0x00 0x25cfc 0x23000000 0x25d 0x3230000 0x02 0x5e212300 0x00 0x25f0323 0x00 0x2604f 0x23000000 0x261 0x3230000 0x02 0x625c2300 0x00 0x2630323 0x00 0x2646b 0x23000000 0x265 0x3230000 0x02 0x667c2300 0x00 0x2670323 0x00 0x2688f 0x23000000 0x269 0x3230000 0x02 0x6aa52300 0x00 0x26b0323 0x00 0x26cbe 0x23000000 0x26d 0x3230000 0x02 0x6ecd2300 0x00 0x26f0323 0x1000000 0x270cf 0x23000000 0x271 0x1230000 0x02 0x72962300 0x00 0x2730123 0x00 0x27498 0x23000000 0x275 0x1230000 0x02 0x769c2300 0x00 0x2770123 0x00 0x278a0 0x23000000 0x279 0x1230000 0x02 0x7aa42300 0x00 0x27b0123 0x00 0x27ca8 0x23000000 0x27d 0x1230000 0x02 0x7eac2300 0x00 0x27f0123 0x00 0x280b0 0x23000000 0x281 0x1230000 0x02 0x82b32300 0x00 0x2830123 0x00 0x284c2 0x23000000 0x285 0x1230000 0x02 0x86d02300 0x00 0x2870123 0x00 0x288ea 0x23000000 0x289 0x2230000 0x02 0x8a012300 0x00 0x28b0223 0x00 0x28c2c 0x23000000 0x28d 0x2230000 0x02 0x8e572300 0x00 0x28f0223 0x00 0x29059 0x23000000 0x291 0x2230000 0x02 0x92872300 0x00 0x2930223 0x00 0x294c2 0x23000000 0x295 0x2230000 0x02 0x96ea2300 0x00 0x2970323 0x00 0x2981d 0x23000000 0x299 0x3230000 0x02 0x9a402300 0x00 0x29b0323 0x00 0x29c68 0x23000000 0x29d 0x3230000 0x02 0x9e732300 0x00 0x29f0323 0x00 0x2a07f 0x23000000 0x2a2 0x3230000 0x02 0xa38c2300 0x00 0x2a40323 0x00 0x2a59b 0x23000000 0x2a6 0x3230000 0x02 0xa7ac2300 0x00 0x2a90323 0x00 0x2aabe 0x23000000 0x2ab 0x3230000 0x02 0xaccd2300 0x00 0x2ad0323 0x00 0x2aecf 0x23000000 0x2af 0x1230000 0x02 0xb0962300 0x00 0x2b10123 0x00 0x2b298 0x23000000 0x2b3 0x1230000 0x02 0xb49c2300 0x00 0x2b50123 0x00 0x2b6a0 0x23000000 0x2b7 0x1230000 0x02 0xb8a42300 0x00 0x2b90123 0x00 0x2baa8 0x23000000 0x2bb 0x1230000 0x02 0xbcac2300 0x00 0x2bd0123 0x00 0x2beb0 0x23000000 0x2bf 0x1230000 0x02 0xc0b32300 0x00 0x2c10123 0x00 0x2c2c2 0x23000000 0x2c3 0x1230000 0x02 0xc4d02300 0x00 0x2c50123 0x00 0x2c6ea 0x23000000 0x2c7 0x2230000 0x02 0xc8012300 0x00 0x2c90223 0x00 0x2ca2c 0x23000000 0x2cb 0x2230000 0x02 0xcc572300 0x00 0x2cd0223 0x00 0x2ce59 0x23000000 0x2cf 0x2230000 0x02 0xd0872300 0x00 0x2d10223 0x00 0x2d2c2 0x23000000 0x2d3 0x2230000 0x02 0xd4ea2300 0x00 0x2d50323 0x00 0x2d61d 0x23000000 0x2d7 0x3230000 0x02 0xd8402300 0x00 0x2d90323 0x00 0x2da68 0x23000000 0x2db 0x3230000 0x02 0xdc732300 0x00 0x2dd0323 0x00 0x2de7f 0x23000000 0x2df 0x3230000 0x02 0xe08c2300 0x00 0x2e10323 0x00 0x2e29b 0x23000000 0x2e3 0x3230000 0x02 0xe4ac2300 0x00 0x2e50323 0x00 0x2e6be 0x23000000 0x2e7 0x3230000 0x02 0xe8cd2300 0x00 0x2e90323 0x1000000 0x2eacf>;
        qcom,mdss-dsi-eyecare-level6-command = <0x23000000 0x2ff 0x1230000 0x02 0xfb012300 0x00 0x2750023 0x00 0x27664 0x23000000 0x277 0x230000 0x02 0x78702300 0x00 0x2790023 0x00 0x27a85 0x23000000 0x27b 0x230000 0x02 0x7c982300 0x00 0x27d0023 0x00 0x27ea9 0x23000000 0x27f 0x230000 0x02 0x80b92300 0x00 0x2810023 0x00 0x282c7 0x23000000 0x283 0x230000 0x02 0x84d52300 0x00 0x2850023 0x00 0x286e2 0x23000000 0x287 0x1230000 0x02 0x880e2300 0x00 0x2890123 0x00 0x28a32 0x23000000 0x28b 0x1230000 0x02 0x8c6d2300 0x00 0x28d0123 0x00 0x28e9b 0x23000000 0x28f 0x1230000 0x02 0x90e52300 0x00 0x2910223 0x00 0x29221 0x23000000 0x293 0x2230000 0x02 0x94232300 0x00 0x2950223 0x00 0x2965b 0x23000000 0x297 0x2230000 0x02 0x989b2300 0x00 0x2990223 0x00 0x29ac4 0x23000000 0x29b 0x2230000 0x02 0x9cfd2300 0x00 0x29d0323 0x00 0x29e23 0x23000000 0x29f 0x3230000 0x02 0xa0512300 0x00 0x2a20323 0x00 0x2a35e 0x23000000 0x2a4 0x3230000 0x02 0xa56d2300 0x00 0x2a60323 0x00 0x2a77e 0x23000000 0x2a9 0x3230000 0x02 0xaa922300 0x00 0x2ab0323 0x00 0x2aca9 0x23000000 0x2ad 0x3230000 0x02 0xaec02300 0x00 0x2af0323 0x00 0x2b0ce 0x23000000 0x2b1 0x3230000 0x02 0xb2cf2300 0x00 0x2b30023 0x00 0x2b464 0x23000000 0x2b5 0x230000 0x02 0xb6702300 0x00 0x2b70023 0x00 0x2b885 0x23000000 0x2b9 0x230000 0x02 0xba982300 0x00 0x2bb0023 0x00 0x2bca9 0x23000000 0x2bd 0x230000 0x02 0xbeb92300 0x00 0x2bf0023 0x00 0x2c0c7 0x23000000 0x2c1 0x230000 0x02 0xc2d52300 0x00 0x2c30023 0x00 0x2c4e2 0x23000000 0x2c5 0x1230000 0x02 0xc60e2300 0x00 0x2c70123 0x00 0x2c832 0x23000000 0x2c9 0x1230000 0x02 0xca6d2300 0x00 0x2cb0123 0x00 0x2cc9b 0x23000000 0x2cd 0x1230000 0x02 0xcee52300 0x00 0x2cf0223 0x00 0x2d021 0x23000000 0x2d1 0x2230000 0x02 0xd2232300 0x00 0x2d30223 0x00 0x2d45b 0x23000000 0x2d5 0x2230000 0x02 0xd69b2300 0x00 0x2d70223 0x00 0x2d8c4 0x23000000 0x2d9 0x2230000 0x02 0xdafd2300 0x00 0x2db0323 0x00 0x2dc23 0x23000000 0x2dd 0x3230000 0x02 0xde512300 0x00 0x2df0323 0x00 0x2e05e 0x23000000 0x2e1 0x3230000 0x02 0xe26d2300 0x00 0x2e30323 0x00 0x2e47e 0x23000000 0x2e5 0x3230000 0x02 0xe6922300 0x00 0x2e70323 0x00 0x2e8a9 0x23000000 0x2e9 0x3230000 0x02 0xeac02300 0x00 0x2eb0323 0x00 0x2ecce 0x23000000 0x2ed 0x3230100 0x02 0xeecf2300 0x00 0x2ef0023 0x00 0x2f000 0x23000000 0x2f1 0x230000 0x02 0xf21d2300 0x00 0x2f30023 0x00 0x2f444 0x23000000 0x2f5 0x230000 0x02 0xf6612300 0x00 0x2f70023 0x00 0x2f878 0x23000000 0x2f9 0x230000 0x02 0xfa8d2300 0x00 0x2ff0223 0x00 0x2fb01 0x23000000 0x200 0x230000 0x02 0x19f2300 0x00 0x2020023 0x00 0x203b0 0x23000000 0x204 0x230000 0x02 0x5bf2300 0x00 0x2060023 0x00 0x207f3 0x23000000 0x208 0x1230000 0x02 0x91c2300 0x00 0x20a0123 0x00 0x20b5d 0x23000000 0x20c 0x1230000 0x02 0xd8f2300 0x00 0x20e0123 0x00 0x20fdf 0x23000000 0x210 0x2230000 0x02 0x111c2300 0x00 0x2120223 0x00 0x2131e 0x23000000 0x214 0x2230000 0x02 0x15582300 0x00 0x2160223 0x00 0x21799 0x23000000 0x218 0x2230000 0x02 0x19c32300 0x00 0x21a0223 0x00 0x21bfc 0x23000000 0x21c 0x3230000 0x02 0x1d212300 0x00 0x21e0323 0x00 0x21f4f 0x23000000 0x220 0x3230000 0x02 0x215c2300 0x00 0x2220323 0x00 0x2236b 0x23000000 0x224 0x3230000 0x02 0x257c2300 0x00 0x2260323 0x00 0x2278f 0x23000000 0x228 0x3230000 0x02 0x29a52300 0x00 0x22a0323 0x00 0x22bbe 0x23000000 0x22d 0x3230000 0x02 0x2fcd2300 0x00 0x2300323 0x00 0x231cf 0x23000000 0x232 0x230000 0x02 0x33002300 0x00 0x2340023 0x00 0x2351d 0x23000000 0x236 0x230000 0x02 0x37442300 0x00 0x2380023 0x00 0x23961 0x23000000 0x23a 0x230000 0x02 0x3b782300 0x00 0x23d0023 0x00 0x23f8d 0x23000000 0x240 0x230000 0x02 0x419f2300 0x00 0x2420023 0x00 0x243b0 0x23000000 0x244 0x230000 0x02 0x45bf2300 0x00 0x2460023 0x00 0x247f3 0x23000000 0x248 0x1230000 0x02 0x491c2300 0x00 0x24a0123 0x00 0x24b5d 0x23000000 0x24c 0x1230000 0x02 0x4d8f2300 0x00 0x24e0123 0x00 0x24fdf 0x23000000 0x250 0x2230000 0x02 0x511c2300 0x00 0x2520223 0x00 0x2531e 0x23000000 0x254 0x2230000 0x02 0x55582300 0x00 0x2560223 0x00 0x25899 0x23000000 0x259 0x2230000 0x02 0x5ac32300 0x00 0x25b0223 0x00 0x25cfc 0x23000000 0x25d 0x3230000 0x02 0x5e212300 0x00 0x25f0323 0x00 0x2604f 0x23000000 0x261 0x3230000 0x02 0x625c2300 0x00 0x2630323 0x00 0x2646b 0x23000000 0x265 0x3230000 0x02 0x667c2300 0x00 0x2670323 0x00 0x2688f 0x23000000 0x269 0x3230000 0x02 0x6aa52300 0x00 0x26b0323 0x00 0x26cbe 0x23000000 0x26d 0x3230000 0x02 0x6ecd2300 0x00 0x26f0323 0x1000000 0x270cf 0x23000000 0x271 0x1230000 0x02 0x72b82300 0x00 0x2730123 0x00 0x274ba 0x23000000 0x275 0x1230000 0x02 0x76bd2300 0x00 0x2770123 0x00 0x278c0 0x23000000 0x279 0x1230000 0x02 0x7ac42300 0x00 0x27b0123 0x00 0x27cc7 0x23000000 0x27d 0x1230000 0x02 0x7eca2300 0x00 0x27f0123 0x00 0x280cd 0x23000000 0x281 0x1230000 0x02 0x82d12300 0x00 0x2830123 0x00 0x284dd 0x23000000 0x285 0x1230000 0x02 0x86e92300 0x00 0x2870123 0x00 0x288fe 0x23000000 0x289 0x2230000 0x02 0x8a132300 0x00 0x28b0223 0x00 0x28c3b 0x23000000 0x28d 0x2230000 0x02 0x8e642300 0x00 0x28f0223 0x00 0x29065 0x23000000 0x291 0x2230000 0x02 0x92922300 0x00 0x2930223 0x00 0x294cc 0x23000000 0x295 0x2230000 0x02 0x96f32300 0x00 0x2970323 0x00 0x29827 0x23000000 0x299 0x3230000 0x02 0x9a472300 0x00 0x29b0323 0x00 0x29c6d 0x23000000 0x29d 0x3230000 0x02 0x9e782300 0x00 0x29f0323 0x00 0x2a084 0x23000000 0x2a2 0x3230000 0x02 0xa3912300 0x00 0x2a40323 0x00 0x2a59f 0x23000000 0x2a6 0x3230000 0x02 0xa7af2300 0x00 0x2a90323 0x00 0x2aac0 0x23000000 0x2ab 0x3230000 0x02 0xacce2300 0x00 0x2ad0323 0x00 0x2aecf 0x23000000 0x2af 0x1230000 0x02 0xb0b82300 0x00 0x2b10123 0x00 0x2b2ba 0x23000000 0x2b3 0x1230000 0x02 0xb4bd2300 0x00 0x2b50123 0x00 0x2b6c0 0x23000000 0x2b7 0x1230000 0x02 0xb8c42300 0x00 0x2b90123 0x00 0x2bac7 0x23000000 0x2bb 0x1230000 0x02 0xbcca2300 0x00 0x2bd0123 0x00 0x2becd 0x23000000 0x2bf 0x1230000 0x02 0xc0d12300 0x00 0x2c10123 0x00 0x2c2dd 0x23000000 0x2c3 0x1230000 0x02 0xc4e92300 0x00 0x2c50123 0x00 0x2c6fe 0x23000000 0x2c7 0x2230000 0x02 0xc8132300 0x00 0x2c90223 0x00 0x2ca3b 0x23000000 0x2cb 0x2230000 0x02 0xcc642300 0x00 0x2cd0223 0x00 0x2ce65 0x23000000 0x2cf 0x2230000 0x02 0xd0922300 0x00 0x2d10223 0x00 0x2d2cc 0x23000000 0x2d3 0x2230000 0x02 0xd4f32300 0x00 0x2d50323 0x00 0x2d627 0x23000000 0x2d7 0x3230000 0x02 0xd8472300 0x00 0x2d90323 0x00 0x2da6d 0x23000000 0x2db 0x3230000 0x02 0xdc782300 0x00 0x2dd0323 0x00 0x2de84 0x23000000 0x2df 0x3230000 0x02 0xe0912300 0x00 0x2e10323 0x00 0x2e29f 0x23000000 0x2e3 0x3230000 0x02 0xe4af2300 0x00 0x2e50323 0x00 0x2e6c0 0x23000000 0x2e7 0x3230000 0x02 0xe8ce2300 0x00 0x2e90323 0x1000000 0x2eacf>;
        qcom,mdss-dsi-eyecare-level7-command = <0x23000000 0x2ff 0x1230000 0x02 0xfb012300 0x00 0x2750023 0x00 0x27675 0x23000000 0x277 0x230000 0x02 0x78802300 0x00 0x2790023 0x00 0x27a93 0x23000000 0x27b 0x230000 0x02 0x7ca42300 0x00 0x27d0023 0x00 0x27eb4 0x23000000 0x27f 0x230000 0x02 0x80c32300 0x00 0x2810023 0x00 0x282d1 0x23000000 0x283 0x230000 0x02 0x84de2300 0x00 0x2850023 0x00 0x286ea 0x23000000 0x287 0x1230000 0x02 0x88142300 0x00 0x2890123 0x00 0x28a38 0x23000000 0x28b 0x1230000 0x02 0x8c702300 0x00 0x28d0123 0x00 0x28e9e 0x23000000 0x28f 0x1230000 0x02 0x90e72300 0x00 0x2910223 0x00 0x29222 0x23000000 0x293 0x2230000 0x02 0x94242300 0x00 0x2950223 0x00 0x2965c 0x23000000 0x297 0x2230000 0x02 0x989c2300 0x00 0x2990223 0x00 0x29ac5 0x23000000 0x29b 0x2230000 0x02 0x9cfe2300 0x00 0x29d0323 0x00 0x29e23 0x23000000 0x29f 0x3230000 0x02 0xa0512300 0x00 0x2a20323 0x00 0x2a35f 0x23000000 0x2a4 0x3230000 0x02 0xa56e2300 0x00 0x2a60323 0x00 0x2a77f 0x23000000 0x2a9 0x3230000 0x02 0xaa922300 0x00 0x2ab0323 0x00 0x2aca9 0x23000000 0x2ad 0x3230000 0x02 0xaec02300 0x00 0x2af0323 0x00 0x2b0ce 0x23000000 0x2b1 0x3230000 0x02 0xb2cf2300 0x00 0x2b30023 0x00 0x2b475 0x23000000 0x2b5 0x230000 0x02 0xb6802300 0x00 0x2b70023 0x00 0x2b893 0x23000000 0x2b9 0x230000 0x02 0xbaa42300 0x00 0x2bb0023 0x00 0x2bcb4 0x23000000 0x2bd 0x230000 0x02 0xbec32300 0x00 0x2bf0023 0x00 0x2c0d1 0x23000000 0x2c1 0x230000 0x02 0xc2de2300 0x00 0x2c30023 0x00 0x2c4ea 0x23000000 0x2c5 0x1230000 0x02 0xc6142300 0x00 0x2c70123 0x00 0x2c838 0x23000000 0x2c9 0x1230000 0x02 0xca702300 0x00 0x2cb0123 0x00 0x2cc9e 0x23000000 0x2cd 0x1230000 0x02 0xcee72300 0x00 0x2cf0223 0x00 0x2d022 0x23000000 0x2d1 0x2230000 0x02 0xd2242300 0x00 0x2d30223 0x00 0x2d45c 0x23000000 0x2d5 0x2230000 0x02 0xd69c2300 0x00 0x2d70223 0x00 0x2d8c5 0x23000000 0x2d9 0x2230000 0x02 0xdafe2300 0x00 0x2db0323 0x00 0x2dc23 0x23000000 0x2dd 0x3230000 0x02 0xde512300 0x00 0x2df0323 0x00 0x2e05f 0x23000000 0x2e1 0x3230000 0x02 0xe26e2300 0x00 0x2e30323 0x00 0x2e47f 0x23000000 0x2e5 0x3230000 0x02 0xe6922300 0x00 0x2e70323 0x00 0x2e8a9 0x23000000 0x2e9 0x3230000 0x02 0xeac02300 0x00 0x2eb0323 0x00 0x2ecce 0x23000000 0x2ed 0x3230100 0x02 0xeecf2300 0x00 0x2ef0023 0x00 0x2f000 0x23000000 0x2f1 0x230000 0x02 0xf21d2300 0x00 0x2f30023 0x00 0x2f444 0x23000000 0x2f5 0x230000 0x02 0xf6612300 0x00 0x2f70023 0x00 0x2f878 0x23000000 0x2f9 0x230000 0x02 0xfa8d2300 0x00 0x2ff0223 0x00 0x2fb01 0x23000000 0x200 0x230000 0x02 0x19f2300 0x00 0x2020023 0x00 0x203b0 0x23000000 0x204 0x230000 0x02 0x5bf2300 0x00 0x2060023 0x00 0x207f3 0x23000000 0x208 0x1230000 0x02 0x91c2300 0x00 0x20a0123 0x00 0x20b5d 0x23000000 0x20c 0x1230000 0x02 0xd8f2300 0x00 0x20e0123 0x00 0x20fdf 0x23000000 0x210 0x2230000 0x02 0x111c2300 0x00 0x2120223 0x00 0x2131e 0x23000000 0x214 0x2230000 0x02 0x15582300 0x00 0x2160223 0x00 0x21799 0x23000000 0x218 0x2230000 0x02 0x19c32300 0x00 0x21a0223 0x00 0x21bfc 0x23000000 0x21c 0x3230000 0x02 0x1d212300 0x00 0x21e0323 0x00 0x21f4f 0x23000000 0x220 0x3230000 0x02 0x215c2300 0x00 0x2220323 0x00 0x2236b 0x23000000 0x224 0x3230000 0x02 0x257c2300 0x00 0x2260323 0x00 0x2278f 0x23000000 0x228 0x3230000 0x02 0x29a52300 0x00 0x22a0323 0x00 0x22bbe 0x23000000 0x22d 0x3230000 0x02 0x2fcd2300 0x00 0x2300323 0x00 0x231cf 0x23000000 0x232 0x230000 0x02 0x33002300 0x00 0x2340023 0x00 0x2351d 0x23000000 0x236 0x230000 0x02 0x37442300 0x00 0x2380023 0x00 0x23961 0x23000000 0x23a 0x230000 0x02 0x3b782300 0x00 0x23d0023 0x00 0x23f8d 0x23000000 0x240 0x230000 0x02 0x419f2300 0x00 0x2420023 0x00 0x243b0 0x23000000 0x244 0x230000 0x02 0x45bf2300 0x00 0x2460023 0x00 0x247f3 0x23000000 0x248 0x1230000 0x02 0x491c2300 0x00 0x24a0123 0x00 0x24b5d 0x23000000 0x24c 0x1230000 0x02 0x4d8f2300 0x00 0x24e0123 0x00 0x24fdf 0x23000000 0x250 0x2230000 0x02 0x511c2300 0x00 0x2520223 0x00 0x2531e 0x23000000 0x254 0x2230000 0x02 0x55582300 0x00 0x2560223 0x00 0x25899 0x23000000 0x259 0x2230000 0x02 0x5ac32300 0x00 0x25b0223 0x00 0x25cfc 0x23000000 0x25d 0x3230000 0x02 0x5e212300 0x00 0x25f0323 0x00 0x2604f 0x23000000 0x261 0x3230000 0x02 0x625c2300 0x00 0x2630323 0x00 0x2646b 0x23000000 0x265 0x3230000 0x02 0x667c2300 0x00 0x2670323 0x00 0x2688f 0x23000000 0x269 0x3230000 0x02 0x6aa52300 0x00 0x26b0323 0x00 0x26cbe 0x23000000 0x26d 0x3230000 0x02 0x6ecd2300 0x00 0x26f0323 0x1000000 0x270cf 0x23000000 0x271 0x1230000 0x02 0x72d52300 0x00 0x2730123 0x00 0x274d6 0x23000000 0x275 0x1230000 0x02 0x76d92300 0x00 0x2770123 0x00 0x278dc 0x23000000 0x279 0x1230000 0x02 0x7adf2300 0x00 0x27b0123 0x00 0x27ce2 0x23000000 0x27d 0x1230000 0x02 0x7ee42300 0x00 0x27f0123 0x00 0x280e7 0x23000000 0x281 0x1230000 0x02 0x82ea2300 0x00 0x2830123 0x00 0x284f3 0x23000000 0x285 0x1230000 0x02 0x86fe2300 0x00 0x2870223 0x00 0x28811 0x23000000 0x289 0x2230000 0x02 0x8a242300 0x00 0x28b0223 0x00 0x28c49 0x23000000 0x28d 0x2230000 0x02 0x8e6f2300 0x00 0x28f0223 0x00 0x29071 0x23000000 0x291 0x2230000 0x02 0x929c2300 0x00 0x2930223 0x00 0x294d6 0x23000000 0x295 0x2230000 0x02 0x96fc2300 0x00 0x2970323 0x00 0x2982f 0x23000000 0x299 0x3230000 0x02 0x9a4e2300 0x00 0x29b0323 0x00 0x29c73 0x23000000 0x29d 0x3230000 0x02 0x9e7d2300 0x00 0x29f0323 0x00 0x2a089 0x23000000 0x2a2 0x3230000 0x02 0xa3952300 0x00 0x2a40323 0x00 0x2a5a3 0x23000000 0x2a6 0x3230000 0x02 0xa7b22300 0x00 0x2a90323 0x00 0x2aac2 0x23000000 0x2ab 0x3230000 0x02 0xacce2300 0x00 0x2ad0323 0x00 0x2aecf 0x23000000 0x2af 0x1230000 0x02 0xb0d52300 0x00 0x2b10123 0x00 0x2b2d6 0x23000000 0x2b3 0x1230000 0x02 0xb4d92300 0x00 0x2b50123 0x00 0x2b6dc 0x23000000 0x2b7 0x1230000 0x02 0xb8df2300 0x00 0x2b90123 0x00 0x2bae2 0x23000000 0x2bb 0x1230000 0x02 0xbce42300 0x00 0x2bd0123 0x00 0x2bee7 0x23000000 0x2bf 0x1230000 0x02 0xc0ea2300 0x00 0x2c10123 0x00 0x2c2f3 0x23000000 0x2c3 0x1230000 0x02 0xc4fe2300 0x00 0x2c50223 0x00 0x2c611 0x23000000 0x2c7 0x2230000 0x02 0xc8242300 0x00 0x2c90223 0x00 0x2ca49 0x23000000 0x2cb 0x2230000 0x02 0xcc6f2300 0x00 0x2cd0223 0x00 0x2ce71 0x23000000 0x2cf 0x2230000 0x02 0xd09c2300 0x00 0x2d10223 0x00 0x2d2d6 0x23000000 0x2d3 0x2230000 0x02 0xd4fc2300 0x00 0x2d50323 0x00 0x2d62f 0x23000000 0x2d7 0x3230000 0x02 0xd84e2300 0x00 0x2d90323 0x00 0x2da73 0x23000000 0x2db 0x3230000 0x02 0xdc7d2300 0x00 0x2dd0323 0x00 0x2de89 0x23000000 0x2df 0x3230000 0x02 0xe0952300 0x00 0x2e10323 0x00 0x2e2a3 0x23000000 0x2e3 0x3230000 0x02 0xe4b22300 0x00 0x2e50323 0x00 0x2e6c2 0x23000000 0x2e7 0x3230000 0x02 0xe8ce2300 0x00 0x2e90323 0x1000000 0x2eacf>;
        qcom,mdss-dsi-eyecare-level8-command = <0x23000000 0x2ff 0x1230000 0x02 0xfb012300 0x00 0x2750023 0x00 0x27687 0x23000000 0x277 0x230000 0x02 0x78902300 0x00 0x2790023 0x00 0x27aa2 0x23000000 0x27b 0x230000 0x02 0x7cb22300 0x00 0x27d0023 0x00 0x27ec1 0x23000000 0x27f 0x230000 0x02 0x80cf2300 0x00 0x2810023 0x00 0x282dc 0x23000000 0x283 0x230000 0x02 0x84e82300 0x00 0x2850023 0x00 0x286f4 0x23000000 0x287 0x1230000 0x02 0x881c2300 0x00 0x2890123 0x00 0x28a3e 0x23000000 0x28b 0x1230000 0x02 0x8c752300 0x00 0x28d0123 0x00 0x28ea2 0x23000000 0x28f 0x1230000 0x02 0x90ea2300 0x00 0x2910223 0x00 0x29224 0x23000000 0x293 0x2230000 0x02 0x94252300 0x00 0x2950223 0x00 0x2965d 0x23000000 0x297 0x2230000 0x02 0x989d2300 0x00 0x2990223 0x00 0x29ac6 0x23000000 0x29b 0x2230000 0x02 0x9cfe2300 0x00 0x29d0323 0x00 0x29e24 0x23000000 0x29f 0x3230000 0x02 0xa0522300 0x00 0x2a20323 0x00 0x2a35f 0x23000000 0x2a4 0x3230000 0x02 0xa56e2300 0x00 0x2a60323 0x00 0x2a77f 0x23000000 0x2a9 0x3230000 0x02 0xaa932300 0x00 0x2ab0323 0x00 0x2aca9 0x23000000 0x2ad 0x3230000 0x02 0xaec02300 0x00 0x2af0323 0x00 0x2b0ce 0x23000000 0x2b1 0x3230000 0x02 0xb2cf2300 0x00 0x2b30023 0x00 0x2b487 0x23000000 0x2b5 0x230000 0x02 0xb6902300 0x00 0x2b70023 0x00 0x2b8a2 0x23000000 0x2b9 0x230000 0x02 0xbab22300 0x00 0x2bb0023 0x00 0x2bcc1 0x23000000 0x2bd 0x230000 0x02 0xbecf2300 0x00 0x2bf0023 0x00 0x2c0dc 0x23000000 0x2c1 0x230000 0x02 0xc2e82300 0x00 0x2c30023 0x00 0x2c4f4 0x23000000 0x2c5 0x1230000 0x02 0xc61c2300 0x00 0x2c70123 0x00 0x2c83e 0x23000000 0x2c9 0x1230000 0x02 0xca752300 0x00 0x2cb0123 0x00 0x2cca2 0x23000000 0x2cd 0x1230000 0x02 0xceea2300 0x00 0x2cf0223 0x00 0x2d024 0x23000000 0x2d1 0x2230000 0x02 0xd2252300 0x00 0x2d30223 0x00 0x2d45d 0x23000000 0x2d5 0x2230000 0x02 0xd69d2300 0x00 0x2d70223 0x00 0x2d8c6 0x23000000 0x2d9 0x2230000 0x02 0xdafe2300 0x00 0x2db0323 0x00 0x2dc24 0x23000000 0x2dd 0x3230000 0x02 0xde522300 0x00 0x2df0323 0x00 0x2e05f 0x23000000 0x2e1 0x3230000 0x02 0xe26e2300 0x00 0x2e30323 0x00 0x2e47f 0x23000000 0x2e5 0x3230000 0x02 0xe6932300 0x00 0x2e70323 0x00 0x2e8a9 0x23000000 0x2e9 0x3230000 0x02 0xeac02300 0x00 0x2eb0323 0x00 0x2ecce 0x23000000 0x2ed 0x3230100 0x02 0xeecf2300 0x00 0x2ef0023 0x00 0x2f000 0x23000000 0x2f1 0x230000 0x02 0xf21d2300 0x00 0x2f30023 0x00 0x2f444 0x23000000 0x2f5 0x230000 0x02 0xf6612300 0x00 0x2f70023 0x00 0x2f878 0x23000000 0x2f9 0x230000 0x02 0xfa8d2300 0x00 0x2ff0223 0x00 0x2fb01 0x23000000 0x200 0x230000 0x02 0x19f2300 0x00 0x2020023 0x00 0x203b0 0x23000000 0x204 0x230000 0x02 0x5bf2300 0x00 0x2060023 0x00 0x207f3 0x23000000 0x208 0x1230000 0x02 0x91c2300 0x00 0x20a0123 0x00 0x20b5d 0x23000000 0x20c 0x1230000 0x02 0xd8f2300 0x00 0x20e0123 0x00 0x20fdf 0x23000000 0x210 0x2230000 0x02 0x111c2300 0x00 0x2120223 0x00 0x2131e 0x23000000 0x214 0x2230000 0x02 0x15582300 0x00 0x2160223 0x00 0x21799 0x23000000 0x218 0x2230000 0x02 0x19c32300 0x00 0x21a0223 0x00 0x21bfc 0x23000000 0x21c 0x3230000 0x02 0x1d212300 0x00 0x21e0323 0x00 0x21f4f 0x23000000 0x220 0x3230000 0x02 0x215c2300 0x00 0x2220323 0x00 0x2236b 0x23000000 0x224 0x3230000 0x02 0x257c2300 0x00 0x2260323 0x00 0x2278f 0x23000000 0x228 0x3230000 0x02 0x29a52300 0x00 0x22a0323 0x00 0x22bbe 0x23000000 0x22d 0x3230000 0x02 0x2fcd2300 0x00 0x2300323 0x00 0x231cf 0x23000000 0x232 0x230000 0x02 0x33002300 0x00 0x2340023 0x00 0x2351d 0x23000000 0x236 0x230000 0x02 0x37442300 0x00 0x2380023 0x00 0x23961 0x23000000 0x23a 0x230000 0x02 0x3b782300 0x00 0x23d0023 0x00 0x23f8d 0x23000000 0x240 0x230000 0x02 0x419f2300 0x00 0x2420023 0x00 0x243b0 0x23000000 0x244 0x230000 0x02 0x45bf2300 0x00 0x2460023 0x00 0x247f3 0x23000000 0x248 0x1230000 0x02 0x491c2300 0x00 0x24a0123 0x00 0x24b5d 0x23000000 0x24c 0x1230000 0x02 0x4d8f2300 0x00 0x24e0123 0x00 0x24fdf 0x23000000 0x250 0x2230000 0x02 0x511c2300 0x00 0x2520223 0x00 0x2531e 0x23000000 0x254 0x2230000 0x02 0x55582300 0x00 0x2560223 0x00 0x25899 0x23000000 0x259 0x2230000 0x02 0x5ac32300 0x00 0x25b0223 0x00 0x25cfc 0x23000000 0x25d 0x3230000 0x02 0x5e212300 0x00 0x25f0323 0x00 0x2604f 0x23000000 0x261 0x3230000 0x02 0x625c2300 0x00 0x2630323 0x00 0x2646b 0x23000000 0x265 0x3230000 0x02 0x667c2300 0x00 0x2670323 0x00 0x2688f 0x23000000 0x269 0x3230000 0x02 0x6aa52300 0x00 0x26b0323 0x00 0x26cbe 0x23000000 0x26d 0x3230000 0x02 0x6ecd2300 0x00 0x26f0323 0x1000000 0x270cf 0x23000000 0x271 0x1230000 0x02 0x72ec2300 0x00 0x2730123 0x00 0x274ed 0x23000000 0x275 0x1230000 0x02 0x76f02300 0x00 0x2770123 0x00 0x278f2 0x23000000 0x279 0x1230000 0x02 0x7af42300 0x00 0x27b0123 0x00 0x27cf6 0x23000000 0x27d 0x1230000 0x02 0x7ef82300 0x00 0x27f0123 0x00 0x280fb 0x23000000 0x281 0x1230000 0x02 0x82fd2300 0x00 0x2830223 0x00 0x28406 0x23000000 0x285 0x2230000 0x02 0x86102300 0x00 0x2870223 0x00 0x28821 0x23000000 0x289 0x2230000 0x02 0x8a322300 0x00 0x28b0223 0x00 0x28c55 0x23000000 0x28d 0x2230000 0x02 0x8e7a2300 0x00 0x28f0223 0x00 0x2907b 0x23000000 0x291 0x2230000 0x02 0x92a62300 0x00 0x2930223 0x00 0x294df 0x23000000 0x295 0x3230000 0x02 0x96042300 0x00 0x2970323 0x00 0x29837 0x23000000 0x299 0x3230000 0x02 0x9a552300 0x00 0x29b0323 0x00 0x29c78 0x23000000 0x29d 0x3230000 0x02 0x9e822300 0x00 0x29f0323 0x00 0x2a08d 0x23000000 0x2a2 0x3230000 0x02 0xa3992300 0x00 0x2a40323 0x00 0x2a5a6 0x23000000 0x2a6 0x3230000 0x02 0xa7b42300 0x00 0x2a90323 0x00 0x2aac4 0x23000000 0x2ab 0x3230000 0x02 0xacce2300 0x00 0x2ad0323 0x00 0x2aecf 0x23000000 0x2af 0x1230000 0x02 0xb0ec2300 0x00 0x2b10123 0x00 0x2b2ed 0x23000000 0x2b3 0x1230000 0x02 0xb4f02300 0x00 0x2b50123 0x00 0x2b6f2 0x23000000 0x2b7 0x1230000 0x02 0xb8f42300 0x00 0x2b90123 0x00 0x2baf6 0x23000000 0x2bb 0x1230000 0x02 0xbcf82300 0x00 0x2bd0123 0x00 0x2befb 0x23000000 0x2bf 0x1230000 0x02 0xc0fd2300 0x00 0x2c10223 0x00 0x2c206 0x23000000 0x2c3 0x2230000 0x02 0xc4102300 0x00 0x2c50223 0x00 0x2c621 0x23000000 0x2c7 0x2230000 0x02 0xc8322300 0x00 0x2c90223 0x00 0x2ca55 0x23000000 0x2cb 0x2230000 0x02 0xcc7a2300 0x00 0x2cd0223 0x00 0x2ce7b 0x23000000 0x2cf 0x2230000 0x02 0xd0a62300 0x00 0x2d10223 0x00 0x2d2df 0x23000000 0x2d3 0x3230000 0x02 0xd4042300 0x00 0x2d50323 0x00 0x2d637 0x23000000 0x2d7 0x3230000 0x02 0xd8552300 0x00 0x2d90323 0x00 0x2da78 0x23000000 0x2db 0x3230000 0x02 0xdc822300 0x00 0x2dd0323 0x00 0x2de8d 0x23000000 0x2df 0x3230000 0x02 0xe0992300 0x00 0x2e10323 0x00 0x2e2a6 0x23000000 0x2e3 0x3230000 0x02 0xe4b42300 0x00 0x2e50323 0x00 0x2e6c4 0x23000000 0x2e7 0x3230000 0x02 0xe8ce2300 0x00 0x2e90323 0x1000000 0x2eacf>;
        qcom,mdss-dsi-cold-command-state = "dsi_hs_mode";
        qcom,mdss-dsi-warm-command-state = "dsi_hs_mode";
        qcom,mdss-dsi-default-command-state = "dsi_hs_mode";
        qcom,mdss-dsi-ceon-command-state = "dsi_hs_mode";
        qcom,mdss-dsi-ceoff-command-state = "dsi_hs_mode";
        qcom,mdss-dsi-eyecare-off-command-state = "dsi_hs_mode";
        qcom,mdss-dsi-eyecare-level1-command-state = "dsi_hs_mode";
        qcom,mdss-dsi-eyecare-level2-command-state = "dsi_hs_mode";
        qcom,mdss-dsi-eyecare-level3-command-state = "dsi_hs_mode";
        qcom,mdss-dsi-eyecare-level4-command-state = "dsi_hs_mode";
        qcom,mdss-dsi-eyecare-level5-command-state = "dsi_hs_mode";
        qcom,mdss-dsi-eyecare-level6-command-state = "dsi_hs_mode";
        qcom,mdss-dsi-eyecare-level7-command-state = "dsi_hs_mode";
        qcom,mdss-dsi-eyecare-level8-command-state = "dsi_hs_mode";
        qcom,mdss-dsi-panel-name = "tianma nt35596 1080p video mode dsi panel";
        qcom,mdss-dsi-panel-type = "dsi_video_mode";
        qcom,mdss-dsi-panel-framerate = <60>;
        qcom,mdss-dsi-virtual-channel-id = <0>;
        qcom,mdss-dsi-stream = <0>;
        qcom,mdss-dsi-panel-width = <1080>;
        qcom,mdss-dsi-panel-height = <1920>;
        qcom,mdss-dsi-h-front-porch = <98>;
        qcom,mdss-dsi-h-back-porch = <200>;
        qcom,mdss-dsi-h-pulse-width = <8>;
        qcom,mdss-dsi-h-sync-skew = <0>;
        qcom,mdss-dsi-v-back-porch = <8>;
        qcom,mdss-dsi-v-front-porch = <10>;
        qcom,mdss-dsi-v-pulse-width = <2>;
        qcom,mdss-dsi-h-left-border = <0>;
        qcom,mdss-dsi-h-right-border = <0>;
        qcom,mdss-dsi-v-top-border = <0>;
        qcom,mdss-dsi-v-bottom-border = <0>;
        qcom,mdss-dsi-bpp = <24>;
        qcom,mdss-dsi-underflow-color = <0xff>;
        qcom,mdss-dsi-border-color = <0>;
        qcom,mdss-dsi-h-sync-pulse = <0>;
        qcom,mdss-dsi-traffic-mode = "burst_mode";
        qcom,mdss-dsi-bllp-eof-power-mode;
        qcom,mdss-dsi-bllp-power-mode;
        qcom,mdss-dsi-lane-0-state;
        qcom,mdss-dsi-lane-1-state;
        qcom,mdss-dsi-lane-2-state;
        qcom,mdss-dsi-lane-3-state;
        qcom,mdss-dsi-panel-timings = <0xf83c2800 0x6e722e40 0x30030400>;
        qcom,mdss-dsi-t-clk-post = <0x02>;
        qcom,mdss-dsi-t-clk-pre = <0x2d>;
        qcom,mdss-dsi-bl-min-level = <1>;
        qcom,mdss-dsi-bl-max-level = <4095>;
        qcom,mdss-dsi-dma-trigger = "trigger_sw";
        qcom,mdss-dsi-mdp-trigger = "none";
        qcom,mdss-dsi-on-command = <0x23010000 0x2ff 0xee230100 0xa0002 0x18402301 0x1400 0x2180023 0x00 0x2fb01 0x23000000 0x27c 0x31230000 0x02 0x25032300 0x00 0x2ff0123 0x00 0x2fb01 0x23000000 0x275 0x230000 0x02 0x76002300 0x00 0x2770023 0x00 0x27821 0x23000000 0x279 0x230000 0x02 0x7a4a2300 0x00 0x27b0023 0x00 0x27c66 0x23000000 0x27d 0x230000 0x02 0x7e7f2300 0x00 0x27f0023 0x00 0x28094 0x23000000 0x281 0x230000 0x02 0x82a72300 0x00 0x2830023 0x00 0x284b8 0x23000000 0x285 0x230000 0x02 0x86c72300 0x00 0x2870023 0x00 0x288fb 0x23000000 0x289 0x1230000 0x02 0x8a252300 0x00 0x28b0123 0x00 0x28c61 0x23000000 0x28d 0x1230000 0x02 0x8e942300 0x00 0x28f0123 0x00 0x290e2 0x23000000 0x291 0x2230000 0x02 0x92202300 0x00 0x2930223 0x00 0x29422 0x23000000 0x295 0x2230000 0x02 0x965c2300 0x00 0x2970223 0x00 0x2989e 0x23000000 0x299 0x2230000 0x02 0x9ac92300 0x00 0x29b0323 0x00 0x29c01 0x23000000 0x29d 0x3230000 0x02 0x9e282300 0x00 0x29f0323 0x00 0x2a055 0x23000000 0x2a2 0x3230000 0x02 0xa3622300 0x00 0x2a40323 0x00 0x2a56f 0x23000000 0x2a6 0x3230000 0x02 0xa77e2300 0x00 0x2a90323 0x00 0x2aa8f 0x23000000 0x2ab 0x3230000 0x02 0xac9c2300 0x00 0x2ad0323 0x00 0x2aea2 0x23000000 0x2af 0x3230000 0x02 0xb0ab2300 0x00 0x2b10323 0x00 0x2b2b2 0x23000000 0x2b3 0x230000 0x02 0xb4002300 0x00 0x2b50023 0x00 0x2b621 0x23000000 0x2b7 0x230000 0x02 0xb84a2300 0x00 0x2b90023 0x00 0x2ba66 0x23000000 0x2bb 0x230000 0x02 0xbc7f2300 0x00 0x2bd0023 0x00 0x2be94 0x23000000 0x2bf 0x230000 0x02 0xc0a72300 0x00 0x2c10023 0x00 0x2c2b8 0x23000000 0x2c3 0x230000 0x02 0xc4c72300 0x00 0x2c50023 0x00 0x2c6fb 0x23000000 0x2c7 0x1230000 0x02 0xc8252300 0x00 0x2c90123 0x00 0x2ca61 0x23000000 0x2cb 0x1230000 0x02 0xcc942300 0x00 0x2cd0123 0x00 0x2cee2 0x23000000 0x2cf 0x2230000 0x02 0xd0202300 0x00 0x2d10223 0x00 0x2d222 0x23000000 0x2d3 0x2230000 0x02 0xd45c2300 0x00 0x2d50223 0x00 0x2d69e 0x23000000 0x2d7 0x2230000 0x02 0xd8c92300 0x00 0x2d90323 0x00 0x2da01 0x23000000 0x2db 0x3230000 0x02 0xdc282300 0x00 0x2dd0323 0x00 0x2de55 0x23000000 0x2df 0x3230000 0x02 0xe0622300 0x00 0x2e10323 0x00 0x2e26f 0x23000000 0x2e3 0x3230000 0x02 0xe47e2300 0x00 0x2e50323 0x00 0x2e68f 0x23000000 0x2e7 0x3230000 0x02 0xe89c2300 0x00 0x2e90323 0x00 0x2eaa2 0x23000000 0x2eb 0x3230000 0x02 0xecab2300 0x00 0x2ed0323 0x00 0x2eeb2 0x23000000 0x2ef 0x230000 0x02 0xf0002300 0x00 0x2f10023 0x00 0x2f221 0x23000000 0x2f3 0x230000 0x02 0xf44a2300 0x00 0x2f50023 0x00 0x2f666 0x23000000 0x2f7 0x230000 0x02 0xf87f2300 0x00 0x2f90023 0x00 0x2fa94 0x23000000 0x2ff 0x2230000 0x02 0xfb012300 0x00 0x2000023 0x00 0x201a7 0x23000000 0x202 0x230000 0x02 0x3b82300 0x00 0x2040023 0x00 0x205c7 0x23000000 0x206 0x230000 0x02 0x7fb2300 0x00 0x2080123 0x00 0x20925 0x23000000 0x20a 0x1230000 0x02 0xb612300 0x00 0x20c0123 0x00 0x20d94 0x23000000 0x20e 0x1230000 0x02 0xfe22300 0x00 0x2100223 0x00 0x21120 0x23000000 0x212 0x2230000 0x02 0x13222300 0x00 0x2140223 0x00 0x2155c 0x23000000 0x216 0x2230000 0x02 0x179e2300 0x00 0x2180223 0x00 0x219c9 0x23000000 0x21a 0x3230000 0x02 0x1b012300 0x00 0x21c0323 0x00 0x21d28 0x23000000 0x21e 0x3230000 0x02 0x1f552300 0x00 0x2200323 0x00 0x22162 0x23000000 0x222 0x3230000 0x02 0x236f2300 0x00 0x2240323 0x00 0x2257e 0x23000000 0x226 0x3230000 0x02 0x278f2300 0x00 0x2280323 0x00 0x2299c 0x23000000 0x22a 0x3230000 0x02 0x2ba22300 0x00 0x22d0323 0x00 0x22fab 0x23000000 0x230 0x3230000 0x02 0x31b22300 0x00 0x2320023 0x00 0x23300 0x23000000 0x234 0x230000 0x02 0x35212300 0x00 0x2360023 0x00 0x2374a 0x23000000 0x238 0x230000 0x02 0x39662300 0x00 0x23a0023 0x00 0x23b7f 0x23000000 0x23d 0x230000 0x02 0x3f942300 0x00 0x2400023 0x00 0x241a7 0x23000000 0x242 0x230000 0x02 0x43b82300 0x00 0x2440023 0x00 0x245c7 0x23000000 0x246 0x230000 0x02 0x47fb2300 0x00 0x2480123 0x00 0x24925 0x23000000 0x24a 0x1230000 0x02 0x4b612300 0x00 0x24c0123 0x00 0x24d94 0x23000000 0x24e 0x1230000 0x02 0x4fe22300 0x00 0x2500223 0x00 0x25120 0x23000000 0x252 0x2230000 0x02 0x53222300 0x00 0x2540223 0x00 0x2555c 0x23000000 0x256 0x2230000 0x02 0x589e2300 0x00 0x2590223 0x00 0x25ac9 0x23000000 0x25b 0x3230000 0x02 0x5c012300 0x00 0x25d0323 0x00 0x25e28 0x23000000 0x25f 0x3230000 0x02 0x60552300 0x00 0x2610323 0x00 0x26262 0x23000000 0x263 0x3230000 0x02 0x646f2300 0x00 0x2650323 0x00 0x2667e 0x23000000 0x267 0x3230000 0x02 0x688f2300 0x00 0x2690323 0x00 0x26a9c 0x23000000 0x26b 0x3230000 0x02 0x6ca22300 0x00 0x26d0323 0x00 0x26eab 0x23000000 0x26f 0x3230000 0x02 0x70b22300 0x00 0x2710023 0x00 0x27200 0x23000000 0x273 0x230000 0x02 0x741e2300 0x00 0x2750023 0x00 0x27648 0x23000000 0x277 0x230000 0x02 0x78572300 0x00 0x2790023 0x00 0x27a6a 0x23000000 0x27b 0x230000 0x02 0x7c802300 0x00 0x27d0023 0x00 0x27e90 0x23000000 0x27f 0x230000 0x02 0x80a02300 0x00 0x2810023 0x00 0x282ae 0x23000000 0x283 0x230000 0x02 0x84e32300 0x00 0x2850123 0x00 0x2860e 0x23000000 0x287 0x1230000 0x02 0x88502300 0x00 0x2890123 0x00 0x28a88 0x23000000 0x28b 0x1230000 0x02 0x8cda2300 0x00 0x28d0223 0x00 0x28e19 0x23000000 0x28f 0x2230000 0x02 0x901b2300 0x00 0x2910223 0x00 0x29258 0x23000000 0x293 0x2230000 0x02 0x949c2300 0x00 0x2950223 0x00 0x296c6 0x23000000 0x297 0x3230000 0x02 0x98012300 0x00 0x2990323 0x00 0x29a28 0x23000000 0x29b 0x3230000 0x02 0x9c552300 0x00 0x29d0323 0x00 0x29e62 0x23000000 0x29f 0x3230000 0x02 0xa06f2300 0x00 0x2a20323 0x00 0x2a37e 0x23000000 0x2a4 0x3230000 0x02 0xa58f2300 0x00 0x2a60323 0x00 0x2a79c 0x23000000 0x2a9 0x3230000 0x02 0xaaa22300 0x00 0x2ab0323 0x00 0x2acab 0x23000000 0x2ad 0x3230000 0x02 0xaeb22300 0x00 0x2af0023 0x00 0x2b000 0x23000000 0x2b1 0x230000 0x02 0xb21e2300 0x00 0x2b30023 0x00 0x2b448 0x23000000 0x2b5 0x230000 0x02 0xb6572300 0x00 0x2b70023 0x00 0x2b86a 0x23000000 0x2b9 0x230000 0x02 0xba802300 0x00 0x2bb0023 0x00 0x2bc90 0x23000000 0x2bd 0x230000 0x02 0xbea02300 0x00 0x2bf0023 0x00 0x2c0ae 0x23000000 0x2c1 0x230000 0x02 0xc2e32300 0x00 0x2c30123 0x00 0x2c40e 0x23000000 0x2c5 0x1230000 0x02 0xc6502300 0x00 0x2c70123 0x00 0x2c888 0x23000000 0x2c9 0x1230000 0x02 0xcada2300 0x00 0x2cb0223 0x00 0x2cc19 0x23000000 0x2cd 0x2230000 0x02 0xce1b2300 0x00 0x2cf0223 0x00 0x2d058 0x23000000 0x2d1 0x2230000 0x02 0xd29c2300 0x00 0x2d30223 0x00 0x2d4c6 0x23000000 0x2d5 0x3230000 0x02 0xd6012300 0x00 0x2d70323 0x00 0x2d828 0x23000000 0x2d9 0x3230000 0x02 0xda552300 0x00 0x2db0323 0x00 0x2dc62 0x23000000 0x2dd 0x3230000 0x02 0xde6f2300 0x00 0x2df0323 0x00 0x2e07e 0x23000000 0x2e1 0x3230000 0x02 0xe28f2300 0x00 0x2e30323 0x00 0x2e49c 0x23000000 0x2e5 0x3230000 0x02 0xe6a22300 0x00 0x2e70323 0x00 0x2e8ab 0x23000000 0x2e9 0x3230000 0x02 0xeab22300 0x00 0x2ff0023 0x00 0x2ff00 0x23000000 0x251 0x230000 0x02 0x532c2300 0x00 0x2550023 0x00 0x2ff00 0x23000000 0x2d3 0xa230100 0x02 0xd40a0501 0x6400 0x2110005 0x1000000 0x22900>;
        qcom,mdss-dsi-off-command = [05 01 00 00 96 00 02 28 00 05 01 00 00 3c 00 02 10 00];
        qcom,mdss-dsi-on-command-state = "dsi_lp_mode";
        qcom,mdss-dsi-off-command-state = "dsi_lp_mode";
        qcom,mdss-dsi-bl-pmic-control-type = "bl_ctrl_wled";
        qcom,mdss-dsi-reset-sequence = <1 10>, <0 1>, <1 10>, <0 1>, <1 20>;
        qcom,mdss-dsi-tx-eot-append;
        qcom,cont-splash-enabled;
        qcom,panel-supply-entries = <&dsi_panel_pwr_supply>;
        qcom,mdss-pan-physical-width-dimension = <70>;
        qcom,mdss-pan-physical-height-dimension = <128>;
        qcom,mdss-dsi-hbp-power-mode;
        qcom,mdss-dsi-panel-status-command = [06 01 00 01 05 00 02 0a 08];
        qcom,mdss-dsi-panel-status-command-state = "dsi_hs_mode";
        qcom,mdss-dsi-panel-status-check-mode = "reg_read";
        qcom,mdss-dsi-panel-status-value = <0x9c>;
        qcom,mdss-night-brightness = <0x09 0x1b 0x2d 0x3f>;
    };
};
