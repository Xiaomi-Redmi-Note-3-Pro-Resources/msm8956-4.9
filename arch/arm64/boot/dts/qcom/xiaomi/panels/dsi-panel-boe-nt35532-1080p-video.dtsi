/*
 * Copyright (c) 2015, The Linux Foundation. All rights reserved.
 * Copyright (C) 2016, XiaoMi, Inc.
 * Copyright (c) 2023, Irawans Prjkt. All rights reserved.
 *
 * This program is free software; you can redistribute it and/or modify
 * it under the terms of the GNU General Public License version 2 and
 * only version 2 as published by the Free Software Foundation.
 *
 * This program is distributed in the hope that it will be useful,
 * but WITHOUT ANY WARRANTY; without even the implied warranty of
 * MERCHANTABILITY or FITNESS FOR A PARTICULAR PURPOSE.  See the
 * GNU General Public License for more details.
 */
&mdss_mdp {
    dsi_boe_nt35532_1080_video: qcom,mdss_dsi_boe_nt35532_1080p_video {
        qcom,mdss-dsi-cold-command = [23 00 00 00 00 00 02 ff 01 23 00 00 00 00 00 02 fb 01 23 00 00 00 00 00 02 68 13 23 00 00 00 00 00 02 75 00 23 00 00 00 00 00 02 76 32 23 00 00 00 00 00 02 77 00 23 00 00 00 00 00 02 78 4d 23 00 00 00 00 00 02 79 00 23 00 00 00 00 00 02 7a 72 23 00 00 00 00 00 02 7b 00 23 00 00 00 00 00 02 7c 8e 23 00 00 00 00 00 02 7d 00 23 00 00 00 00 00 02 7e a5 23 00 00 00 00 00 02 7f 00 23 00 00 00 00 00 02 80 b9 23 00 00 00 00 00 02 81 00 23 00 00 00 00 00 02 82 d0 23 00 00 00 00 00 02 83 00 23 00 00 00 00 00 02 84 de 23 00 00 00 00 00 02 85 00 23 00 00 00 00 00 02 86 e9 23 00 00 00 00 00 02 87 01 23 00 00 00 00 00 02 88 19 23 00 00 00 00 00 02 89 01 23 00 00 00 00 00 02 8a 44 23 00 00 00 00 00 02 8b 01 23 00 00 00 00 00 02 8c 7f 23 00 00 00 00 00 02 8d 01 23 00 00 00 00 00 02 8e ae 23 00 00 00 00 00 02 8f 01 23 00 00 00 00 00 02 90 f6 23 00 00 00 00 00 02 91 02 23 00 00 00 00 00 02 92 2d 23 00 00 00 00 00 02 93 02 23 00 00 00 00 00 02 94 2f 23 00 00 00 00 00 02 95 02 23 00 00 00 00 00 02 96 63 23 00 00 00 00 00 02 97 02 23 00 00 00 00 00 02 98 9f 23 00 00 00 00 00 02 99 02 23 00 00 00 00 00 02 9a c7 23 00 00 00 00 00 02 9b 02 23 00 00 00 00 00 02 9c fe 23 00 00 00 00 00 02 9d 03 23 00 00 00 00 00 02 9e 26 23 00 00 00 00 00 02 9f 03 23 00 00 00 00 00 02 a0 57 23 00 00 00 00 00 02 a2 03 23 00 00 00 00 00 02 a3 65 23 00 00 00 00 00 02 a4 03 23 00 00 00 00 00 02 a5 75 23 00 00 00 00 00 02 a6 03 23 00 00 00 00 00 02 a7 87 23 00 00 00 00 00 02 a9 03 23 00 00 00 00 00 02 aa 9b 23 00 00 00 00 00 02 ab 03 23 00 00 00 00 00 02 ac b0 23 00 00 00 00 00 02 ad 03 23 00 00 00 00 00 02 ae c1 23 00 00 00 00 00 02 af 03 23 00 00 00 00 00 02 b0 c9 23 00 00 00 00 00 02 b1 03 23 00 00 00 00 00 02 b2 ca 23 00 00 00 00 00 02 b3 00 23 00 00 00 00 00 02 b4 32 23 00 00 00 00 00 02 b5 00 23 00 00 00 00 00 02 b6 4d 23 00 00 00 00 00 02 b7 00 23 00 00 00 00 00 02 b8 72 23 00 00 00 00 00 02 b9 00 23 00 00 00 00 00 02 ba 8e 23 00 00 00 00 00 02 bb 00 23 00 00 00 00 00 02 bc a5 23 00 00 00 00 00 02 bd 00 23 00 00 00 00 00 02 be b9 23 00 00 00 00 00 02 bf 00 23 00 00 00 00 00 02 c0 d0 23 00 00 00 00 00 02 c1 00 23 00 00 00 00 00 02 c2 de 23 00 00 00 00 00 02 c3 00 23 00 00 00 00 00 02 c4 e9 23 00 00 00 00 00 02 c5 01 23 00 00 00 00 00 02 c6 19 23 00 00 00 00 00 02 c7 01 23 00 00 00 00 00 02 c8 44 23 00 00 00 00 00 02 c9 01 23 00 00 00 00 00 02 ca 7f 23 00 00 00 00 00 02 cb 01 23 00 00 00 00 00 02 cc ae 23 00 00 00 00 00 02 cd 01 23 00 00 00 00 00 02 ce f6 23 00 00 00 00 00 02 cf 02 23 00 00 00 00 00 02 d0 2d 23 00 00 00 00 00 02 d1 02 23 00 00 00 00 00 02 d2 2f 23 00 00 00 00 00 02 d3 02 23 00 00 00 00 00 02 d4 63 23 00 00 00 00 00 02 d5 02 23 00 00 00 00 00 02 d6 9f 23 00 00 00 00 00 02 d7 02 23 00 00 00 00 00 02 d8 c7 23 00 00 00 00 00 02 d9 02 23 00 00 00 00 00 02 da fe 23 00 00 00 00 00 02 db 03 23 00 00 00 00 00 02 dc 26 23 00 00 00 00 00 02 dd 03 23 00 00 00 00 00 02 de 57 23 00 00 00 00 00 02 df 03 23 00 00 00 00 00 02 e0 65 23 00 00 00 00 00 02 e1 03 23 00 00 00 00 00 02 e2 75 23 00 00 00 00 00 02 e3 03 23 00 00 00 00 00 02 e4 87 23 00 00 00 00 00 02 e5 03 23 00 00 00 00 00 02 e6 9b 23 00 00 00 00 00 02 e7 03 23 00 00 00 00 00 02 e8 b0 23 00 00 00 00 00 02 e9 03 23 00 00 00 00 00 02 ea c1 23 00 00 00 00 00 02 eb 03 23 00 00 00 00 00 02 ec c9 23 00 00 00 00 00 02 ed 03 23 00 00 00 00 00 02 ee ca 23 00 00 00 00 00 02 ef 00 23 00 00 00 00 00 02 f0 c7 23 00 00 00 00 00 02 f1 00 23 00 00 00 00 00 02 f2 cf 23 00 00 00 00 00 02 f3 00 23 00 00 00 00 00 02 f4 dd 23 00 00 00 00 00 02 f5 00 23 00 00 00 00 00 02 f6 eb 23 00 00 00 00 00 02 f7 00 23 00 00 00 00 00 02 f8 f7 23 00 00 00 00 00 02 f9 01 23 00 00 00 00 00 02 fa 03 23 00 00 00 00 00 02 ff 02 23 00 00 00 00 00 02 fb 01 23 00 00 00 00 00 02 00 01 23 00 00 00 00 00 02 01 0e 23 00 00 00 00 00 02 02 01 23 00 00 00 00 00 02 03 18 23 00 00 00 00 00 02 04 01 23 00 00 00 00 00 02 05 22 23 00 00 00 00 00 02 06 01 23 00 00 00 00 00 02 07 45 23 00 00 00 00 00 02 08 01 23 00 00 00 00 00 02 09 63 23 00 00 00 00 00 02 0a 01 23 00 00 00 00 00 02 0b 95 23 00 00 00 00 00 02 0c 01 23 00 00 00 00 00 02 0d be 23 00 00 00 00 00 02 0e 01 23 00 00 00 00 00 02 0f ff 23 00 00 00 00 00 02 10 02 23 00 00 00 00 00 02 11 33 23 00 00 00 00 00 02 12 02 23 00 00 00 00 00 02 13 35 23 00 00 00 00 00 02 14 02 23 00 00 00 00 00 02 15 67 23 00 00 00 00 00 02 16 02 23 00 00 00 00 00 02 17 a2 23 00 00 00 00 00 02 18 02 23 00 00 00 00 00 02 19 ca 23 00 00 00 00 00 02 1a 03 23 00 00 00 00 00 02 1b 00 23 00 00 00 00 00 02 1c 03 23 00 00 00 00 00 02 1d 2a 23 00 00 00 00 00 02 1e 03 23 00 00 00 00 00 02 1f 5b 23 00 00 00 00 00 02 20 03 23 00 00 00 00 00 02 21 69 23 00 00 00 00 00 02 22 03 23 00 00 00 00 00 02 23 79 23 00 00 00 00 00 02 24 03 23 00 00 00 00 00 02 25 8b 23 00 00 00 00 00 02 26 03 23 00 00 00 00 00 02 27 9e 23 00 00 00 00 00 02 28 03 23 00 00 00 00 00 02 29 b2 23 00 00 00 00 00 02 2a 03 23 00 00 00 00 00 02 2b c2 23 00 00 00 00 00 02 2d 03 23 00 00 00 00 00 02 2f c9 23 00 00 00 00 00 02 30 03 23 00 00 00 00 00 02 31 ca 23 00 00 00 00 00 02 32 00 23 00 00 00 00 00 02 33 c7 23 00 00 00 00 00 02 34 00 23 00 00 00 00 00 02 35 cf 23 00 00 00 00 00 02 36 00 23 00 00 00 00 00 02 37 dd 23 00 00 00 00 00 02 38 00 23 00 00 00 00 00 02 39 eb 23 00 00 00 00 00 02 3a 00 23 00 00 00 00 00 02 3b f7 23 00 00 00 00 00 02 3d 01 23 00 00 00 00 00 02 3f 03 23 00 00 00 00 00 02 40 01 23 00 00 00 00 00 02 41 0e 23 00 00 00 00 00 02 42 01 23 00 00 00 00 00 02 43 18 23 00 00 00 00 00 02 44 01 23 00 00 00 00 00 02 45 22 23 00 00 00 00 00 02 46 01 23 00 00 00 00 00 02 47 45 23 00 00 00 00 00 02 48 01 23 00 00 00 00 00 02 49 63 23 00 00 00 00 00 02 4a 01 23 00 00 00 00 00 02 4b 95 23 00 00 00 00 00 02 4c 01 23 00 00 00 00 00 02 4d be 23 00 00 00 00 00 02 4e 01 23 00 00 00 00 00 02 4f ff 23 00 00 00 00 00 02 50 02 23 00 00 00 00 00 02 51 33 23 00 00 00 00 00 02 52 02 23 00 00 00 00 00 02 53 35 23 00 00 00 00 00 02 54 02 23 00 00 00 00 00 02 55 67 23 00 00 00 00 00 02 56 02 23 00 00 00 00 00 02 58 a2 23 00 00 00 00 00 02 59 02 23 00 00 00 00 00 02 5a ca 23 00 00 00 00 00 02 5b 03 23 00 00 00 00 00 02 5c 00 23 00 00 00 00 00 02 5d 03 23 00 00 00 00 00 02 5e 2a 23 00 00 00 00 00 02 5f 03 23 00 00 00 00 00 02 60 5b 23 00 00 00 00 00 02 61 03 23 00 00 00 00 00 02 62 69 23 00 00 00 00 00 02 63 03 23 00 00 00 00 00 02 64 79 23 00 00 00 00 00 02 65 03 23 00 00 00 00 00 02 66 8b 23 00 00 00 00 00 02 67 03 23 00 00 00 00 00 02 68 9e 23 00 00 00 00 00 02 69 03 23 00 00 00 00 00 02 6a b2 23 00 00 00 00 00 02 6b 03 23 00 00 00 00 00 02 6c c2 23 00 00 00 00 00 02 6d 03 23 00 00 00 00 00 02 6e c9 23 00 00 00 00 00 02 6f 03 23 00 00 00 00 00 02 70 ca 23 00 00 00 00 00 02 71 00 23 00 00 00 00 00 02 72 01 23 00 00 00 00 00 02 73 00 23 00 00 00 00 00 02 74 29 23 00 00 00 00 00 02 75 00 23 00 00 00 00 00 02 76 56 23 00 00 00 00 00 02 77 00 23 00 00 00 00 00 02 78 76 23 00 00 00 00 00 02 79 00 23 00 00 00 00 00 02 7a 8f 23 00 00 00 00 00 02 7b 00 23 00 00 00 00 00 02 7c a4 23 00 00 00 00 00 02 7d 00 23 00 00 00 00 00 02 7e bc 23 00 00 00 00 00 02 7f 00 23 00 00 00 00 00 02 80 cb 23 00 00 00 00 00 02 81 00 23 00 00 00 00 00 02 82 d7 23 00 00 00 00 00 02 83 01 23 00 00 00 00 00 02 84 09 23 00 00 00 00 00 02 85 01 23 00 00 00 00 00 02 86 35 23 00 00 00 00 00 02 87 01 23 00 00 00 00 00 02 88 72 23 00 00 00 00 00 02 89 01 23 00 00 00 00 00 02 8a a3 23 00 00 00 00 00 02 8b 01 23 00 00 00 00 00 02 8c ef 23 00 00 00 00 00 02 8d 02 23 00 00 00 00 00 02 8e 27 23 00 00 00 00 00 02 8f 02 23 00 00 00 00 00 02 90 29 23 00 00 00 00 00 02 91 02 23 00 00 00 00 00 02 92 5e 23 00 00 00 00 00 02 93 02 23 00 00 00 00 00 02 94 9b 23 00 00 00 00 00 02 95 02 23 00 00 00 00 00 02 96 c4 23 00 00 00 00 00 02 97 02 23 00 00 00 00 00 02 98 ff 23 00 00 00 00 00 02 99 03 23 00 00 00 00 00 02 9a 30 23 00 00 00 00 00 02 9b 03 23 00 00 00 00 00 02 9c 7c 23 00 00 00 00 00 02 9d 03 23 00 00 00 00 00 02 9e 8e 23 00 00 00 00 00 02 9f 03 23 00 00 00 00 00 02 a0 97 23 00 00 00 00 00 02 a2 03 23 00 00 00 00 00 02 a3 99 23 00 00 00 00 00 02 a4 03 23 00 00 00 00 00 02 a5 9c 23 00 00 00 00 00 02 a6 03 23 00 00 00 00 00 02 a7 ab 23 00 00 00 00 00 02 a9 03 23 00 00 00 00 00 02 aa be 23 00 00 00 00 00 02 ab 03 23 00 00 00 00 00 02 ac c9 23 00 00 00 00 00 02 ad 03 23 00 00 00 00 00 02 ae ca 23 00 00 00 00 00 02 af 00 23 00 00 00 00 00 02 b0 01 23 00 00 00 00 00 02 b1 00 23 00 00 00 00 00 02 b2 29 23 00 00 00 00 00 02 b3 00 23 00 00 00 00 00 02 b4 56 23 00 00 00 00 00 02 b5 00 23 00 00 00 00 00 02 b6 76 23 00 00 00 00 00 02 b7 00 23 00 00 00 00 00 02 b8 8f 23 00 00 00 00 00 02 b9 00 23 00 00 00 00 00 02 ba a4 23 00 00 00 00 00 02 bb 00 23 00 00 00 00 00 02 bc bc 23 00 00 00 00 00 02 bd 00 23 00 00 00 00 00 02 be cb 23 00 00 00 00 00 02 bf 00 23 00 00 00 00 00 02 c0 d7 23 00 00 00 00 00 02 c1 01 23 00 00 00 00 00 02 c2 09 23 00 00 00 00 00 02 c3 01 23 00 00 00 00 00 02 c4 35 23 00 00 00 00 00 02 c5 01 23 00 00 00 00 00 02 c6 72 23 00 00 00 00 00 02 c7 01 23 00 00 00 00 00 02 c8 a3 23 00 00 00 00 00 02 c9 01 23 00 00 00 00 00 02 ca ef 23 00 00 00 00 00 02 cb 02 23 00 00 00 00 00 02 cc 27 23 00 00 00 00 00 02 cd 02 23 00 00 00 00 00 02 ce 29 23 00 00 00 00 00 02 cf 02 23 00 00 00 00 00 02 d0 5e 23 00 00 00 00 00 02 d1 02 23 00 00 00 00 00 02 d2 9b 23 00 00 00 00 00 02 d3 02 23 00 00 00 00 00 02 d4 c4 23 00 00 00 00 00 02 d5 02 23 00 00 00 00 00 02 d6 ff 23 00 00 00 00 00 02 d7 03 23 00 00 00 00 00 02 d8 30 23 00 00 00 00 00 02 d9 03 23 00 00 00 00 00 02 da 7c 23 00 00 00 00 00 02 db 03 23 00 00 00 00 00 02 dc 8e 23 00 00 00 00 00 02 dd 03 23 00 00 00 00 00 02 de 97 23 00 00 00 00 00 02 df 03 23 00 00 00 00 00 02 e0 99 23 00 00 00 00 00 02 e1 03 23 00 00 00 00 00 02 e2 9c 23 00 00 00 00 00 02 e3 03 23 00 00 00 00 00 02 e4 ab 23 00 00 00 00 00 02 e5 03 23 00 00 00 00 00 02 e6 be 23 00 00 00 00 00 02 e7 03 23 00 00 00 00 00 02 e8 c9 23 00 00 00 00 00 02 e9 03 23 01 00 00 00 00 02 ea ca 23 01 00 00 00 00 02 ff 00];
        qcom,mdss-dsi-warm-command = [23 00 00 00 00 00 02 ff 01 23 00 00 00 00 00 02 fb 01 23 00 00 00 00 00 02 68 13 23 00 00 00 00 00 02 75 00 23 00 00 00 00 00 02 76 33 23 00 00 00 00 00 02 77 00 23 00 00 00 00 00 02 78 4a 23 00 00 00 00 00 02 79 00 23 00 00 00 00 00 02 7a 6d 23 00 00 00 00 00 02 7b 00 23 00 00 00 00 00 02 7c 87 23 00 00 00 00 00 02 7d 00 23 00 00 00 00 00 02 7e 9d 23 00 00 00 00 00 02 7f 00 23 00 00 00 00 00 02 80 b0 23 00 00 00 00 00 02 81 00 23 00 00 00 00 00 02 82 c1 23 00 00 00 00 00 02 83 00 23 00 00 00 00 00 02 84 d0 23 00 00 00 00 00 02 85 00 23 00 00 00 00 00 02 86 dd 23 00 00 00 00 00 02 87 01 23 00 00 00 00 00 02 88 0c 23 00 00 00 00 00 02 89 01 23 00 00 00 00 00 02 8a 31 23 00 00 00 00 00 02 8b 01 23 00 00 00 00 00 02 8c 6c 23 00 00 00 00 00 02 8d 01 23 00 00 00 00 00 02 8e 9b 23 00 00 00 00 00 02 8f 01 23 00 00 00 00 00 02 90 e4 23 00 00 00 00 00 02 91 02 23 00 00 00 00 00 02 92 1c 23 00 00 00 00 00 02 93 02 23 00 00 00 00 00 02 94 1e 23 00 00 00 00 00 02 95 02 23 00 00 00 00 00 02 96 50 23 00 00 00 00 00 02 97 02 23 00 00 00 00 00 02 98 89 23 00 00 00 00 00 02 99 02 23 00 00 00 00 00 02 9a ad 23 00 00 00 00 00 02 9b 02 23 00 00 00 00 00 02 9c df 23 00 00 00 00 00 02 9d 03 23 00 00 00 00 00 02 9e 04 23 00 00 00 00 00 02 9f 03 23 00 00 00 00 00 02 a0 30 23 00 00 00 00 00 02 a2 03 23 00 00 00 00 00 02 a3 3d 23 00 00 00 00 00 02 a4 03 23 00 00 00 00 00 02 a5 4c 23 00 00 00 00 00 02 a6 03 23 00 00 00 00 00 02 a7 5e 23 00 00 00 00 00 02 a9 03 23 00 00 00 00 00 02 aa 75 23 00 00 00 00 00 02 ab 03 23 00 00 00 00 00 02 ac 8f 23 00 00 00 00 00 02 ad 03 23 00 00 00 00 00 02 ae a8 23 00 00 00 00 00 02 af 03 23 00 00 00 00 00 02 b0 b2 23 00 00 00 00 00 02 b1 03 23 00 00 00 00 00 02 b2 b3 23 00 00 00 00 00 02 b3 00 23 00 00 00 00 00 02 b4 33 23 00 00 00 00 00 02 b5 00 23 00 00 00 00 00 02 b6 4a 23 00 00 00 00 00 02 b7 00 23 00 00 00 00 00 02 b8 6d 23 00 00 00 00 00 02 b9 00 23 00 00 00 00 00 02 ba 87 23 00 00 00 00 00 02 bb 00 23 00 00 00 00 00 02 bc 9d 23 00 00 00 00 00 02 bd 00 23 00 00 00 00 00 02 be b0 23 00 00 00 00 00 02 bf 00 23 00 00 00 00 00 02 c0 c1 23 00 00 00 00 00 02 c1 00 23 00 00 00 00 00 02 c2 d0 23 00 00 00 00 00 02 c3 00 23 00 00 00 00 00 02 c4 dd 23 00 00 00 00 00 02 c5 01 23 00 00 00 00 00 02 c6 0c 23 00 00 00 00 00 02 c7 01 23 00 00 00 00 00 02 c8 31 23 00 00 00 00 00 02 c9 01 23 00 00 00 00 00 02 ca 6c 23 00 00 00 00 00 02 cb 01 23 00 00 00 00 00 02 cc 9b 23 00 00 00 00 00 02 cd 01 23 00 00 00 00 00 02 ce e4 23 00 00 00 00 00 02 cf 02 23 00 00 00 00 00 02 d0 1c 23 00 00 00 00 00 02 d1 02 23 00 00 00 00 00 02 d2 1e 23 00 00 00 00 00 02 d3 02 23 00 00 00 00 00 02 d4 50 23 00 00 00 00 00 02 d5 02 23 00 00 00 00 00 02 d6 89 23 00 00 00 00 00 02 d7 02 23 00 00 00 00 00 02 d8 ad 23 00 00 00 00 00 02 d9 02 23 00 00 00 00 00 02 da df 23 00 00 00 00 00 02 db 03 23 00 00 00 00 00 02 dc 04 23 00 00 00 00 00 02 dd 03 23 00 00 00 00 00 02 de 30 23 00 00 00 00 00 02 df 03 23 00 00 00 00 00 02 e0 3d 23 00 00 00 00 00 02 e1 03 23 00 00 00 00 00 02 e2 4c 23 00 00 00 00 00 02 e3 03 23 00 00 00 00 00 02 e4 5e 23 00 00 00 00 00 02 e5 03 23 00 00 00 00 00 02 e6 75 23 00 00 00 00 00 02 e7 03 23 00 00 00 00 00 02 e8 8f 23 00 00 00 00 00 02 e9 03 23 00 00 00 00 00 02 ea a8 23 00 00 00 00 00 02 eb 03 23 00 00 00 00 00 02 ec b2 23 00 00 00 00 00 02 ed 03 23 00 00 00 00 00 02 ee b3 23 00 00 00 00 00 02 ef 00 23 00 00 00 00 00 02 f0 f4 23 00 00 00 00 00 02 f1 00 23 00 00 00 00 00 02 f2 fa 23 00 00 00 00 00 02 f3 01 23 00 00 00 00 00 02 f4 03 23 00 00 00 00 00 02 f5 01 23 00 00 00 00 00 02 f6 0d 23 00 00 00 00 00 02 f7 01 23 00 00 00 00 00 02 f8 16 23 00 00 00 00 00 02 f9 01 23 00 00 00 00 00 02 fa 1f 23 00 00 00 00 00 02 ff 02 23 00 00 00 00 00 02 fb 01 23 00 00 00 00 00 02 00 01 23 00 00 00 00 00 02 01 28 23 00 00 00 00 00 02 02 01 23 00 00 00 00 00 02 03 30 23 00 00 00 00 00 02 04 01 23 00 00 00 00 00 02 05 37 23 00 00 00 00 00 02 06 01 23 00 00 00 00 00 02 07 53 23 00 00 00 00 00 02 08 01 23 00 00 00 00 00 02 09 6c 23 00 00 00 00 00 02 0a 01 23 00 00 00 00 00 02 0b 98 23 00 00 00 00 00 02 0c 01 23 00 00 00 00 00 02 0d bd 23 00 00 00 00 00 02 0e 01 23 00 00 00 00 00 02 0f f8 23 00 00 00 00 00 02 10 02 23 00 00 00 00 00 02 11 2a 23 00 00 00 00 00 02 12 02 23 00 00 00 00 00 02 13 2c 23 00 00 00 00 00 02 14 02 23 00 00 00 00 00 02 15 5b 23 00 00 00 00 00 02 16 02 23 00 00 00 00 00 02 17 92 23 00 00 00 00 00 02 18 02 23 00 00 00 00 00 02 19 b7 23 00 00 00 00 00 02 1a 02 23 00 00 00 00 00 02 1b ea 23 00 00 00 00 00 02 1c 03 23 00 00 00 00 00 02 1d 0d 23 00 00 00 00 00 02 1e 03 23 00 00 00 00 00 02 1f 3c 23 00 00 00 00 00 02 20 03 23 00 00 00 00 00 02 21 4a 23 00 00 00 00 00 02 22 03 23 00 00 00 00 00 02 23 59 23 00 00 00 00 00 02 24 03 23 00 00 00 00 00 02 25 6a 23 00 00 00 00 00 02 26 03 23 00 00 00 00 00 02 27 7d 23 00 00 00 00 00 02 28 03 23 00 00 00 00 00 02 29 92 23 00 00 00 00 00 02 2a 03 23 00 00 00 00 00 02 2b a6 23 00 00 00 00 00 02 2d 03 23 00 00 00 00 00 02 2f b2 23 00 00 00 00 00 02 30 03 23 00 00 00 00 00 02 31 b3 23 00 00 00 00 00 02 32 00 23 00 00 00 00 00 02 33 f4 23 00 00 00 00 00 02 34 00 23 00 00 00 00 00 02 35 fa 23 00 00 00 00 00 02 36 01 23 00 00 00 00 00 02 37 03 23 00 00 00 00 00 02 38 01 23 00 00 00 00 00 02 39 0d 23 00 00 00 00 00 02 3a 01 23 00 00 00 00 00 02 3b 16 23 00 00 00 00 00 02 3d 01 23 00 00 00 00 00 02 3f 1f 23 00 00 00 00 00 02 40 01 23 00 00 00 00 00 02 41 28 23 00 00 00 00 00 02 42 01 23 00 00 00 00 00 02 43 30 23 00 00 00 00 00 02 44 01 23 00 00 00 00 00 02 45 37 23 00 00 00 00 00 02 46 01 23 00 00 00 00 00 02 47 53 23 00 00 00 00 00 02 48 01 23 00 00 00 00 00 02 49 6c 23 00 00 00 00 00 02 4a 01 23 00 00 00 00 00 02 4b 98 23 00 00 00 00 00 02 4c 01 23 00 00 00 00 00 02 4d bd 23 00 00 00 00 00 02 4e 01 23 00 00 00 00 00 02 4f f8 23 00 00 00 00 00 02 50 02 23 00 00 00 00 00 02 51 2a 23 00 00 00 00 00 02 52 02 23 00 00 00 00 00 02 53 2c 23 00 00 00 00 00 02 54 02 23 00 00 00 00 00 02 55 5b 23 00 00 00 00 00 02 56 02 23 00 00 00 00 00 02 58 92 23 00 00 00 00 00 02 59 02 23 00 00 00 00 00 02 5a b7 23 00 00 00 00 00 02 5b 02 23 00 00 00 00 00 02 5c ea 23 00 00 00 00 00 02 5d 03 23 00 00 00 00 00 02 5e 0d 23 00 00 00 00 00 02 5f 03 23 00 00 00 00 00 02 60 3c 23 00 00 00 00 00 02 61 03 23 00 00 00 00 00 02 62 4a 23 00 00 00 00 00 02 63 03 23 00 00 00 00 00 02 64 59 23 00 00 00 00 00 02 65 03 23 00 00 00 00 00 02 66 6a 23 00 00 00 00 00 02 67 03 23 00 00 00 00 00 02 68 7d 23 00 00 00 00 00 02 69 03 23 00 00 00 00 00 02 6a 92 23 00 00 00 00 00 02 6b 03 23 00 00 00 00 00 02 6c a6 23 00 00 00 00 00 02 6d 03 23 00 00 00 00 00 02 6e b2 23 00 00 00 00 00 02 6f 03 23 00 00 00 00 00 02 70 b3 23 00 00 00 00 00 02 71 01 23 00 00 00 00 00 02 72 26 23 00 00 00 00 00 02 73 01 23 00 00 00 00 00 02 74 2a 23 00 00 00 00 00 02 75 01 23 00 00 00 00 00 02 76 31 23 00 00 00 00 00 02 77 01 23 00 00 00 00 00 02 78 38 23 00 00 00 00 00 02 79 01 23 00 00 00 00 00 02 7a 3f 23 00 00 00 00 00 02 7b 01 23 00 00 00 00 00 02 7c 46 23 00 00 00 00 00 02 7d 01 23 00 00 00 00 00 02 7e 4d 23 00 00 00 00 00 02 7f 01 23 00 00 00 00 00 02 80 53 23 00 00 00 00 00 02 81 01 23 00 00 00 00 00 02 82 59 23 00 00 00 00 00 02 83 01 23 00 00 00 00 00 02 84 70 23 00 00 00 00 00 02 85 01 23 00 00 00 00 00 02 86 85 23 00 00 00 00 00 02 87 01 23 00 00 00 00 00 02 88 ab 23 00 00 00 00 00 02 89 01 23 00 00 00 00 00 02 8a cc 23 00 00 00 00 00 02 8b 02 23 00 00 00 00 00 02 8c 02 23 00 00 00 00 00 02 8d 02 23 00 00 00 00 00 02 8e 31 23 00 00 00 00 00 02 8f 02 23 00 00 00 00 00 02 90 33 23 00 00 00 00 00 02 91 02 23 00 00 00 00 00 02 92 60 23 00 00 00 00 00 02 93 02 23 00 00 00 00 00 02 94 97 23 00 00 00 00 00 02 95 02 23 00 00 00 00 00 02 96 bd 23 00 00 00 00 00 02 97 02 23 00 00 00 00 00 02 98 f4 23 00 00 00 00 00 02 99 03 23 00 00 00 00 00 02 9a 1b 23 00 00 00 00 00 02 9b 03 23 00 00 00 00 00 02 9c 58 23 00 00 00 00 00 02 9d 03 23 00 00 00 00 00 02 9e 73 23 00 00 00 00 00 02 9f 03 23 00 00 00 00 00 02 a0 83 23 00 00 00 00 00 02 a2 03 23 00 00 00 00 00 02 a3 86 23 00 00 00 00 00 02 a4 03 23 00 00 00 00 00 02 a5 88 23 00 00 00 00 00 02 a6 03 23 00 00 00 00 00 02 a7 90 23 00 00 00 00 00 02 a9 03 23 00 00 00 00 00 02 aa a2 23 00 00 00 00 00 02 ab 03 23 00 00 00 00 00 02 ac b2 23 00 00 00 00 00 02 ad 03 23 00 00 00 00 00 02 ae b3 23 00 00 00 00 00 02 af 01 23 00 00 00 00 00 02 b0 26 23 00 00 00 00 00 02 b1 01 23 00 00 00 00 00 02 b2 2a 23 00 00 00 00 00 02 b3 01 23 00 00 00 00 00 02 b4 31 23 00 00 00 00 00 02 b5 01 23 00 00 00 00 00 02 b6 38 23 00 00 00 00 00 02 b7 01 23 00 00 00 00 00 02 b8 3f 23 00 00 00 00 00 02 b9 01 23 00 00 00 00 00 02 ba 46 23 00 00 00 00 00 02 bb 01 23 00 00 00 00 00 02 bc 4d 23 00 00 00 00 00 02 bd 01 23 00 00 00 00 00 02 be 53 23 00 00 00 00 00 02 bf 01 23 00 00 00 00 00 02 c0 59 23 00 00 00 00 00 02 c1 01 23 00 00 00 00 00 02 c2 70 23 00 00 00 00 00 02 c3 01 23 00 00 00 00 00 02 c4 85 23 00 00 00 00 00 02 c5 01 23 00 00 00 00 00 02 c6 ab 23 00 00 00 00 00 02 c7 01 23 00 00 00 00 00 02 c8 cc 23 00 00 00 00 00 02 c9 02 23 00 00 00 00 00 02 ca 02 23 00 00 00 00 00 02 cb 02 23 00 00 00 00 00 02 cc 31 23 00 00 00 00 00 02 cd 02 23 00 00 00 00 00 02 ce 33 23 00 00 00 00 00 02 cf 02 23 00 00 00 00 00 02 d0 60 23 00 00 00 00 00 02 d1 02 23 00 00 00 00 00 02 d2 97 23 00 00 00 00 00 02 d3 02 23 00 00 00 00 00 02 d4 bd 23 00 00 00 00 00 02 d5 02 23 00 00 00 00 00 02 d6 f4 23 00 00 00 00 00 02 d7 03 23 00 00 00 00 00 02 d8 1b 23 00 00 00 00 00 02 d9 03 23 00 00 00 00 00 02 da 58 23 00 00 00 00 00 02 db 03 23 00 00 00 00 00 02 dc 73 23 00 00 00 00 00 02 dd 03 23 00 00 00 00 00 02 de 83 23 00 00 00 00 00 02 df 03 23 00 00 00 00 00 02 e0 86 23 00 00 00 00 00 02 e1 03 23 00 00 00 00 00 02 e2 88 23 00 00 00 00 00 02 e3 03 23 00 00 00 00 00 02 e4 90 23 00 00 00 00 00 02 e5 03 23 00 00 00 00 00 02 e6 a2 23 00 00 00 00 00 02 e7 03 23 00 00 00 00 00 02 e8 b2 23 00 00 00 00 00 02 e9 03 23 01 00 00 00 00 02 ea b3 23 01 00 00 00 00 02 ff 00];
        qcom,mdss-dsi-default-command = [23 00 00 00 00 00 02 ff 01 23 00 00 00 00 00 02 fb 01 23 00 00 00 00 00 02 68 13 23 00 00 00 00 00 02 75 00 23 00 00 00 00 00 02 76 00 23 00 00 00 00 00 02 77 00 23 00 00 00 00 00 02 78 22 23 00 00 00 00 00 02 79 00 23 00 00 00 00 00 02 7a 51 23 00 00 00 00 00 02 7b 00 23 00 00 00 00 00 02 7c 73 23 00 00 00 00 00 02 7d 00 23 00 00 00 00 00 02 7e 8d 23 00 00 00 00 00 02 7f 00 23 00 00 00 00 00 02 80 a4 23 00 00 00 00 00 02 81 00 23 00 00 00 00 00 02 82 b8 23 00 00 00 00 00 02 83 00 23 00 00 00 00 00 02 84 ca 23 00 00 00 00 00 02 85 00 23 00 00 00 00 00 02 86 d9 23 00 00 00 00 00 02 87 01 23 00 00 00 00 00 02 88 0d 23 00 00 00 00 00 02 89 01 23 00 00 00 00 00 02 8a 36 23 00 00 00 00 00 02 8b 01 23 00 00 00 00 00 02 8c 75 23 00 00 00 00 00 02 8d 01 23 00 00 00 00 00 02 8e a7 23 00 00 00 00 00 02 8f 01 23 00 00 00 00 00 02 90 f2 23 00 00 00 00 00 02 91 02 23 00 00 00 00 00 02 92 2b 23 00 00 00 00 00 02 93 02 23 00 00 00 00 00 02 94 2b 23 00 00 00 00 00 02 95 02 23 00 00 00 00 00 02 96 61 23 00 00 00 00 00 02 97 02 23 00 00 00 00 00 02 98 9d 23 00 00 00 00 00 02 99 02 23 00 00 00 00 00 02 9a c6 23 00 00 00 00 00 02 9b 03 23 00 00 00 00 00 02 9c 01 23 00 00 00 00 00 02 9d 03 23 00 00 00 00 00 02 9e 27 23 00 00 00 00 00 02 9f 03 23 00 00 00 00 00 02 a0 63 23 00 00 00 00 00 02 a2 03 23 00 00 00 00 00 02 a3 6b 23 00 00 00 00 00 02 a4 03 23 00 00 00 00 00 02 a5 72 23 00 00 00 00 00 02 a6 03 23 00 00 00 00 00 02 a7 7e 23 00 00 00 00 00 02 a9 03 23 00 00 00 00 00 02 aa 87 23 00 00 00 00 00 02 ab 03 23 00 00 00 00 00 02 ac 93 23 00 00 00 00 00 02 ad 03 23 00 00 00 00 00 02 ae 9b 23 00 00 00 00 00 02 af 03 23 00 00 00 00 00 02 b0 a2 23 00 00 00 00 00 02 b1 03 23 00 00 00 00 00 02 b2 ff 23 00 00 00 00 00 02 b3 00 23 00 00 00 00 00 02 b4 00 23 00 00 00 00 00 02 b5 00 23 00 00 00 00 00 02 b6 22 23 00 00 00 00 00 02 b7 00 23 00 00 00 00 00 02 b8 51 23 00 00 00 00 00 02 b9 00 23 00 00 00 00 00 02 ba 73 23 00 00 00 00 00 02 bb 00 23 00 00 00 00 00 02 bc 8d 23 00 00 00 00 00 02 bd 00 23 00 00 00 00 00 02 be a4 23 00 00 00 00 00 02 bf 00 23 00 00 00 00 00 02 c0 b8 23 00 00 00 00 00 02 c1 00 23 00 00 00 00 00 02 c2 ca 23 00 00 00 00 00 02 c3 00 23 00 00 00 00 00 02 c4 d9 23 00 00 00 00 00 02 c5 01 23 00 00 00 00 00 02 c6 0d 23 00 00 00 00 00 02 c7 01 23 00 00 00 00 00 02 c8 36 23 00 00 00 00 00 02 c9 01 23 00 00 00 00 00 02 ca 75 23 00 00 00 00 00 02 cb 01 23 00 00 00 00 00 02 cc a7 23 00 00 00 00 00 02 cd 01 23 00 00 00 00 00 02 ce f2 23 00 00 00 00 00 02 cf 02 23 00 00 00 00 00 02 d0 2b 23 00 00 00 00 00 02 d1 02 23 00 00 00 00 00 02 d2 2b 23 00 00 00 00 00 02 d3 02 23 00 00 00 00 00 02 d4 61 23 00 00 00 00 00 02 d5 02 23 00 00 00 00 00 02 d6 9d 23 00 00 00 00 00 02 d7 02 23 00 00 00 00 00 02 d8 c6 23 00 00 00 00 00 02 d9 03 23 00 00 00 00 00 02 da 01 23 00 00 00 00 00 02 db 03 23 00 00 00 00 00 02 dc 27 23 00 00 00 00 00 02 dd 03 23 00 00 00 00 00 02 de 63 23 00 00 00 00 00 02 df 03 23 00 00 00 00 00 02 e0 6b 23 00 00 00 00 00 02 e1 03 23 00 00 00 00 00 02 e2 72 23 00 00 00 00 00 02 e3 03 23 00 00 00 00 00 02 e4 7e 23 00 00 00 00 00 02 e5 03 23 00 00 00 00 00 02 e6 87 23 00 00 00 00 00 02 e7 03 23 00 00 00 00 00 02 e8 93 23 00 00 00 00 00 02 e9 03 23 00 00 00 00 00 02 ea 9b 23 00 00 00 00 00 02 eb 03 23 00 00 00 00 00 02 ec a2 23 00 00 00 00 00 02 ed 03 23 00 00 00 00 00 02 ee ff 23 00 00 00 00 00 02 ef 00 23 00 00 00 00 00 02 f0 d6 23 00 00 00 00 00 02 f1 00 23 00 00 00 00 00 02 f2 dd 23 00 00 00 00 00 02 f3 00 23 00 00 00 00 00 02 f4 ea 23 00 00 00 00 00 02 f5 00 23 00 00 00 00 00 02 f6 f7 23 00 00 00 00 00 02 f7 01 23 00 00 00 00 00 02 f8 03 23 00 00 00 00 00 02 f9 01 23 00 00 00 00 00 02 fa 0d 23 00 00 00 00 00 02 ff 02 23 00 00 00 00 00 02 fb 01 23 00 00 00 00 00 02 00 01 23 00 00 00 00 00 02 01 17 23 00 00 00 00 00 02 02 01 23 00 00 00 00 00 02 03 21 23 00 00 00 00 00 02 04 01 23 00 00 00 00 00 02 05 2a 23 00 00 00 00 00 02 06 01 23 00 00 00 00 00 02 07 4b 23 00 00 00 00 00 02 08 01 23 00 00 00 00 00 02 09 68 23 00 00 00 00 00 02 0a 01 23 00 00 00 00 00 02 0b 98 23 00 00 00 00 00 02 0c 01 23 00 00 00 00 00 02 0d c0 23 00 00 00 00 00 02 0e 02 23 00 00 00 00 00 02 0f 00 23 00 00 00 00 00 02 10 02 23 00 00 00 00 00 02 11 34 23 00 00 00 00 00 02 12 02 23 00 00 00 00 00 02 13 35 23 00 00 00 00 00 02 14 02 23 00 00 00 00 00 02 15 68 23 00 00 00 00 00 02 16 02 23 00 00 00 00 00 02 17 a4 23 00 00 00 00 00 02 18 02 23 00 00 00 00 00 02 19 cc 23 00 00 00 00 00 02 1a 03 23 00 00 00 00 00 02 1b 07 23 00 00 00 00 00 02 1c 03 23 00 00 00 00 00 02 1d 2f 23 00 00 00 00 00 02 1e 03 23 00 00 00 00 00 02 1f 6a 23 00 00 00 00 00 02 20 03 23 00 00 00 00 00 02 21 71 23 00 00 00 00 00 02 22 03 23 00 00 00 00 00 02 23 85 23 00 00 00 00 00 02 24 03 23 00 00 00 00 00 02 25 9a 23 00 00 00 00 00 02 26 03 23 00 00 00 00 00 02 27 b2 23 00 00 00 00 00 02 28 03 23 00 00 00 00 00 02 29 ca 23 00 00 00 00 00 02 2a 03 23 00 00 00 00 00 02 2b e2 23 00 00 00 00 00 02 2d 03 23 00 00 00 00 00 02 2f f5 23 00 00 00 00 00 02 30 03 23 00 00 00 00 00 02 31 ff 23 00 00 00 00 00 02 32 00 23 00 00 00 00 00 02 33 d6 23 00 00 00 00 00 02 34 00 23 00 00 00 00 00 02 35 dd 23 00 00 00 00 00 02 36 00 23 00 00 00 00 00 02 37 ea 23 00 00 00 00 00 02 38 00 23 00 00 00 00 00 02 39 f7 23 00 00 00 00 00 02 3a 01 23 00 00 00 00 00 02 3b 03 23 00 00 00 00 00 02 3d 01 23 00 00 00 00 00 02 3f 0d 23 00 00 00 00 00 02 40 01 23 00 00 00 00 00 02 41 17 23 00 00 00 00 00 02 42 01 23 00 00 00 00 00 02 43 21 23 00 00 00 00 00 02 44 01 23 00 00 00 00 00 02 45 2a 23 00 00 00 00 00 02 46 01 23 00 00 00 00 00 02 47 4b 23 00 00 00 00 00 02 48 01 23 00 00 00 00 00 02 49 68 23 00 00 00 00 00 02 4a 01 23 00 00 00 00 00 02 4b 98 23 00 00 00 00 00 02 4c 01 23 00 00 00 00 00 02 4d c0 23 00 00 00 00 00 02 4e 02 23 00 00 00 00 00 02 4f 00 23 00 00 00 00 00 02 50 02 23 00 00 00 00 00 02 51 34 23 00 00 00 00 00 02 52 02 23 00 00 00 00 00 02 53 35 23 00 00 00 00 00 02 54 02 23 00 00 00 00 00 02 55 68 23 00 00 00 00 00 02 56 02 23 00 00 00 00 00 02 58 a4 23 00 00 00 00 00 02 59 02 23 00 00 00 00 00 02 5a cc 23 00 00 00 00 00 02 5b 03 23 00 00 00 00 00 02 5c 07 23 00 00 00 00 00 02 5d 03 23 00 00 00 00 00 02 5e 2f 23 00 00 00 00 00 02 5f 03 23 00 00 00 00 00 02 60 6a 23 00 00 00 00 00 02 61 03 23 00 00 00 00 00 02 62 71 23 00 00 00 00 00 02 63 03 23 00 00 00 00 00 02 64 85 23 00 00 00 00 00 02 65 03 23 00 00 00 00 00 02 66 9a 23 00 00 00 00 00 02 67 03 23 00 00 00 00 00 02 68 b2 23 00 00 00 00 00 02 69 03 23 00 00 00 00 00 02 6a ca 23 00 00 00 00 00 02 6b 03 23 00 00 00 00 00 02 6c e2 23 00 00 00 00 00 02 6d 03 23 00 00 00 00 00 02 6e f5 23 00 00 00 00 00 02 6f 03 23 00 00 00 00 00 02 70 ff 23 00 00 00 00 00 02 71 00 23 00 00 00 00 00 02 72 cd 23 00 00 00 00 00 02 73 00 23 00 00 00 00 00 02 74 d5 23 00 00 00 00 00 02 75 00 23 00 00 00 00 00 02 76 e3 23 00 00 00 00 00 02 77 00 23 00 00 00 00 00 02 78 ef 23 00 00 00 00 00 02 79 00 23 00 00 00 00 00 02 7a fb 23 00 00 00 00 00 02 7b 01 23 00 00 00 00 00 02 7c 06 23 00 00 00 00 00 02 7d 01 23 00 00 00 00 00 02 7e 11 23 00 00 00 00 00 02 7f 01 23 00 00 00 00 00 02 80 1b 23 00 00 00 00 00 02 81 01 23 00 00 00 00 00 02 82 24 23 00 00 00 00 00 02 83 01 23 00 00 00 00 00 02 84 46 23 00 00 00 00 00 02 85 01 23 00 00 00 00 00 02 86 63 23 00 00 00 00 00 02 87 01 23 00 00 00 00 00 02 88 94 23 00 00 00 00 00 02 89 01 23 00 00 00 00 00 02 8a bb 23 00 00 00 00 00 02 8b 01 23 00 00 00 00 00 02 8c fc 23 00 00 00 00 00 02 8d 02 23 00 00 00 00 00 02 8e 32 23 00 00 00 00 00 02 8f 02 23 00 00 00 00 00 02 90 32 23 00 00 00 00 00 02 91 02 23 00 00 00 00 00 02 92 66 23 00 00 00 00 00 02 93 02 23 00 00 00 00 00 02 94 a3 23 00 00 00 00 00 02 95 02 23 00 00 00 00 00 02 96 cc 23 00 00 00 00 00 02 97 03 23 00 00 00 00 00 02 98 0b 23 00 00 00 00 00 02 99 03 23 00 00 00 00 00 02 9a 38 23 00 00 00 00 00 02 9b 03 23 00 00 00 00 00 02 9c 8a 23 00 00 00 00 00 02 9d 03 23 00 00 00 00 00 02 9e 97 23 00 00 00 00 00 02 9f 03 23 00 00 00 00 00 02 a0 97 23 00 00 00 00 00 02 a2 03 23 00 00 00 00 00 02 a3 99 23 00 00 00 00 00 02 a4 03 23 00 00 00 00 00 02 a5 9b 23 00 00 00 00 00 02 a6 03 23 00 00 00 00 00 02 a7 9d 23 00 00 00 00 00 02 a9 03 23 00 00 00 00 00 02 aa 9f 23 00 00 00 00 00 02 ab 03 23 00 00 00 00 00 02 ac a1 23 00 00 00 00 00 02 ad 03 23 00 00 00 00 00 02 ae a2 23 00 00 00 00 00 02 af 00 23 00 00 00 00 00 02 b0 cd 23 00 00 00 00 00 02 b1 00 23 00 00 00 00 00 02 b2 d5 23 00 00 00 00 00 02 b3 00 23 00 00 00 00 00 02 b4 e3 23 00 00 00 00 00 02 b5 00 23 00 00 00 00 00 02 b6 ef 23 00 00 00 00 00 02 b7 00 23 00 00 00 00 00 02 b8 fb 23 00 00 00 00 00 02 b9 01 23 00 00 00 00 00 02 ba 06 23 00 00 00 00 00 02 bb 01 23 00 00 00 00 00 02 bc 11 23 00 00 00 00 00 02 bd 01 23 00 00 00 00 00 02 be 1b 23 00 00 00 00 00 02 bf 01 23 00 00 00 00 00 02 c0 24 23 00 00 00 00 00 02 c1 01 23 00 00 00 00 00 02 c2 46 23 00 00 00 00 00 02 c3 01 23 00 00 00 00 00 02 c4 63 23 00 00 00 00 00 02 c5 01 23 00 00 00 00 00 02 c6 94 23 00 00 00 00 00 02 c7 01 23 00 00 00 00 00 02 c8 bb 23 00 00 00 00 00 02 c9 01 23 00 00 00 00 00 02 ca fc 23 00 00 00 00 00 02 cb 02 23 00 00 00 00 00 02 cc 32 23 00 00 00 00 00 02 cd 02 23 00 00 00 00 00 02 ce 32 23 00 00 00 00 00 02 cf 02 23 00 00 00 00 00 02 d0 66 23 00 00 00 00 00 02 d1 02 23 00 00 00 00 00 02 d2 a3 23 00 00 00 00 00 02 d3 02 23 00 00 00 00 00 02 d4 cc 23 00 00 00 00 00 02 d5 03 23 00 00 00 00 00 02 d6 0b 23 00 00 00 00 00 02 d7 03 23 00 00 00 00 00 02 d8 38 23 00 00 00 00 00 02 d9 03 23 00 00 00 00 00 02 da 8a 23 00 00 00 00 00 02 db 03 23 00 00 00 00 00 02 dc 97 23 00 00 00 00 00 02 dd 03 23 00 00 00 00 00 02 de 97 23 00 00 00 00 00 02 df 03 23 00 00 00 00 00 02 e0 99 23 00 00 00 00 00 02 e1 03 23 00 00 00 00 00 02 e2 9b 23 00 00 00 00 00 02 e3 03 23 00 00 00 00 00 02 e4 9d 23 00 00 00 00 00 02 e5 03 23 00 00 00 00 00 02 e6 9f 23 00 00 00 00 00 02 e7 03 23 00 00 00 00 00 02 e8 a1 23 00 00 00 00 00 02 e9 03 23 01 00 00 00 00 02 ea a2 23 01 00 00 00 00 02 ff 00];
        qcom,mdss-dsi-ceon-command = [23 01 00 00 00 00 02 55 80];
        qcom,mdss-dsi-ceoff-command = [23 01 00 00 00 00 02 55 00];
        qcom,mdss-dsi-eyecare-off-command = [23 00 00 00 00 00 02 ff 01 23 00 00 00 00 00 02 fb 01 23 00 00 00 00 00 02 68 13 23 00 00 00 00 00 02 75 00 23 00 00 00 00 00 02 76 00 23 00 00 00 00 00 02 77 00 23 00 00 00 00 00 02 78 22 23 00 00 00 00 00 02 79 00 23 00 00 00 00 00 02 7a 51 23 00 00 00 00 00 02 7b 00 23 00 00 00 00 00 02 7c 73 23 00 00 00 00 00 02 7d 00 23 00 00 00 00 00 02 7e 8d 23 00 00 00 00 00 02 7f 00 23 00 00 00 00 00 02 80 a4 23 00 00 00 00 00 02 81 00 23 00 00 00 00 00 02 82 b8 23 00 00 00 00 00 02 83 00 23 00 00 00 00 00 02 84 ca 23 00 00 00 00 00 02 85 00 23 00 00 00 00 00 02 86 d9 23 00 00 00 00 00 02 87 01 23 00 00 00 00 00 02 88 0d 23 00 00 00 00 00 02 89 01 23 00 00 00 00 00 02 8a 36 23 00 00 00 00 00 02 8b 01 23 00 00 00 00 00 02 8c 75 23 00 00 00 00 00 02 8d 01 23 00 00 00 00 00 02 8e a7 23 00 00 00 00 00 02 8f 01 23 00 00 00 00 00 02 90 f2 23 00 00 00 00 00 02 91 02 23 00 00 00 00 00 02 92 2b 23 00 00 00 00 00 02 93 02 23 00 00 00 00 00 02 94 2b 23 00 00 00 00 00 02 95 02 23 00 00 00 00 00 02 96 61 23 00 00 00 00 00 02 97 02 23 00 00 00 00 00 02 98 9d 23 00 00 00 00 00 02 99 02 23 00 00 00 00 00 02 9a c6 23 00 00 00 00 00 02 9b 03 23 00 00 00 00 00 02 9c 01 23 00 00 00 00 00 02 9d 03 23 00 00 00 00 00 02 9e 27 23 00 00 00 00 00 02 9f 03 23 00 00 00 00 00 02 a0 63 23 00 00 00 00 00 02 a2 03 23 00 00 00 00 00 02 a3 6b 23 00 00 00 00 00 02 a4 03 23 00 00 00 00 00 02 a5 72 23 00 00 00 00 00 02 a6 03 23 00 00 00 00 00 02 a7 7e 23 00 00 00 00 00 02 a9 03 23 00 00 00 00 00 02 aa 87 23 00 00 00 00 00 02 ab 03 23 00 00 00 00 00 02 ac 93 23 00 00 00 00 00 02 ad 03 23 00 00 00 00 00 02 ae 9b 23 00 00 00 00 00 02 af 03 23 00 00 00 00 00 02 b0 a2 23 00 00 00 00 00 02 b1 03 23 00 00 00 00 00 02 b2 ff 23 00 00 00 00 00 02 b3 00 23 00 00 00 00 00 02 b4 00 23 00 00 00 00 00 02 b5 00 23 00 00 00 00 00 02 b6 22 23 00 00 00 00 00 02 b7 00 23 00 00 00 00 00 02 b8 51 23 00 00 00 00 00 02 b9 00 23 00 00 00 00 00 02 ba 73 23 00 00 00 00 00 02 bb 00 23 00 00 00 00 00 02 bc 8d 23 00 00 00 00 00 02 bd 00 23 00 00 00 00 00 02 be a4 23 00 00 00 00 00 02 bf 00 23 00 00 00 00 00 02 c0 b8 23 00 00 00 00 00 02 c1 00 23 00 00 00 00 00 02 c2 ca 23 00 00 00 00 00 02 c3 00 23 00 00 00 00 00 02 c4 d9 23 00 00 00 00 00 02 c5 01 23 00 00 00 00 00 02 c6 0d 23 00 00 00 00 00 02 c7 01 23 00 00 00 00 00 02 c8 36 23 00 00 00 00 00 02 c9 01 23 00 00 00 00 00 02 ca 75 23 00 00 00 00 00 02 cb 01 23 00 00 00 00 00 02 cc a7 23 00 00 00 00 00 02 cd 01 23 00 00 00 00 00 02 ce f2 23 00 00 00 00 00 02 cf 02 23 00 00 00 00 00 02 d0 2b 23 00 00 00 00 00 02 d1 02 23 00 00 00 00 00 02 d2 2b 23 00 00 00 00 00 02 d3 02 23 00 00 00 00 00 02 d4 61 23 00 00 00 00 00 02 d5 02 23 00 00 00 00 00 02 d6 9d 23 00 00 00 00 00 02 d7 02 23 00 00 00 00 00 02 d8 c6 23 00 00 00 00 00 02 d9 03 23 00 00 00 00 00 02 da 01 23 00 00 00 00 00 02 db 03 23 00 00 00 00 00 02 dc 27 23 00 00 00 00 00 02 dd 03 23 00 00 00 00 00 02 de 63 23 00 00 00 00 00 02 df 03 23 00 00 00 00 00 02 e0 6b 23 00 00 00 00 00 02 e1 03 23 00 00 00 00 00 02 e2 72 23 00 00 00 00 00 02 e3 03 23 00 00 00 00 00 02 e4 7e 23 00 00 00 00 00 02 e5 03 23 00 00 00 00 00 02 e6 87 23 00 00 00 00 00 02 e7 03 23 00 00 00 00 00 02 e8 93 23 00 00 00 00 00 02 e9 03 23 00 00 00 00 00 02 ea 9b 23 00 00 00 00 00 02 eb 03 23 00 00 00 00 00 02 ec a2 23 00 00 00 00 00 02 ed 03 23 00 00 00 00 00 02 ee ff 23 00 00 00 00 00 02 ef 00 23 00 00 00 00 00 02 f0 d6 23 00 00 00 00 00 02 f1 00 23 00 00 00 00 00 02 f2 dd 23 00 00 00 00 00 02 f3 00 23 00 00 00 00 00 02 f4 ea 23 00 00 00 00 00 02 f5 00 23 00 00 00 00 00 02 f6 f7 23 00 00 00 00 00 02 f7 01 23 00 00 00 00 00 02 f8 03 23 00 00 00 00 00 02 f9 01 23 00 00 00 00 00 02 fa 0d 23 00 00 00 00 00 02 ff 02 23 00 00 00 00 00 02 fb 01 23 00 00 00 00 00 02 00 01 23 00 00 00 00 00 02 01 17 23 00 00 00 00 00 02 02 01 23 00 00 00 00 00 02 03 21 23 00 00 00 00 00 02 04 01 23 00 00 00 00 00 02 05 2a 23 00 00 00 00 00 02 06 01 23 00 00 00 00 00 02 07 4b 23 00 00 00 00 00 02 08 01 23 00 00 00 00 00 02 09 68 23 00 00 00 00 00 02 0a 01 23 00 00 00 00 00 02 0b 98 23 00 00 00 00 00 02 0c 01 23 00 00 00 00 00 02 0d c0 23 00 00 00 00 00 02 0e 02 23 00 00 00 00 00 02 0f 00 23 00 00 00 00 00 02 10 02 23 00 00 00 00 00 02 11 34 23 00 00 00 00 00 02 12 02 23 00 00 00 00 00 02 13 35 23 00 00 00 00 00 02 14 02 23 00 00 00 00 00 02 15 68 23 00 00 00 00 00 02 16 02 23 00 00 00 00 00 02 17 a4 23 00 00 00 00 00 02 18 02 23 00 00 00 00 00 02 19 cc 23 00 00 00 00 00 02 1a 03 23 00 00 00 00 00 02 1b 07 23 00 00 00 00 00 02 1c 03 23 00 00 00 00 00 02 1d 2f 23 00 00 00 00 00 02 1e 03 23 00 00 00 00 00 02 1f 6a 23 00 00 00 00 00 02 20 03 23 00 00 00 00 00 02 21 71 23 00 00 00 00 00 02 22 03 23 00 00 00 00 00 02 23 85 23 00 00 00 00 00 02 24 03 23 00 00 00 00 00 02 25 9a 23 00 00 00 00 00 02 26 03 23 00 00 00 00 00 02 27 b2 23 00 00 00 00 00 02 28 03 23 00 00 00 00 00 02 29 ca 23 00 00 00 00 00 02 2a 03 23 00 00 00 00 00 02 2b e2 23 00 00 00 00 00 02 2d 03 23 00 00 00 00 00 02 2f f5 23 00 00 00 00 00 02 30 03 23 00 00 00 00 00 02 31 ff 23 00 00 00 00 00 02 32 00 23 00 00 00 00 00 02 33 d6 23 00 00 00 00 00 02 34 00 23 00 00 00 00 00 02 35 dd 23 00 00 00 00 00 02 36 00 23 00 00 00 00 00 02 37 ea 23 00 00 00 00 00 02 38 00 23 00 00 00 00 00 02 39 f7 23 00 00 00 00 00 02 3a 01 23 00 00 00 00 00 02 3b 03 23 00 00 00 00 00 02 3d 01 23 00 00 00 00 00 02 3f 0d 23 00 00 00 00 00 02 40 01 23 00 00 00 00 00 02 41 17 23 00 00 00 00 00 02 42 01 23 00 00 00 00 00 02 43 21 23 00 00 00 00 00 02 44 01 23 00 00 00 00 00 02 45 2a 23 00 00 00 00 00 02 46 01 23 00 00 00 00 00 02 47 4b 23 00 00 00 00 00 02 48 01 23 00 00 00 00 00 02 49 68 23 00 00 00 00 00 02 4a 01 23 00 00 00 00 00 02 4b 98 23 00 00 00 00 00 02 4c 01 23 00 00 00 00 00 02 4d c0 23 00 00 00 00 00 02 4e 02 23 00 00 00 00 00 02 4f 00 23 00 00 00 00 00 02 50 02 23 00 00 00 00 00 02 51 34 23 00 00 00 00 00 02 52 02 23 00 00 00 00 00 02 53 35 23 00 00 00 00 00 02 54 02 23 00 00 00 00 00 02 55 68 23 00 00 00 00 00 02 56 02 23 00 00 00 00 00 02 58 a4 23 00 00 00 00 00 02 59 02 23 00 00 00 00 00 02 5a cc 23 00 00 00 00 00 02 5b 03 23 00 00 00 00 00 02 5c 07 23 00 00 00 00 00 02 5d 03 23 00 00 00 00 00 02 5e 2f 23 00 00 00 00 00 02 5f 03 23 00 00 00 00 00 02 60 6a 23 00 00 00 00 00 02 61 03 23 00 00 00 00 00 02 62 71 23 00 00 00 00 00 02 63 03 23 00 00 00 00 00 02 64 85 23 00 00 00 00 00 02 65 03 23 00 00 00 00 00 02 66 9a 23 00 00 00 00 00 02 67 03 23 00 00 00 00 00 02 68 b2 23 00 00 00 00 00 02 69 03 23 00 00 00 00 00 02 6a ca 23 00 00 00 00 00 02 6b 03 23 00 00 00 00 00 02 6c e2 23 00 00 00 00 00 02 6d 03 23 00 00 00 00 00 02 6e f5 23 00 00 00 00 00 02 6f 03 23 00 00 00 00 00 02 70 ff 23 00 00 00 00 00 02 71 00 23 00 00 00 00 00 02 72 cd 23 00 00 00 00 00 02 73 00 23 00 00 00 00 00 02 74 d5 23 00 00 00 00 00 02 75 00 23 00 00 00 00 00 02 76 e3 23 00 00 00 00 00 02 77 00 23 00 00 00 00 00 02 78 ef 23 00 00 00 00 00 02 79 00 23 00 00 00 00 00 02 7a fb 23 00 00 00 00 00 02 7b 01 23 00 00 00 00 00 02 7c 06 23 00 00 00 00 00 02 7d 01 23 00 00 00 00 00 02 7e 11 23 00 00 00 00 00 02 7f 01 23 00 00 00 00 00 02 80 1b 23 00 00 00 00 00 02 81 01 23 00 00 00 00 00 02 82 24 23 00 00 00 00 00 02 83 01 23 00 00 00 00 00 02 84 46 23 00 00 00 00 00 02 85 01 23 00 00 00 00 00 02 86 63 23 00 00 00 00 00 02 87 01 23 00 00 00 00 00 02 88 94 23 00 00 00 00 00 02 89 01 23 00 00 00 00 00 02 8a bb 23 00 00 00 00 00 02 8b 01 23 00 00 00 00 00 02 8c fc 23 00 00 00 00 00 02 8d 02 23 00 00 00 00 00 02 8e 32 23 00 00 00 00 00 02 8f 02 23 00 00 00 00 00 02 90 32 23 00 00 00 00 00 02 91 02 23 00 00 00 00 00 02 92 66 23 00 00 00 00 00 02 93 02 23 00 00 00 00 00 02 94 a3 23 00 00 00 00 00 02 95 02 23 00 00 00 00 00 02 96 cc 23 00 00 00 00 00 02 97 03 23 00 00 00 00 00 02 98 0b 23 00 00 00 00 00 02 99 03 23 00 00 00 00 00 02 9a 38 23 00 00 00 00 00 02 9b 03 23 00 00 00 00 00 02 9c 8a 23 00 00 00 00 00 02 9d 03 23 00 00 00 00 00 02 9e 97 23 00 00 00 00 00 02 9f 03 23 00 00 00 00 00 02 a0 97 23 00 00 00 00 00 02 a2 03 23 00 00 00 00 00 02 a3 99 23 00 00 00 00 00 02 a4 03 23 00 00 00 00 00 02 a5 9b 23 00 00 00 00 00 02 a6 03 23 00 00 00 00 00 02 a7 9d 23 00 00 00 00 00 02 a9 03 23 00 00 00 00 00 02 aa 9f 23 00 00 00 00 00 02 ab 03 23 00 00 00 00 00 02 ac a1 23 00 00 00 00 00 02 ad 03 23 00 00 00 00 00 02 ae a2 23 00 00 00 00 00 02 af 00 23 00 00 00 00 00 02 b0 cd 23 00 00 00 00 00 02 b1 00 23 00 00 00 00 00 02 b2 d5 23 00 00 00 00 00 02 b3 00 23 00 00 00 00 00 02 b4 e3 23 00 00 00 00 00 02 b5 00 23 00 00 00 00 00 02 b6 ef 23 00 00 00 00 00 02 b7 00 23 00 00 00 00 00 02 b8 fb 23 00 00 00 00 00 02 b9 01 23 00 00 00 00 00 02 ba 06 23 00 00 00 00 00 02 bb 01 23 00 00 00 00 00 02 bc 11 23 00 00 00 00 00 02 bd 01 23 00 00 00 00 00 02 be 1b 23 00 00 00 00 00 02 bf 01 23 00 00 00 00 00 02 c0 24 23 00 00 00 00 00 02 c1 01 23 00 00 00 00 00 02 c2 46 23 00 00 00 00 00 02 c3 01 23 00 00 00 00 00 02 c4 63 23 00 00 00 00 00 02 c5 01 23 00 00 00 00 00 02 c6 94 23 00 00 00 00 00 02 c7 01 23 00 00 00 00 00 02 c8 bb 23 00 00 00 00 00 02 c9 01 23 00 00 00 00 00 02 ca fc 23 00 00 00 00 00 02 cb 02 23 00 00 00 00 00 02 cc 32 23 00 00 00 00 00 02 cd 02 23 00 00 00 00 00 02 ce 32 23 00 00 00 00 00 02 cf 02 23 00 00 00 00 00 02 d0 66 23 00 00 00 00 00 02 d1 02 23 00 00 00 00 00 02 d2 a3 23 00 00 00 00 00 02 d3 02 23 00 00 00 00 00 02 d4 cc 23 00 00 00 00 00 02 d5 03 23 00 00 00 00 00 02 d6 0b 23 00 00 00 00 00 02 d7 03 23 00 00 00 00 00 02 d8 38 23 00 00 00 00 00 02 d9 03 23 00 00 00 00 00 02 da 8a 23 00 00 00 00 00 02 db 03 23 00 00 00 00 00 02 dc 97 23 00 00 00 00 00 02 dd 03 23 00 00 00 00 00 02 de 97 23 00 00 00 00 00 02 df 03 23 00 00 00 00 00 02 e0 99 23 00 00 00 00 00 02 e1 03 23 00 00 00 00 00 02 e2 9b 23 00 00 00 00 00 02 e3 03 23 00 00 00 00 00 02 e4 9d 23 00 00 00 00 00 02 e5 03 23 00 00 00 00 00 02 e6 9f 23 00 00 00 00 00 02 e7 03 23 00 00 00 00 00 02 e8 a1 23 00 00 00 00 00 02 e9 03 23 01 00 00 00 00 02 ea a2 23 01 00 00 00 00 02 ff 00];
        qcom,mdss-dsi-eyecare-level1-command = [23 00 00 00 00 00 02 ff 01 23 00 00 00 00 00 02 fb 01 23 00 00 00 00 00 02 68 13 23 00 00 00 00 00 02 75 00 23 00 00 00 00 00 02 76 00 23 00 00 00 00 00 02 77 00 23 00 00 00 00 00 02 78 29 23 00 00 00 00 00 02 79 00 23 00 00 00 00 00 02 7a 59 23 00 00 00 00 00 02 7b 00 23 00 00 00 00 00 02 7c 7a 23 00 00 00 00 00 02 7d 00 23 00 00 00 00 00 02 7e 93 23 00 00 00 00 00 02 7f 00 23 00 00 00 00 00 02 80 a9 23 00 00 00 00 00 02 81 00 23 00 00 00 00 00 02 82 bc 23 00 00 00 00 00 02 83 00 23 00 00 00 00 00 02 84 cd 23 00 00 00 00 00 02 85 00 23 00 00 00 00 00 02 86 dc 23 00 00 00 00 00 02 87 01 23 00 00 00 00 00 02 88 0e 23 00 00 00 00 00 02 89 01 23 00 00 00 00 00 02 8a 36 23 00 00 00 00 00 02 8b 01 23 00 00 00 00 00 02 8c 75 23 00 00 00 00 00 02 8d 01 23 00 00 00 00 00 02 8e a5 23 00 00 00 00 00 02 8f 01 23 00 00 00 00 00 02 90 f0 23 00 00 00 00 00 02 91 02 23 00 00 00 00 00 02 92 29 23 00 00 00 00 00 02 93 02 23 00 00 00 00 00 02 94 2a 23 00 00 00 00 00 02 95 02 23 00 00 00 00 00 02 96 5f 23 00 00 00 00 00 02 97 02 23 00 00 00 00 00 02 98 9a 23 00 00 00 00 00 02 99 02 23 00 00 00 00 00 02 9a c2 23 00 00 00 00 00 02 9b 02 23 00 00 00 00 00 02 9c f9 23 00 00 00 00 00 02 9d 03 23 00 00 00 00 00 02 9e 1f 23 00 00 00 00 00 02 9f 03 23 00 00 00 00 00 02 a0 50 23 00 00 00 00 00 02 a2 03 23 00 00 00 00 00 02 a3 5f 23 00 00 00 00 00 02 a4 03 23 00 00 00 00 00 02 a5 6e 23 00 00 00 00 00 02 a6 03 23 00 00 00 00 00 02 a7 80 23 00 00 00 00 00 02 a9 03 23 00 00 00 00 00 02 aa 94 23 00 00 00 00 00 02 ab 03 23 00 00 00 00 00 02 ac ac 23 00 00 00 00 00 02 ad 03 23 00 00 00 00 00 02 ae c3 23 00 00 00 00 00 02 af 03 23 00 00 00 00 00 02 b0 d2 23 00 00 00 00 00 02 b1 03 23 00 00 00 00 00 02 b2 d3 23 00 00 00 00 00 02 b3 00 23 00 00 00 00 00 02 b4 00 23 00 00 00 00 00 02 b5 00 23 00 00 00 00 00 02 b6 29 23 00 00 00 00 00 02 b7 00 23 00 00 00 00 00 02 b8 59 23 00 00 00 00 00 02 b9 00 23 00 00 00 00 00 02 ba 7a 23 00 00 00 00 00 02 bb 00 23 00 00 00 00 00 02 bc 93 23 00 00 00 00 00 02 bd 00 23 00 00 00 00 00 02 be a9 23 00 00 00 00 00 02 bf 00 23 00 00 00 00 00 02 c0 bc 23 00 00 00 00 00 02 c1 00 23 00 00 00 00 00 02 c2 cd 23 00 00 00 00 00 02 c3 00 23 00 00 00 00 00 02 c4 dc 23 00 00 00 00 00 02 c5 01 23 00 00 00 00 00 02 c6 0e 23 00 00 00 00 00 02 c7 01 23 00 00 00 00 00 02 c8 36 23 00 00 00 00 00 02 c9 01 23 00 00 00 00 00 02 ca 75 23 00 00 00 00 00 02 cb 01 23 00 00 00 00 00 02 cc a5 23 00 00 00 00 00 02 cd 01 23 00 00 00 00 00 02 ce f0 23 00 00 00 00 00 02 cf 02 23 00 00 00 00 00 02 d0 29 23 00 00 00 00 00 02 d1 02 23 00 00 00 00 00 02 d2 2a 23 00 00 00 00 00 02 d3 02 23 00 00 00 00 00 02 d4 5f 23 00 00 00 00 00 02 d5 02 23 00 00 00 00 00 02 d6 9a 23 00 00 00 00 00 02 d7 02 23 00 00 00 00 00 02 d8 c2 23 00 00 00 00 00 02 d9 02 23 00 00 00 00 00 02 da f9 23 00 00 00 00 00 02 db 03 23 00 00 00 00 00 02 dc 1f 23 00 00 00 00 00 02 dd 03 23 00 00 00 00 00 02 de 50 23 00 00 00 00 00 02 df 03 23 00 00 00 00 00 02 e0 5f 23 00 00 00 00 00 02 e1 03 23 00 00 00 00 00 02 e2 6e 23 00 00 00 00 00 02 e3 03 23 00 00 00 00 00 02 e4 80 23 00 00 00 00 00 02 e5 03 23 00 00 00 00 00 02 e6 94 23 00 00 00 00 00 02 e7 03 23 00 00 00 00 00 02 e8 ac 23 00 00 00 00 00 02 e9 03 23 00 00 00 00 00 02 ea c3 23 00 00 00 00 00 02 eb 03 23 00 00 00 00 00 02 ec d2 23 00 00 00 00 00 02 ed 03 23 00 00 00 00 00 02 ee d3 23 00 00 00 00 00 02 ef 00 23 00 00 00 00 00 02 f0 d6 23 00 00 00 00 00 02 f1 00 23 00 00 00 00 00 02 f2 dd 23 00 00 00 00 00 02 f3 00 23 00 00 00 00 00 02 f4 ea 23 00 00 00 00 00 02 f5 00 23 00 00 00 00 00 02 f6 f6 23 00 00 00 00 00 02 f7 01 23 00 00 00 00 00 02 f8 02 23 00 00 00 00 00 02 f9 01 23 00 00 00 00 00 02 fa 0c 23 00 00 00 00 00 02 ff 02 23 00 00 00 00 00 02 fb 01 23 00 00 00 00 00 02 00 01 23 00 00 00 00 00 02 01 17 23 00 00 00 00 00 02 02 01 23 00 00 00 00 00 02 03 20 23 00 00 00 00 00 02 04 01 23 00 00 00 00 00 02 05 29 23 00 00 00 00 00 02 06 01 23 00 00 00 00 00 02 07 4b 23 00 00 00 00 00 02 08 01 23 00 00 00 00 00 02 09 67 23 00 00 00 00 00 02 0a 01 23 00 00 00 00 00 02 0b 97 23 00 00 00 00 00 02 0c 01 23 00 00 00 00 00 02 0d bf 23 00 00 00 00 00 02 0e 01 23 00 00 00 00 00 02 0f fe 23 00 00 00 00 00 02 10 02 23 00 00 00 00 00 02 11 32 23 00 00 00 00 00 02 12 02 23 00 00 00 00 00 02 13 34 23 00 00 00 00 00 02 14 02 23 00 00 00 00 00 02 15 66 23 00 00 00 00 00 02 16 02 23 00 00 00 00 00 02 17 a0 23 00 00 00 00 00 02 18 02 23 00 00 00 00 00 02 19 c8 23 00 00 00 00 00 02 1a 02 23 00 00 00 00 00 02 1b fe 23 00 00 00 00 00 02 1c 03 23 00 00 00 00 00 02 1d 26 23 00 00 00 00 00 02 1e 03 23 00 00 00 00 00 02 1f 56 23 00 00 00 00 00 02 20 03 23 00 00 00 00 00 02 21 64 23 00 00 00 00 00 02 22 03 23 00 00 00 00 00 02 23 74 23 00 00 00 00 00 02 24 03 23 00 00 00 00 00 02 25 85 23 00 00 00 00 00 02 26 03 23 00 00 00 00 00 02 27 99 23 00 00 00 00 00 02 28 03 23 00 00 00 00 00 02 29 b0 23 00 00 00 00 00 02 2a 03 23 00 00 00 00 00 02 2b c5 23 00 00 00 00 00 02 2d 03 23 00 00 00 00 00 02 2f d2 23 00 00 00 00 00 02 30 03 23 00 00 00 00 00 02 31 d3 23 00 00 00 00 00 02 32 00 23 00 00 00 00 00 02 33 d6 23 00 00 00 00 00 02 34 00 23 00 00 00 00 00 02 35 dd 23 00 00 00 00 00 02 36 00 23 00 00 00 00 00 02 37 ea 23 00 00 00 00 00 02 38 00 23 00 00 00 00 00 02 39 f6 23 00 00 00 00 00 02 3a 01 23 00 00 00 00 00 02 3b 02 23 00 00 00 00 00 02 3d 01 23 00 00 00 00 00 02 3f 0c 23 00 00 00 00 00 02 40 01 23 00 00 00 00 00 02 41 17 23 00 00 00 00 00 02 42 01 23 00 00 00 00 00 02 43 20 23 00 00 00 00 00 02 44 01 23 00 00 00 00 00 02 45 29 23 00 00 00 00 00 02 46 01 23 00 00 00 00 00 02 47 4b 23 00 00 00 00 00 02 48 01 23 00 00 00 00 00 02 49 67 23 00 00 00 00 00 02 4a 01 23 00 00 00 00 00 02 4b 97 23 00 00 00 00 00 02 4c 01 23 00 00 00 00 00 02 4d bf 23 00 00 00 00 00 02 4e 01 23 00 00 00 00 00 02 4f fe 23 00 00 00 00 00 02 50 02 23 00 00 00 00 00 02 51 32 23 00 00 00 00 00 02 52 02 23 00 00 00 00 00 02 53 34 23 00 00 00 00 00 02 54 02 23 00 00 00 00 00 02 55 66 23 00 00 00 00 00 02 56 02 23 00 00 00 00 00 02 58 a0 23 00 00 00 00 00 02 59 02 23 00 00 00 00 00 02 5a c8 23 00 00 00 00 00 02 5b 02 23 00 00 00 00 00 02 5c fe 23 00 00 00 00 00 02 5d 03 23 00 00 00 00 00 02 5e 26 23 00 00 00 00 00 02 5f 03 23 00 00 00 00 00 02 60 56 23 00 00 00 00 00 02 61 03 23 00 00 00 00 00 02 62 64 23 00 00 00 00 00 02 63 03 23 00 00 00 00 00 02 64 74 23 00 00 00 00 00 02 65 03 23 00 00 00 00 00 02 66 85 23 00 00 00 00 00 02 67 03 23 00 00 00 00 00 02 68 99 23 00 00 00 00 00 02 69 03 23 00 00 00 00 00 02 6a b0 23 00 00 00 00 00 02 6b 03 23 00 00 00 00 00 02 6c c5 23 00 00 00 00 00 02 6d 03 23 00 00 00 00 00 02 6e d2 23 00 00 00 00 00 02 6f 03 23 00 00 00 00 00 02 70 d3 23 00 00 00 00 00 02 71 01 23 00 00 00 00 00 02 72 1b 23 00 00 00 00 00 02 73 01 23 00 00 00 00 00 02 74 1f 23 00 00 00 00 00 02 75 01 23 00 00 00 00 00 02 76 28 23 00 00 00 00 00 02 77 01 23 00 00 00 00 00 02 78 30 23 00 00 00 00 00 02 79 01 23 00 00 00 00 00 02 7a 38 23 00 00 00 00 00 02 7b 01 23 00 00 00 00 00 02 7c 40 23 00 00 00 00 00 02 7d 01 23 00 00 00 00 00 02 7e 47 23 00 00 00 00 00 02 7f 01 23 00 00 00 00 00 02 80 4f 23 00 00 00 00 00 02 81 01 23 00 00 00 00 00 02 82 56 23 00 00 00 00 00 02 83 01 23 00 00 00 00 00 02 84 6f 23 00 00 00 00 00 02 85 01 23 00 00 00 00 00 02 86 87 23 00 00 00 00 00 02 87 01 23 00 00 00 00 00 02 88 af 23 00 00 00 00 00 02 89 01 23 00 00 00 00 00 02 8a d2 23 00 00 00 00 00 02 8b 02 23 00 00 00 00 00 02 8c 0a 23 00 00 00 00 00 02 8d 02 23 00 00 00 00 00 02 8e 3a 23 00 00 00 00 00 02 8f 02 23 00 00 00 00 00 02 90 3c 23 00 00 00 00 00 02 91 02 23 00 00 00 00 00 02 92 6c 23 00 00 00 00 00 02 93 02 23 00 00 00 00 00 02 94 a6 23 00 00 00 00 00 02 95 02 23 00 00 00 00 00 02 96 cd 23 00 00 00 00 00 02 97 03 23 00 00 00 00 00 02 98 06 23 00 00 00 00 00 02 99 03 23 00 00 00 00 00 02 9a 2a 23 00 00 00 00 00 02 9b 03 23 00 00 00 00 00 02 9c 59 23 00 00 00 00 00 02 9d 03 23 00 00 00 00 00 02 9e 67 23 00 00 00 00 00 02 9f 03 23 00 00 00 00 00 02 a0 78 23 00 00 00 00 00 02 a2 03 23 00 00 00 00 00 02 a3 8b 23 00 00 00 00 00 02 a4 03 23 00 00 00 00 00 02 a5 a2 23 00 00 00 00 00 02 a6 03 23 00 00 00 00 00 02 a7 b8 23 00 00 00 00 00 02 a9 03 23 00 00 00 00 00 02 aa ca 23 00 00 00 00 00 02 ab 03 23 00 00 00 00 00 02 ac d2 23 00 00 00 00 00 02 ad 03 23 00 00 00 00 00 02 ae d3 23 00 00 00 00 00 02 af 01 23 00 00 00 00 00 02 b0 1b 23 00 00 00 00 00 02 b1 01 23 00 00 00 00 00 02 b2 1f 23 00 00 00 00 00 02 b3 01 23 00 00 00 00 00 02 b4 28 23 00 00 00 00 00 02 b5 01 23 00 00 00 00 00 02 b6 30 23 00 00 00 00 00 02 b7 01 23 00 00 00 00 00 02 b8 38 23 00 00 00 00 00 02 b9 01 23 00 00 00 00 00 02 ba 40 23 00 00 00 00 00 02 bb 01 23 00 00 00 00 00 02 bc 47 23 00 00 00 00 00 02 bd 01 23 00 00 00 00 00 02 be 4f 23 00 00 00 00 00 02 bf 01 23 00 00 00 00 00 02 c0 56 23 00 00 00 00 00 02 c1 01 23 00 00 00 00 00 02 c2 6f 23 00 00 00 00 00 02 c3 01 23 00 00 00 00 00 02 c4 87 23 00 00 00 00 00 02 c5 01 23 00 00 00 00 00 02 c6 af 23 00 00 00 00 00 02 c7 01 23 00 00 00 00 00 02 c8 d2 23 00 00 00 00 00 02 c9 02 23 00 00 00 00 00 02 ca 0a 23 00 00 00 00 00 02 cb 02 23 00 00 00 00 00 02 cc 3a 23 00 00 00 00 00 02 cd 02 23 00 00 00 00 00 02 ce 3c 23 00 00 00 00 00 02 cf 02 23 00 00 00 00 00 02 d0 6c 23 00 00 00 00 00 02 d1 02 23 00 00 00 00 00 02 d2 a6 23 00 00 00 00 00 02 d3 02 23 00 00 00 00 00 02 d4 cd 23 00 00 00 00 00 02 d5 03 23 00 00 00 00 00 02 d6 06 23 00 00 00 00 00 02 d7 03 23 00 00 00 00 00 02 d8 2a 23 00 00 00 00 00 02 d9 03 23 00 00 00 00 00 02 da 59 23 00 00 00 00 00 02 db 03 23 00 00 00 00 00 02 dc 67 23 00 00 00 00 00 02 dd 03 23 00 00 00 00 00 02 de 78 23 00 00 00 00 00 02 df 03 23 00 00 00 00 00 02 e0 8b 23 00 00 00 00 00 02 e1 03 23 00 00 00 00 00 02 e2 a2 23 00 00 00 00 00 02 e3 03 23 00 00 00 00 00 02 e4 b8 23 00 00 00 00 00 02 e5 03 23 00 00 00 00 00 02 e6 ca 23 00 00 00 00 00 02 e7 03 23 00 00 00 00 00 02 e8 d2 23 00 00 00 00 00 02 e9 03 23 01 00 00 00 00 02 ea d3 23 01 00 00 00 00 02 ff 00];
        qcom,mdss-dsi-eyecare-level2-command = [23 00 00 00 00 00 02 ff 01 23 00 00 00 00 00 02 fb 01 23 00 00 00 00 00 02 68 13 23 00 00 00 00 00 02 75 00 23 00 00 00 00 00 02 76 00 23 00 00 00 00 00 02 77 00 23 00 00 00 00 00 02 78 29 23 00 00 00 00 00 02 79 00 23 00 00 00 00 00 02 7a 59 23 00 00 00 00 00 02 7b 00 23 00 00 00 00 00 02 7c 7a 23 00 00 00 00 00 02 7d 00 23 00 00 00 00 00 02 7e 93 23 00 00 00 00 00 02 7f 00 23 00 00 00 00 00 02 80 a9 23 00 00 00 00 00 02 81 00 23 00 00 00 00 00 02 82 bc 23 00 00 00 00 00 02 83 00 23 00 00 00 00 00 02 84 cd 23 00 00 00 00 00 02 85 00 23 00 00 00 00 00 02 86 dc 23 00 00 00 00 00 02 87 01 23 00 00 00 00 00 02 88 0e 23 00 00 00 00 00 02 89 01 23 00 00 00 00 00 02 8a 36 23 00 00 00 00 00 02 8b 01 23 00 00 00 00 00 02 8c 75 23 00 00 00 00 00 02 8d 01 23 00 00 00 00 00 02 8e a5 23 00 00 00 00 00 02 8f 01 23 00 00 00 00 00 02 90 f0 23 00 00 00 00 00 02 91 02 23 00 00 00 00 00 02 92 29 23 00 00 00 00 00 02 93 02 23 00 00 00 00 00 02 94 2a 23 00 00 00 00 00 02 95 02 23 00 00 00 00 00 02 96 5f 23 00 00 00 00 00 02 97 02 23 00 00 00 00 00 02 98 9a 23 00 00 00 00 00 02 99 02 23 00 00 00 00 00 02 9a c2 23 00 00 00 00 00 02 9b 02 23 00 00 00 00 00 02 9c f9 23 00 00 00 00 00 02 9d 03 23 00 00 00 00 00 02 9e 1f 23 00 00 00 00 00 02 9f 03 23 00 00 00 00 00 02 a0 50 23 00 00 00 00 00 02 a2 03 23 00 00 00 00 00 02 a3 5f 23 00 00 00 00 00 02 a4 03 23 00 00 00 00 00 02 a5 6e 23 00 00 00 00 00 02 a6 03 23 00 00 00 00 00 02 a7 80 23 00 00 00 00 00 02 a9 03 23 00 00 00 00 00 02 aa 94 23 00 00 00 00 00 02 ab 03 23 00 00 00 00 00 02 ac ac 23 00 00 00 00 00 02 ad 03 23 00 00 00 00 00 02 ae c3 23 00 00 00 00 00 02 af 03 23 00 00 00 00 00 02 b0 d2 23 00 00 00 00 00 02 b1 03 23 00 00 00 00 00 02 b2 d3 23 00 00 00 00 00 02 b3 00 23 00 00 00 00 00 02 b4 00 23 00 00 00 00 00 02 b5 00 23 00 00 00 00 00 02 b6 29 23 00 00 00 00 00 02 b7 00 23 00 00 00 00 00 02 b8 59 23 00 00 00 00 00 02 b9 00 23 00 00 00 00 00 02 ba 7a 23 00 00 00 00 00 02 bb 00 23 00 00 00 00 00 02 bc 93 23 00 00 00 00 00 02 bd 00 23 00 00 00 00 00 02 be a9 23 00 00 00 00 00 02 bf 00 23 00 00 00 00 00 02 c0 bc 23 00 00 00 00 00 02 c1 00 23 00 00 00 00 00 02 c2 cd 23 00 00 00 00 00 02 c3 00 23 00 00 00 00 00 02 c4 dc 23 00 00 00 00 00 02 c5 01 23 00 00 00 00 00 02 c6 0e 23 00 00 00 00 00 02 c7 01 23 00 00 00 00 00 02 c8 36 23 00 00 00 00 00 02 c9 01 23 00 00 00 00 00 02 ca 75 23 00 00 00 00 00 02 cb 01 23 00 00 00 00 00 02 cc a5 23 00 00 00 00 00 02 cd 01 23 00 00 00 00 00 02 ce f0 23 00 00 00 00 00 02 cf 02 23 00 00 00 00 00 02 d0 29 23 00 00 00 00 00 02 d1 02 23 00 00 00 00 00 02 d2 2a 23 00 00 00 00 00 02 d3 02 23 00 00 00 00 00 02 d4 5f 23 00 00 00 00 00 02 d5 02 23 00 00 00 00 00 02 d6 9a 23 00 00 00 00 00 02 d7 02 23 00 00 00 00 00 02 d8 c2 23 00 00 00 00 00 02 d9 02 23 00 00 00 00 00 02 da f9 23 00 00 00 00 00 02 db 03 23 00 00 00 00 00 02 dc 1f 23 00 00 00 00 00 02 dd 03 23 00 00 00 00 00 02 de 50 23 00 00 00 00 00 02 df 03 23 00 00 00 00 00 02 e0 5f 23 00 00 00 00 00 02 e1 03 23 00 00 00 00 00 02 e2 6e 23 00 00 00 00 00 02 e3 03 23 00 00 00 00 00 02 e4 80 23 00 00 00 00 00 02 e5 03 23 00 00 00 00 00 02 e6 94 23 00 00 00 00 00 02 e7 03 23 00 00 00 00 00 02 e8 ac 23 00 00 00 00 00 02 e9 03 23 00 00 00 00 00 02 ea c3 23 00 00 00 00 00 02 eb 03 23 00 00 00 00 00 02 ec d2 23 00 00 00 00 00 02 ed 03 23 00 00 00 00 00 02 ee d3 23 00 00 00 00 00 02 ef 00 23 00 00 00 00 00 02 f0 d6 23 00 00 00 00 00 02 f1 00 23 00 00 00 00 00 02 f2 dd 23 00 00 00 00 00 02 f3 00 23 00 00 00 00 00 02 f4 ea 23 00 00 00 00 00 02 f5 00 23 00 00 00 00 00 02 f6 f6 23 00 00 00 00 00 02 f7 01 23 00 00 00 00 00 02 f8 02 23 00 00 00 00 00 02 f9 01 23 00 00 00 00 00 02 fa 0c 23 00 00 00 00 00 02 ff 02 23 00 00 00 00 00 02 fb 01 23 00 00 00 00 00 02 00 01 23 00 00 00 00 00 02 01 17 23 00 00 00 00 00 02 02 01 23 00 00 00 00 00 02 03 20 23 00 00 00 00 00 02 04 01 23 00 00 00 00 00 02 05 29 23 00 00 00 00 00 02 06 01 23 00 00 00 00 00 02 07 4b 23 00 00 00 00 00 02 08 01 23 00 00 00 00 00 02 09 67 23 00 00 00 00 00 02 0a 01 23 00 00 00 00 00 02 0b 97 23 00 00 00 00 00 02 0c 01 23 00 00 00 00 00 02 0d bf 23 00 00 00 00 00 02 0e 01 23 00 00 00 00 00 02 0f fe 23 00 00 00 00 00 02 10 02 23 00 00 00 00 00 02 11 32 23 00 00 00 00 00 02 12 02 23 00 00 00 00 00 02 13 34 23 00 00 00 00 00 02 14 02 23 00 00 00 00 00 02 15 66 23 00 00 00 00 00 02 16 02 23 00 00 00 00 00 02 17 a0 23 00 00 00 00 00 02 18 02 23 00 00 00 00 00 02 19 c8 23 00 00 00 00 00 02 1a 02 23 00 00 00 00 00 02 1b fe 23 00 00 00 00 00 02 1c 03 23 00 00 00 00 00 02 1d 26 23 00 00 00 00 00 02 1e 03 23 00 00 00 00 00 02 1f 56 23 00 00 00 00 00 02 20 03 23 00 00 00 00 00 02 21 64 23 00 00 00 00 00 02 22 03 23 00 00 00 00 00 02 23 74 23 00 00 00 00 00 02 24 03 23 00 00 00 00 00 02 25 85 23 00 00 00 00 00 02 26 03 23 00 00 00 00 00 02 27 99 23 00 00 00 00 00 02 28 03 23 00 00 00 00 00 02 29 b0 23 00 00 00 00 00 02 2a 03 23 00 00 00 00 00 02 2b c5 23 00 00 00 00 00 02 2d 03 23 00 00 00 00 00 02 2f d2 23 00 00 00 00 00 02 30 03 23 00 00 00 00 00 02 31 d3 23 00 00 00 00 00 02 32 00 23 00 00 00 00 00 02 33 d6 23 00 00 00 00 00 02 34 00 23 00 00 00 00 00 02 35 dd 23 00 00 00 00 00 02 36 00 23 00 00 00 00 00 02 37 ea 23 00 00 00 00 00 02 38 00 23 00 00 00 00 00 02 39 f6 23 00 00 00 00 00 02 3a 01 23 00 00 00 00 00 02 3b 02 23 00 00 00 00 00 02 3d 01 23 00 00 00 00 00 02 3f 0c 23 00 00 00 00 00 02 40 01 23 00 00 00 00 00 02 41 17 23 00 00 00 00 00 02 42 01 23 00 00 00 00 00 02 43 20 23 00 00 00 00 00 02 44 01 23 00 00 00 00 00 02 45 29 23 00 00 00 00 00 02 46 01 23 00 00 00 00 00 02 47 4b 23 00 00 00 00 00 02 48 01 23 00 00 00 00 00 02 49 67 23 00 00 00 00 00 02 4a 01 23 00 00 00 00 00 02 4b 97 23 00 00 00 00 00 02 4c 01 23 00 00 00 00 00 02 4d bf 23 00 00 00 00 00 02 4e 01 23 00 00 00 00 00 02 4f fe 23 00 00 00 00 00 02 50 02 23 00 00 00 00 00 02 51 32 23 00 00 00 00 00 02 52 02 23 00 00 00 00 00 02 53 34 23 00 00 00 00 00 02 54 02 23 00 00 00 00 00 02 55 66 23 00 00 00 00 00 02 56 02 23 00 00 00 00 00 02 58 a0 23 00 00 00 00 00 02 59 02 23 00 00 00 00 00 02 5a c8 23 00 00 00 00 00 02 5b 02 23 00 00 00 00 00 02 5c fe 23 00 00 00 00 00 02 5d 03 23 00 00 00 00 00 02 5e 26 23 00 00 00 00 00 02 5f 03 23 00 00 00 00 00 02 60 56 23 00 00 00 00 00 02 61 03 23 00 00 00 00 00 02 62 64 23 00 00 00 00 00 02 63 03 23 00 00 00 00 00 02 64 74 23 00 00 00 00 00 02 65 03 23 00 00 00 00 00 02 66 85 23 00 00 00 00 00 02 67 03 23 00 00 00 00 00 02 68 99 23 00 00 00 00 00 02 69 03 23 00 00 00 00 00 02 6a b0 23 00 00 00 00 00 02 6b 03 23 00 00 00 00 00 02 6c c5 23 00 00 00 00 00 02 6d 03 23 00 00 00 00 00 02 6e d2 23 00 00 00 00 00 02 6f 03 23 00 00 00 00 00 02 70 d3 23 00 00 00 00 00 02 71 01 23 00 00 00 00 00 02 72 52 23 00 00 00 00 00 02 73 01 23 00 00 00 00 00 02 74 55 23 00 00 00 00 00 02 75 01 23 00 00 00 00 00 02 76 5c 23 00 00 00 00 00 02 77 01 23 00 00 00 00 00 02 78 62 23 00 00 00 00 00 02 79 01 23 00 00 00 00 00 02 7a 68 23 00 00 00 00 00 02 7b 01 23 00 00 00 00 00 02 7c 6e 23 00 00 00 00 00 02 7d 01 23 00 00 00 00 00 02 7e 74 23 00 00 00 00 00 02 7f 01 23 00 00 00 00 00 02 80 79 23 00 00 00 00 00 02 81 01 23 00 00 00 00 00 02 82 7f 23 00 00 00 00 00 02 83 01 23 00 00 00 00 00 02 84 93 23 00 00 00 00 00 02 85 01 23 00 00 00 00 00 02 86 a6 23 00 00 00 00 00 02 87 01 23 00 00 00 00 00 02 88 c8 23 00 00 00 00 00 02 89 01 23 00 00 00 00 00 02 8a e6 23 00 00 00 00 00 02 8b 02 23 00 00 00 00 00 02 8c 18 23 00 00 00 00 00 02 8d 02 23 00 00 00 00 00 02 8e 45 23 00 00 00 00 00 02 8f 02 23 00 00 00 00 00 02 90 46 23 00 00 00 00 00 02 91 02 23 00 00 00 00 00 02 92 74 23 00 00 00 00 00 02 93 02 23 00 00 00 00 00 02 94 ad 23 00 00 00 00 00 02 95 02 23 00 00 00 00 00 02 96 d4 23 00 00 00 00 00 02 97 03 23 00 00 00 00 00 02 98 0d 23 00 00 00 00 00 02 99 03 23 00 00 00 00 00 02 9a 31 23 00 00 00 00 00 02 9b 03 23 00 00 00 00 00 02 9c 5e 23 00 00 00 00 00 02 9d 03 23 00 00 00 00 00 02 9e 6d 23 00 00 00 00 00 02 9f 03 23 00 00 00 00 00 02 a0 7d 23 00 00 00 00 00 02 a2 03 23 00 00 00 00 00 02 a3 91 23 00 00 00 00 00 02 a4 03 23 00 00 00 00 00 02 a5 a6 23 00 00 00 00 00 02 a6 03 23 00 00 00 00 00 02 a7 bb 23 00 00 00 00 00 02 a9 03 23 00 00 00 00 00 02 aa cb 23 00 00 00 00 00 02 ab 03 23 00 00 00 00 00 02 ac d2 23 00 00 00 00 00 02 ad 03 23 00 00 00 00 00 02 ae d3 23 00 00 00 00 00 02 af 01 23 00 00 00 00 00 02 b0 52 23 00 00 00 00 00 02 b1 01 23 00 00 00 00 00 02 b2 55 23 00 00 00 00 00 02 b3 01 23 00 00 00 00 00 02 b4 5c 23 00 00 00 00 00 02 b5 01 23 00 00 00 00 00 02 b6 62 23 00 00 00 00 00 02 b7 01 23 00 00 00 00 00 02 b8 68 23 00 00 00 00 00 02 b9 01 23 00 00 00 00 00 02 ba 6e 23 00 00 00 00 00 02 bb 01 23 00 00 00 00 00 02 bc 74 23 00 00 00 00 00 02 bd 01 23 00 00 00 00 00 02 be 79 23 00 00 00 00 00 02 bf 01 23 00 00 00 00 00 02 c0 7f 23 00 00 00 00 00 02 c1 01 23 00 00 00 00 00 02 c2 93 23 00 00 00 00 00 02 c3 01 23 00 00 00 00 00 02 c4 a6 23 00 00 00 00 00 02 c5 01 23 00 00 00 00 00 02 c6 c8 23 00 00 00 00 00 02 c7 01 23 00 00 00 00 00 02 c8 e6 23 00 00 00 00 00 02 c9 02 23 00 00 00 00 00 02 ca 18 23 00 00 00 00 00 02 cb 02 23 00 00 00 00 00 02 cc 45 23 00 00 00 00 00 02 cd 02 23 00 00 00 00 00 02 ce 46 23 00 00 00 00 00 02 cf 02 23 00 00 00 00 00 02 d0 74 23 00 00 00 00 00 02 d1 02 23 00 00 00 00 00 02 d2 ad 23 00 00 00 00 00 02 d3 02 23 00 00 00 00 00 02 d4 d4 23 00 00 00 00 00 02 d5 03 23 00 00 00 00 00 02 d6 0d 23 00 00 00 00 00 02 d7 03 23 00 00 00 00 00 02 d8 31 23 00 00 00 00 00 02 d9 03 23 00 00 00 00 00 02 da 5e 23 00 00 00 00 00 02 db 03 23 00 00 00 00 00 02 dc 6d 23 00 00 00 00 00 02 dd 03 23 00 00 00 00 00 02 de 7d 23 00 00 00 00 00 02 df 03 23 00 00 00 00 00 02 e0 91 23 00 00 00 00 00 02 e1 03 23 00 00 00 00 00 02 e2 a6 23 00 00 00 00 00 02 e3 03 23 00 00 00 00 00 02 e4 bb 23 00 00 00 00 00 02 e5 03 23 00 00 00 00 00 02 e6 cb 23 00 00 00 00 00 02 e7 03 23 00 00 00 00 00 02 e8 d2 23 00 00 00 00 00 02 e9 03 23 01 00 00 00 00 02 ea d3 23 01 00 00 00 00 02 ff 00];
        qcom,mdss-dsi-eyecare-level3-command = [23 00 00 00 00 00 02 ff 01 23 00 00 00 00 00 02 fb 01 23 00 00 00 00 00 02 68 13 23 00 00 00 00 00 02 75 00 23 00 00 00 00 00 02 76 00 23 00 00 00 00 00 02 77 00 23 00 00 00 00 00 02 78 29 23 00 00 00 00 00 02 79 00 23 00 00 00 00 00 02 7a 59 23 00 00 00 00 00 02 7b 00 23 00 00 00 00 00 02 7c 7a 23 00 00 00 00 00 02 7d 00 23 00 00 00 00 00 02 7e 93 23 00 00 00 00 00 02 7f 00 23 00 00 00 00 00 02 80 a9 23 00 00 00 00 00 02 81 00 23 00 00 00 00 00 02 82 bc 23 00 00 00 00 00 02 83 00 23 00 00 00 00 00 02 84 cd 23 00 00 00 00 00 02 85 00 23 00 00 00 00 00 02 86 dc 23 00 00 00 00 00 02 87 01 23 00 00 00 00 00 02 88 0e 23 00 00 00 00 00 02 89 01 23 00 00 00 00 00 02 8a 36 23 00 00 00 00 00 02 8b 01 23 00 00 00 00 00 02 8c 75 23 00 00 00 00 00 02 8d 01 23 00 00 00 00 00 02 8e a5 23 00 00 00 00 00 02 8f 01 23 00 00 00 00 00 02 90 f0 23 00 00 00 00 00 02 91 02 23 00 00 00 00 00 02 92 29 23 00 00 00 00 00 02 93 02 23 00 00 00 00 00 02 94 2a 23 00 00 00 00 00 02 95 02 23 00 00 00 00 00 02 96 5f 23 00 00 00 00 00 02 97 02 23 00 00 00 00 00 02 98 9a 23 00 00 00 00 00 02 99 02 23 00 00 00 00 00 02 9a c2 23 00 00 00 00 00 02 9b 02 23 00 00 00 00 00 02 9c f9 23 00 00 00 00 00 02 9d 03 23 00 00 00 00 00 02 9e 1f 23 00 00 00 00 00 02 9f 03 23 00 00 00 00 00 02 a0 50 23 00 00 00 00 00 02 a2 03 23 00 00 00 00 00 02 a3 5f 23 00 00 00 00 00 02 a4 03 23 00 00 00 00 00 02 a5 6e 23 00 00 00 00 00 02 a6 03 23 00 00 00 00 00 02 a7 80 23 00 00 00 00 00 02 a9 03 23 00 00 00 00 00 02 aa 94 23 00 00 00 00 00 02 ab 03 23 00 00 00 00 00 02 ac ac 23 00 00 00 00 00 02 ad 03 23 00 00 00 00 00 02 ae c3 23 00 00 00 00 00 02 af 03 23 00 00 00 00 00 02 b0 d2 23 00 00 00 00 00 02 b1 03 23 00 00 00 00 00 02 b2 d3 23 00 00 00 00 00 02 b3 00 23 00 00 00 00 00 02 b4 00 23 00 00 00 00 00 02 b5 00 23 00 00 00 00 00 02 b6 29 23 00 00 00 00 00 02 b7 00 23 00 00 00 00 00 02 b8 59 23 00 00 00 00 00 02 b9 00 23 00 00 00 00 00 02 ba 7a 23 00 00 00 00 00 02 bb 00 23 00 00 00 00 00 02 bc 93 23 00 00 00 00 00 02 bd 00 23 00 00 00 00 00 02 be a9 23 00 00 00 00 00 02 bf 00 23 00 00 00 00 00 02 c0 bc 23 00 00 00 00 00 02 c1 00 23 00 00 00 00 00 02 c2 cd 23 00 00 00 00 00 02 c3 00 23 00 00 00 00 00 02 c4 dc 23 00 00 00 00 00 02 c5 01 23 00 00 00 00 00 02 c6 0e 23 00 00 00 00 00 02 c7 01 23 00 00 00 00 00 02 c8 36 23 00 00 00 00 00 02 c9 01 23 00 00 00 00 00 02 ca 75 23 00 00 00 00 00 02 cb 01 23 00 00 00 00 00 02 cc a5 23 00 00 00 00 00 02 cd 01 23 00 00 00 00 00 02 ce f0 23 00 00 00 00 00 02 cf 02 23 00 00 00 00 00 02 d0 29 23 00 00 00 00 00 02 d1 02 23 00 00 00 00 00 02 d2 2a 23 00 00 00 00 00 02 d3 02 23 00 00 00 00 00 02 d4 5f 23 00 00 00 00 00 02 d5 02 23 00 00 00 00 00 02 d6 9a 23 00 00 00 00 00 02 d7 02 23 00 00 00 00 00 02 d8 c2 23 00 00 00 00 00 02 d9 02 23 00 00 00 00 00 02 da f9 23 00 00 00 00 00 02 db 03 23 00 00 00 00 00 02 dc 1f 23 00 00 00 00 00 02 dd 03 23 00 00 00 00 00 02 de 50 23 00 00 00 00 00 02 df 03 23 00 00 00 00 00 02 e0 5f 23 00 00 00 00 00 02 e1 03 23 00 00 00 00 00 02 e2 6e 23 00 00 00 00 00 02 e3 03 23 00 00 00 00 00 02 e4 80 23 00 00 00 00 00 02 e5 03 23 00 00 00 00 00 02 e6 94 23 00 00 00 00 00 02 e7 03 23 00 00 00 00 00 02 e8 ac 23 00 00 00 00 00 02 e9 03 23 00 00 00 00 00 02 ea c3 23 00 00 00 00 00 02 eb 03 23 00 00 00 00 00 02 ec d2 23 00 00 00 00 00 02 ed 03 23 00 00 00 00 00 02 ee d3 23 00 00 00 00 00 02 ef 00 23 00 00 00 00 00 02 f0 d6 23 00 00 00 00 00 02 f1 00 23 00 00 00 00 00 02 f2 dd 23 00 00 00 00 00 02 f3 00 23 00 00 00 00 00 02 f4 ea 23 00 00 00 00 00 02 f5 00 23 00 00 00 00 00 02 f6 f6 23 00 00 00 00 00 02 f7 01 23 00 00 00 00 00 02 f8 02 23 00 00 00 00 00 02 f9 01 23 00 00 00 00 00 02 fa 0c 23 00 00 00 00 00 02 ff 02 23 00 00 00 00 00 02 fb 01 23 00 00 00 00 00 02 00 01 23 00 00 00 00 00 02 01 17 23 00 00 00 00 00 02 02 01 23 00 00 00 00 00 02 03 20 23 00 00 00 00 00 02 04 01 23 00 00 00 00 00 02 05 29 23 00 00 00 00 00 02 06 01 23 00 00 00 00 00 02 07 4b 23 00 00 00 00 00 02 08 01 23 00 00 00 00 00 02 09 67 23 00 00 00 00 00 02 0a 01 23 00 00 00 00 00 02 0b 97 23 00 00 00 00 00 02 0c 01 23 00 00 00 00 00 02 0d bf 23 00 00 00 00 00 02 0e 01 23 00 00 00 00 00 02 0f fe 23 00 00 00 00 00 02 10 02 23 00 00 00 00 00 02 11 32 23 00 00 00 00 00 02 12 02 23 00 00 00 00 00 02 13 34 23 00 00 00 00 00 02 14 02 23 00 00 00 00 00 02 15 66 23 00 00 00 00 00 02 16 02 23 00 00 00 00 00 02 17 a0 23 00 00 00 00 00 02 18 02 23 00 00 00 00 00 02 19 c8 23 00 00 00 00 00 02 1a 02 23 00 00 00 00 00 02 1b fe 23 00 00 00 00 00 02 1c 03 23 00 00 00 00 00 02 1d 26 23 00 00 00 00 00 02 1e 03 23 00 00 00 00 00 02 1f 56 23 00 00 00 00 00 02 20 03 23 00 00 00 00 00 02 21 64 23 00 00 00 00 00 02 22 03 23 00 00 00 00 00 02 23 74 23 00 00 00 00 00 02 24 03 23 00 00 00 00 00 02 25 85 23 00 00 00 00 00 02 26 03 23 00 00 00 00 00 02 27 99 23 00 00 00 00 00 02 28 03 23 00 00 00 00 00 02 29 b0 23 00 00 00 00 00 02 2a 03 23 00 00 00 00 00 02 2b c5 23 00 00 00 00 00 02 2d 03 23 00 00 00 00 00 02 2f d2 23 00 00 00 00 00 02 30 03 23 00 00 00 00 00 02 31 d3 23 00 00 00 00 00 02 32 00 23 00 00 00 00 00 02 33 d6 23 00 00 00 00 00 02 34 00 23 00 00 00 00 00 02 35 dd 23 00 00 00 00 00 02 36 00 23 00 00 00 00 00 02 37 ea 23 00 00 00 00 00 02 38 00 23 00 00 00 00 00 02 39 f6 23 00 00 00 00 00 02 3a 01 23 00 00 00 00 00 02 3b 02 23 00 00 00 00 00 02 3d 01 23 00 00 00 00 00 02 3f 0c 23 00 00 00 00 00 02 40 01 23 00 00 00 00 00 02 41 17 23 00 00 00 00 00 02 42 01 23 00 00 00 00 00 02 43 20 23 00 00 00 00 00 02 44 01 23 00 00 00 00 00 02 45 29 23 00 00 00 00 00 02 46 01 23 00 00 00 00 00 02 47 4b 23 00 00 00 00 00 02 48 01 23 00 00 00 00 00 02 49 67 23 00 00 00 00 00 02 4a 01 23 00 00 00 00 00 02 4b 97 23 00 00 00 00 00 02 4c 01 23 00 00 00 00 00 02 4d bf 23 00 00 00 00 00 02 4e 01 23 00 00 00 00 00 02 4f fe 23 00 00 00 00 00 02 50 02 23 00 00 00 00 00 02 51 32 23 00 00 00 00 00 02 52 02 23 00 00 00 00 00 02 53 34 23 00 00 00 00 00 02 54 02 23 00 00 00 00 00 02 55 66 23 00 00 00 00 00 02 56 02 23 00 00 00 00 00 02 58 a0 23 00 00 00 00 00 02 59 02 23 00 00 00 00 00 02 5a c8 23 00 00 00 00 00 02 5b 02 23 00 00 00 00 00 02 5c fe 23 00 00 00 00 00 02 5d 03 23 00 00 00 00 00 02 5e 26 23 00 00 00 00 00 02 5f 03 23 00 00 00 00 00 02 60 56 23 00 00 00 00 00 02 61 03 23 00 00 00 00 00 02 62 64 23 00 00 00 00 00 02 63 03 23 00 00 00 00 00 02 64 74 23 00 00 00 00 00 02 65 03 23 00 00 00 00 00 02 66 85 23 00 00 00 00 00 02 67 03 23 00 00 00 00 00 02 68 99 23 00 00 00 00 00 02 69 03 23 00 00 00 00 00 02 6a b0 23 00 00 00 00 00 02 6b 03 23 00 00 00 00 00 02 6c c5 23 00 00 00 00 00 02 6d 03 23 00 00 00 00 00 02 6e d2 23 00 00 00 00 00 02 6f 03 23 00 00 00 00 00 02 70 d3 23 00 00 00 00 00 02 71 01 23 00 00 00 00 00 02 72 7c 23 00 00 00 00 00 02 73 01 23 00 00 00 00 00 02 74 7f 23 00 00 00 00 00 02 75 01 23 00 00 00 00 00 02 76 84 23 00 00 00 00 00 02 77 01 23 00 00 00 00 00 02 78 89 23 00 00 00 00 00 02 79 01 23 00 00 00 00 00 02 7a 8d 23 00 00 00 00 00 02 7b 01 23 00 00 00 00 00 02 7c 92 23 00 00 00 00 00 02 7d 01 23 00 00 00 00 00 02 7e 97 23 00 00 00 00 00 02 7f 01 23 00 00 00 00 00 02 80 9b 23 00 00 00 00 00 02 81 01 23 00 00 00 00 00 02 82 a0 23 00 00 00 00 00 02 83 01 23 00 00 00 00 00 02 84 b1 23 00 00 00 00 00 02 85 01 23 00 00 00 00 00 02 86 c1 23 00 00 00 00 00 02 87 01 23 00 00 00 00 00 02 88 de 23 00 00 00 00 00 02 89 01 23 00 00 00 00 00 02 8a f7 23 00 00 00 00 00 02 8b 02 23 00 00 00 00 00 02 8c 25 23 00 00 00 00 00 02 8d 02 23 00 00 00 00 00 02 8e 4e 23 00 00 00 00 00 02 8f 02 23 00 00 00 00 00 02 90 50 23 00 00 00 00 00 02 91 02 23 00 00 00 00 00 02 92 7c 23 00 00 00 00 00 02 93 02 23 00 00 00 00 00 02 94 b5 23 00 00 00 00 00 02 95 02 23 00 00 00 00 00 02 96 db 23 00 00 00 00 00 02 97 03 23 00 00 00 00 00 02 98 14 23 00 00 00 00 00 02 99 03 23 00 00 00 00 00 02 9a 37 23 00 00 00 00 00 02 9b 03 23 00 00 00 00 00 02 9c 64 23 00 00 00 00 00 02 9d 03 23 00 00 00 00 00 02 9e 72 23 00 00 00 00 00 02 9f 03 23 00 00 00 00 00 02 a0 83 23 00 00 00 00 00 02 a2 03 23 00 00 00 00 00 02 a3 96 23 00 00 00 00 00 02 a4 03 23 00 00 00 00 00 02 a5 aa 23 00 00 00 00 00 02 a6 03 23 00 00 00 00 00 02 a7 bd 23 00 00 00 00 00 02 a9 03 23 00 00 00 00 00 02 aa cc 23 00 00 00 00 00 02 ab 03 23 00 00 00 00 00 02 ac d2 23 00 00 00 00 00 02 ad 03 23 00 00 00 00 00 02 ae d3 23 00 00 00 00 00 02 af 01 23 00 00 00 00 00 02 b0 7c 23 00 00 00 00 00 02 b1 01 23 00 00 00 00 00 02 b2 7f 23 00 00 00 00 00 02 b3 01 23 00 00 00 00 00 02 b4 84 23 00 00 00 00 00 02 b5 01 23 00 00 00 00 00 02 b6 89 23 00 00 00 00 00 02 b7 01 23 00 00 00 00 00 02 b8 8d 23 00 00 00 00 00 02 b9 01 23 00 00 00 00 00 02 ba 92 23 00 00 00 00 00 02 bb 01 23 00 00 00 00 00 02 bc 97 23 00 00 00 00 00 02 bd 01 23 00 00 00 00 00 02 be 9b 23 00 00 00 00 00 02 bf 01 23 00 00 00 00 00 02 c0 a0 23 00 00 00 00 00 02 c1 01 23 00 00 00 00 00 02 c2 b1 23 00 00 00 00 00 02 c3 01 23 00 00 00 00 00 02 c4 c1 23 00 00 00 00 00 02 c5 01 23 00 00 00 00 00 02 c6 de 23 00 00 00 00 00 02 c7 01 23 00 00 00 00 00 02 c8 f7 23 00 00 00 00 00 02 c9 02 23 00 00 00 00 00 02 ca 25 23 00 00 00 00 00 02 cb 02 23 00 00 00 00 00 02 cc 4e 23 00 00 00 00 00 02 cd 02 23 00 00 00 00 00 02 ce 50 23 00 00 00 00 00 02 cf 02 23 00 00 00 00 00 02 d0 7c 23 00 00 00 00 00 02 d1 02 23 00 00 00 00 00 02 d2 b5 23 00 00 00 00 00 02 d3 02 23 00 00 00 00 00 02 d4 db 23 00 00 00 00 00 02 d5 03 23 00 00 00 00 00 02 d6 14 23 00 00 00 00 00 02 d7 03 23 00 00 00 00 00 02 d8 37 23 00 00 00 00 00 02 d9 03 23 00 00 00 00 00 02 da 64 23 00 00 00 00 00 02 db 03 23 00 00 00 00 00 02 dc 72 23 00 00 00 00 00 02 dd 03 23 00 00 00 00 00 02 de 83 23 00 00 00 00 00 02 df 03 23 00 00 00 00 00 02 e0 96 23 00 00 00 00 00 02 e1 03 23 00 00 00 00 00 02 e2 aa 23 00 00 00 00 00 02 e3 03 23 00 00 00 00 00 02 e4 bd 23 00 00 00 00 00 02 e5 03 23 00 00 00 00 00 02 e6 cc 23 00 00 00 00 00 02 e7 03 23 00 00 00 00 00 02 e8 d2 23 00 00 00 00 00 02 e9 03 23 01 00 00 00 00 02 ea d3 23 01 00 00 00 00 02 ff 00];
        qcom,mdss-dsi-eyecare-level4-command = [23 00 00 00 00 00 02 ff 01 23 00 00 00 00 00 02 fb 01 23 00 00 00 00 00 02 68 13 23 00 00 00 00 00 02 75 00 23 00 00 00 00 00 02 76 00 23 00 00 00 00 00 02 77 00 23 00 00 00 00 00 02 78 29 23 00 00 00 00 00 02 79 00 23 00 00 00 00 00 02 7a 59 23 00 00 00 00 00 02 7b 00 23 00 00 00 00 00 02 7c 7a 23 00 00 00 00 00 02 7d 00 23 00 00 00 00 00 02 7e 93 23 00 00 00 00 00 02 7f 00 23 00 00 00 00 00 02 80 a9 23 00 00 00 00 00 02 81 00 23 00 00 00 00 00 02 82 bc 23 00 00 00 00 00 02 83 00 23 00 00 00 00 00 02 84 cd 23 00 00 00 00 00 02 85 00 23 00 00 00 00 00 02 86 dc 23 00 00 00 00 00 02 87 01 23 00 00 00 00 00 02 88 0e 23 00 00 00 00 00 02 89 01 23 00 00 00 00 00 02 8a 36 23 00 00 00 00 00 02 8b 01 23 00 00 00 00 00 02 8c 75 23 00 00 00 00 00 02 8d 01 23 00 00 00 00 00 02 8e a5 23 00 00 00 00 00 02 8f 01 23 00 00 00 00 00 02 90 f0 23 00 00 00 00 00 02 91 02 23 00 00 00 00 00 02 92 29 23 00 00 00 00 00 02 93 02 23 00 00 00 00 00 02 94 2a 23 00 00 00 00 00 02 95 02 23 00 00 00 00 00 02 96 5f 23 00 00 00 00 00 02 97 02 23 00 00 00 00 00 02 98 9a 23 00 00 00 00 00 02 99 02 23 00 00 00 00 00 02 9a c2 23 00 00 00 00 00 02 9b 02 23 00 00 00 00 00 02 9c f9 23 00 00 00 00 00 02 9d 03 23 00 00 00 00 00 02 9e 1f 23 00 00 00 00 00 02 9f 03 23 00 00 00 00 00 02 a0 50 23 00 00 00 00 00 02 a2 03 23 00 00 00 00 00 02 a3 5f 23 00 00 00 00 00 02 a4 03 23 00 00 00 00 00 02 a5 6e 23 00 00 00 00 00 02 a6 03 23 00 00 00 00 00 02 a7 80 23 00 00 00 00 00 02 a9 03 23 00 00 00 00 00 02 aa 94 23 00 00 00 00 00 02 ab 03 23 00 00 00 00 00 02 ac ac 23 00 00 00 00 00 02 ad 03 23 00 00 00 00 00 02 ae c3 23 00 00 00 00 00 02 af 03 23 00 00 00 00 00 02 b0 d2 23 00 00 00 00 00 02 b1 03 23 00 00 00 00 00 02 b2 d3 23 00 00 00 00 00 02 b3 00 23 00 00 00 00 00 02 b4 00 23 00 00 00 00 00 02 b5 00 23 00 00 00 00 00 02 b6 29 23 00 00 00 00 00 02 b7 00 23 00 00 00 00 00 02 b8 59 23 00 00 00 00 00 02 b9 00 23 00 00 00 00 00 02 ba 7a 23 00 00 00 00 00 02 bb 00 23 00 00 00 00 00 02 bc 93 23 00 00 00 00 00 02 bd 00 23 00 00 00 00 00 02 be a9 23 00 00 00 00 00 02 bf 00 23 00 00 00 00 00 02 c0 bc 23 00 00 00 00 00 02 c1 00 23 00 00 00 00 00 02 c2 cd 23 00 00 00 00 00 02 c3 00 23 00 00 00 00 00 02 c4 dc 23 00 00 00 00 00 02 c5 01 23 00 00 00 00 00 02 c6 0e 23 00 00 00 00 00 02 c7 01 23 00 00 00 00 00 02 c8 36 23 00 00 00 00 00 02 c9 01 23 00 00 00 00 00 02 ca 75 23 00 00 00 00 00 02 cb 01 23 00 00 00 00 00 02 cc a5 23 00 00 00 00 00 02 cd 01 23 00 00 00 00 00 02 ce f0 23 00 00 00 00 00 02 cf 02 23 00 00 00 00 00 02 d0 29 23 00 00 00 00 00 02 d1 02 23 00 00 00 00 00 02 d2 2a 23 00 00 00 00 00 02 d3 02 23 00 00 00 00 00 02 d4 5f 23 00 00 00 00 00 02 d5 02 23 00 00 00 00 00 02 d6 9a 23 00 00 00 00 00 02 d7 02 23 00 00 00 00 00 02 d8 c2 23 00 00 00 00 00 02 d9 02 23 00 00 00 00 00 02 da f9 23 00 00 00 00 00 02 db 03 23 00 00 00 00 00 02 dc 1f 23 00 00 00 00 00 02 dd 03 23 00 00 00 00 00 02 de 50 23 00 00 00 00 00 02 df 03 23 00 00 00 00 00 02 e0 5f 23 00 00 00 00 00 02 e1 03 23 00 00 00 00 00 02 e2 6e 23 00 00 00 00 00 02 e3 03 23 00 00 00 00 00 02 e4 80 23 00 00 00 00 00 02 e5 03 23 00 00 00 00 00 02 e6 94 23 00 00 00 00 00 02 e7 03 23 00 00 00 00 00 02 e8 ac 23 00 00 00 00 00 02 e9 03 23 00 00 00 00 00 02 ea c3 23 00 00 00 00 00 02 eb 03 23 00 00 00 00 00 02 ec d2 23 00 00 00 00 00 02 ed 03 23 00 00 00 00 00 02 ee d3 23 00 00 00 00 00 02 ef 00 23 00 00 00 00 00 02 f0 d6 23 00 00 00 00 00 02 f1 00 23 00 00 00 00 00 02 f2 dd 23 00 00 00 00 00 02 f3 00 23 00 00 00 00 00 02 f4 ea 23 00 00 00 00 00 02 f5 00 23 00 00 00 00 00 02 f6 f6 23 00 00 00 00 00 02 f7 01 23 00 00 00 00 00 02 f8 02 23 00 00 00 00 00 02 f9 01 23 00 00 00 00 00 02 fa 0c 23 00 00 00 00 00 02 ff 02 23 00 00 00 00 00 02 fb 01 23 00 00 00 00 00 02 00 01 23 00 00 00 00 00 02 01 17 23 00 00 00 00 00 02 02 01 23 00 00 00 00 00 02 03 20 23 00 00 00 00 00 02 04 01 23 00 00 00 00 00 02 05 29 23 00 00 00 00 00 02 06 01 23 00 00 00 00 00 02 07 4b 23 00 00 00 00 00 02 08 01 23 00 00 00 00 00 02 09 67 23 00 00 00 00 00 02 0a 01 23 00 00 00 00 00 02 0b 97 23 00 00 00 00 00 02 0c 01 23 00 00 00 00 00 02 0d bf 23 00 00 00 00 00 02 0e 01 23 00 00 00 00 00 02 0f fe 23 00 00 00 00 00 02 10 02 23 00 00 00 00 00 02 11 32 23 00 00 00 00 00 02 12 02 23 00 00 00 00 00 02 13 34 23 00 00 00 00 00 02 14 02 23 00 00 00 00 00 02 15 66 23 00 00 00 00 00 02 16 02 23 00 00 00 00 00 02 17 a0 23 00 00 00 00 00 02 18 02 23 00 00 00 00 00 02 19 c8 23 00 00 00 00 00 02 1a 02 23 00 00 00 00 00 02 1b fe 23 00 00 00 00 00 02 1c 03 23 00 00 00 00 00 02 1d 26 23 00 00 00 00 00 02 1e 03 23 00 00 00 00 00 02 1f 56 23 00 00 00 00 00 02 20 03 23 00 00 00 00 00 02 21 64 23 00 00 00 00 00 02 22 03 23 00 00 00 00 00 02 23 74 23 00 00 00 00 00 02 24 03 23 00 00 00 00 00 02 25 85 23 00 00 00 00 00 02 26 03 23 00 00 00 00 00 02 27 99 23 00 00 00 00 00 02 28 03 23 00 00 00 00 00 02 29 b0 23 00 00 00 00 00 02 2a 03 23 00 00 00 00 00 02 2b c5 23 00 00 00 00 00 02 2d 03 23 00 00 00 00 00 02 2f d2 23 00 00 00 00 00 02 30 03 23 00 00 00 00 00 02 31 d3 23 00 00 00 00 00 02 32 00 23 00 00 00 00 00 02 33 d6 23 00 00 00 00 00 02 34 00 23 00 00 00 00 00 02 35 dd 23 00 00 00 00 00 02 36 00 23 00 00 00 00 00 02 37 ea 23 00 00 00 00 00 02 38 00 23 00 00 00 00 00 02 39 f6 23 00 00 00 00 00 02 3a 01 23 00 00 00 00 00 02 3b 02 23 00 00 00 00 00 02 3d 01 23 00 00 00 00 00 02 3f 0c 23 00 00 00 00 00 02 40 01 23 00 00 00 00 00 02 41 17 23 00 00 00 00 00 02 42 01 23 00 00 00 00 00 02 43 20 23 00 00 00 00 00 02 44 01 23 00 00 00 00 00 02 45 29 23 00 00 00 00 00 02 46 01 23 00 00 00 00 00 02 47 4b 23 00 00 00 00 00 02 48 01 23 00 00 00 00 00 02 49 67 23 00 00 00 00 00 02 4a 01 23 00 00 00 00 00 02 4b 97 23 00 00 00 00 00 02 4c 01 23 00 00 00 00 00 02 4d bf 23 00 00 00 00 00 02 4e 01 23 00 00 00 00 00 02 4f fe 23 00 00 00 00 00 02 50 02 23 00 00 00 00 00 02 51 32 23 00 00 00 00 00 02 52 02 23 00 00 00 00 00 02 53 34 23 00 00 00 00 00 02 54 02 23 00 00 00 00 00 02 55 66 23 00 00 00 00 00 02 56 02 23 00 00 00 00 00 02 58 a0 23 00 00 00 00 00 02 59 02 23 00 00 00 00 00 02 5a c8 23 00 00 00 00 00 02 5b 02 23 00 00 00 00 00 02 5c fe 23 00 00 00 00 00 02 5d 03 23 00 00 00 00 00 02 5e 26 23 00 00 00 00 00 02 5f 03 23 00 00 00 00 00 02 60 56 23 00 00 00 00 00 02 61 03 23 00 00 00 00 00 02 62 64 23 00 00 00 00 00 02 63 03 23 00 00 00 00 00 02 64 74 23 00 00 00 00 00 02 65 03 23 00 00 00 00 00 02 66 85 23 00 00 00 00 00 02 67 03 23 00 00 00 00 00 02 68 99 23 00 00 00 00 00 02 69 03 23 00 00 00 00 00 02 6a b0 23 00 00 00 00 00 02 6b 03 23 00 00 00 00 00 02 6c c5 23 00 00 00 00 00 02 6d 03 23 00 00 00 00 00 02 6e d2 23 00 00 00 00 00 02 6f 03 23 00 00 00 00 00 02 70 d3 23 00 00 00 00 00 02 71 01 23 00 00 00 00 00 02 72 a0 23 00 00 00 00 00 02 73 01 23 00 00 00 00 00 02 74 a2 23 00 00 00 00 00 02 75 01 23 00 00 00 00 00 02 76 a6 23 00 00 00 00 00 02 77 01 23 00 00 00 00 00 02 78 aa 23 00 00 00 00 00 02 79 01 23 00 00 00 00 00 02 7a ae 23 00 00 00 00 00 02 7b 01 23 00 00 00 00 00 02 7c b2 23 00 00 00 00 00 02 7d 01 23 00 00 00 00 00 02 7e b6 23 00 00 00 00 00 02 7f 01 23 00 00 00 00 00 02 80 ba 23 00 00 00 00 00 02 81 01 23 00 00 00 00 00 02 82 bd 23 00 00 00 00 00 02 83 01 23 00 00 00 00 00 02 84 cc 23 00 00 00 00 00 02 85 01 23 00 00 00 00 00 02 86 d9 23 00 00 00 00 00 02 87 01 23 00 00 00 00 00 02 88 f2 23 00 00 00 00 00 02 89 02 23 00 00 00 00 00 02 8a 08 23 00 00 00 00 00 02 8b 02 23 00 00 00 00 00 02 8c 31 23 00 00 00 00 00 02 8d 02 23 00 00 00 00 00 02 8e 58 23 00 00 00 00 00 02 8f 02 23 00 00 00 00 00 02 90 5a 23 00 00 00 00 00 02 91 02 23 00 00 00 00 00 02 92 85 23 00 00 00 00 00 02 93 02 23 00 00 00 00 00 02 94 bd 23 00 00 00 00 00 02 95 02 23 00 00 00 00 00 02 96 e3 23 00 00 00 00 00 02 97 03 23 00 00 00 00 00 02 98 1c 23 00 00 00 00 00 02 99 03 23 00 00 00 00 00 02 9a 3e 23 00 00 00 00 00 02 9b 03 23 00 00 00 00 00 02 9c 6a 23 00 00 00 00 00 02 9d 03 23 00 00 00 00 00 02 9e 79 23 00 00 00 00 00 02 9f 03 23 00 00 00 00 00 02 a0 89 23 00 00 00 00 00 02 a2 03 23 00 00 00 00 00 02 a3 9b 23 00 00 00 00 00 02 a4 03 23 00 00 00 00 00 02 a5 af 23 00 00 00 00 00 02 a6 03 23 00 00 00 00 00 02 a7 c0 23 00 00 00 00 00 02 a9 03 23 00 00 00 00 00 02 aa cc 23 00 00 00 00 00 02 ab 03 23 00 00 00 00 00 02 ac d2 23 00 00 00 00 00 02 ad 03 23 00 00 00 00 00 02 ae d3 23 00 00 00 00 00 02 af 01 23 00 00 00 00 00 02 b0 a0 23 00 00 00 00 00 02 b1 01 23 00 00 00 00 00 02 b2 a2 23 00 00 00 00 00 02 b3 01 23 00 00 00 00 00 02 b4 a6 23 00 00 00 00 00 02 b5 01 23 00 00 00 00 00 02 b6 aa 23 00 00 00 00 00 02 b7 01 23 00 00 00 00 00 02 b8 ae 23 00 00 00 00 00 02 b9 01 23 00 00 00 00 00 02 ba b2 23 00 00 00 00 00 02 bb 01 23 00 00 00 00 00 02 bc b6 23 00 00 00 00 00 02 bd 01 23 00 00 00 00 00 02 be ba 23 00 00 00 00 00 02 bf 01 23 00 00 00 00 00 02 c0 bd 23 00 00 00 00 00 02 c1 01 23 00 00 00 00 00 02 c2 cc 23 00 00 00 00 00 02 c3 01 23 00 00 00 00 00 02 c4 d9 23 00 00 00 00 00 02 c5 01 23 00 00 00 00 00 02 c6 f2 23 00 00 00 00 00 02 c7 02 23 00 00 00 00 00 02 c8 08 23 00 00 00 00 00 02 c9 02 23 00 00 00 00 00 02 ca 31 23 00 00 00 00 00 02 cb 02 23 00 00 00 00 00 02 cc 58 23 00 00 00 00 00 02 cd 02 23 00 00 00 00 00 02 ce 5a 23 00 00 00 00 00 02 cf 02 23 00 00 00 00 00 02 d0 85 23 00 00 00 00 00 02 d1 02 23 00 00 00 00 00 02 d2 bd 23 00 00 00 00 00 02 d3 02 23 00 00 00 00 00 02 d4 e3 23 00 00 00 00 00 02 d5 03 23 00 00 00 00 00 02 d6 1c 23 00 00 00 00 00 02 d7 03 23 00 00 00 00 00 02 d8 3e 23 00 00 00 00 00 02 d9 03 23 00 00 00 00 00 02 da 6a 23 00 00 00 00 00 02 db 03 23 00 00 00 00 00 02 dc 79 23 00 00 00 00 00 02 dd 03 23 00 00 00 00 00 02 de 89 23 00 00 00 00 00 02 df 03 23 00 00 00 00 00 02 e0 9b 23 00 00 00 00 00 02 e1 03 23 00 00 00 00 00 02 e2 af 23 00 00 00 00 00 02 e3 03 23 00 00 00 00 00 02 e4 c0 23 00 00 00 00 00 02 e5 03 23 00 00 00 00 00 02 e6 cc 23 00 00 00 00 00 02 e7 03 23 00 00 00 00 00 02 e8 d2 23 00 00 00 00 00 02 e9 03 23 01 00 00 00 00 02 ea d3 23 01 00 00 00 00 02 ff 00];
        qcom,mdss-dsi-eyecare-level5-command = [23 00 00 00 00 00 02 ff 01 23 00 00 00 00 00 02 fb 01 23 00 00 00 00 00 02 68 13 23 00 00 00 00 00 02 75 00 23 00 00 00 00 00 02 76 00 23 00 00 00 00 00 02 77 00 23 00 00 00 00 00 02 78 29 23 00 00 00 00 00 02 79 00 23 00 00 00 00 00 02 7a 59 23 00 00 00 00 00 02 7b 00 23 00 00 00 00 00 02 7c 7a 23 00 00 00 00 00 02 7d 00 23 00 00 00 00 00 02 7e 93 23 00 00 00 00 00 02 7f 00 23 00 00 00 00 00 02 80 a9 23 00 00 00 00 00 02 81 00 23 00 00 00 00 00 02 82 bc 23 00 00 00 00 00 02 83 00 23 00 00 00 00 00 02 84 cd 23 00 00 00 00 00 02 85 00 23 00 00 00 00 00 02 86 dc 23 00 00 00 00 00 02 87 01 23 00 00 00 00 00 02 88 0e 23 00 00 00 00 00 02 89 01 23 00 00 00 00 00 02 8a 36 23 00 00 00 00 00 02 8b 01 23 00 00 00 00 00 02 8c 75 23 00 00 00 00 00 02 8d 01 23 00 00 00 00 00 02 8e a5 23 00 00 00 00 00 02 8f 01 23 00 00 00 00 00 02 90 f0 23 00 00 00 00 00 02 91 02 23 00 00 00 00 00 02 92 29 23 00 00 00 00 00 02 93 02 23 00 00 00 00 00 02 94 2a 23 00 00 00 00 00 02 95 02 23 00 00 00 00 00 02 96 5f 23 00 00 00 00 00 02 97 02 23 00 00 00 00 00 02 98 9a 23 00 00 00 00 00 02 99 02 23 00 00 00 00 00 02 9a c2 23 00 00 00 00 00 02 9b 02 23 00 00 00 00 00 02 9c f9 23 00 00 00 00 00 02 9d 03 23 00 00 00 00 00 02 9e 1f 23 00 00 00 00 00 02 9f 03 23 00 00 00 00 00 02 a0 50 23 00 00 00 00 00 02 a2 03 23 00 00 00 00 00 02 a3 5f 23 00 00 00 00 00 02 a4 03 23 00 00 00 00 00 02 a5 6e 23 00 00 00 00 00 02 a6 03 23 00 00 00 00 00 02 a7 80 23 00 00 00 00 00 02 a9 03 23 00 00 00 00 00 02 aa 94 23 00 00 00 00 00 02 ab 03 23 00 00 00 00 00 02 ac ac 23 00 00 00 00 00 02 ad 03 23 00 00 00 00 00 02 ae c3 23 00 00 00 00 00 02 af 03 23 00 00 00 00 00 02 b0 d2 23 00 00 00 00 00 02 b1 03 23 00 00 00 00 00 02 b2 d3 23 00 00 00 00 00 02 b3 00 23 00 00 00 00 00 02 b4 00 23 00 00 00 00 00 02 b5 00 23 00 00 00 00 00 02 b6 29 23 00 00 00 00 00 02 b7 00 23 00 00 00 00 00 02 b8 59 23 00 00 00 00 00 02 b9 00 23 00 00 00 00 00 02 ba 7a 23 00 00 00 00 00 02 bb 00 23 00 00 00 00 00 02 bc 93 23 00 00 00 00 00 02 bd 00 23 00 00 00 00 00 02 be a9 23 00 00 00 00 00 02 bf 00 23 00 00 00 00 00 02 c0 bc 23 00 00 00 00 00 02 c1 00 23 00 00 00 00 00 02 c2 cd 23 00 00 00 00 00 02 c3 00 23 00 00 00 00 00 02 c4 dc 23 00 00 00 00 00 02 c5 01 23 00 00 00 00 00 02 c6 0e 23 00 00 00 00 00 02 c7 01 23 00 00 00 00 00 02 c8 36 23 00 00 00 00 00 02 c9 01 23 00 00 00 00 00 02 ca 75 23 00 00 00 00 00 02 cb 01 23 00 00 00 00 00 02 cc a5 23 00 00 00 00 00 02 cd 01 23 00 00 00 00 00 02 ce f0 23 00 00 00 00 00 02 cf 02 23 00 00 00 00 00 02 d0 29 23 00 00 00 00 00 02 d1 02 23 00 00 00 00 00 02 d2 2a 23 00 00 00 00 00 02 d3 02 23 00 00 00 00 00 02 d4 5f 23 00 00 00 00 00 02 d5 02 23 00 00 00 00 00 02 d6 9a 23 00 00 00 00 00 02 d7 02 23 00 00 00 00 00 02 d8 c2 23 00 00 00 00 00 02 d9 02 23 00 00 00 00 00 02 da f9 23 00 00 00 00 00 02 db 03 23 00 00 00 00 00 02 dc 1f 23 00 00 00 00 00 02 dd 03 23 00 00 00 00 00 02 de 50 23 00 00 00 00 00 02 df 03 23 00 00 00 00 00 02 e0 5f 23 00 00 00 00 00 02 e1 03 23 00 00 00 00 00 02 e2 6e 23 00 00 00 00 00 02 e3 03 23 00 00 00 00 00 02 e4 80 23 00 00 00 00 00 02 e5 03 23 00 00 00 00 00 02 e6 94 23 00 00 00 00 00 02 e7 03 23 00 00 00 00 00 02 e8 ac 23 00 00 00 00 00 02 e9 03 23 00 00 00 00 00 02 ea c3 23 00 00 00 00 00 02 eb 03 23 00 00 00 00 00 02 ec d2 23 00 00 00 00 00 02 ed 03 23 00 00 00 00 00 02 ee d3 23 00 00 00 00 00 02 ef 00 23 00 00 00 00 00 02 f0 d6 23 00 00 00 00 00 02 f1 00 23 00 00 00 00 00 02 f2 dd 23 00 00 00 00 00 02 f3 00 23 00 00 00 00 00 02 f4 ea 23 00 00 00 00 00 02 f5 00 23 00 00 00 00 00 02 f6 f6 23 00 00 00 00 00 02 f7 01 23 00 00 00 00 00 02 f8 02 23 00 00 00 00 00 02 f9 01 23 00 00 00 00 00 02 fa 0c 23 00 00 00 00 00 02 ff 02 23 00 00 00 00 00 02 fb 01 23 00 00 00 00 00 02 00 01 23 00 00 00 00 00 02 01 17 23 00 00 00 00 00 02 02 01 23 00 00 00 00 00 02 03 20 23 00 00 00 00 00 02 04 01 23 00 00 00 00 00 02 05 29 23 00 00 00 00 00 02 06 01 23 00 00 00 00 00 02 07 4b 23 00 00 00 00 00 02 08 01 23 00 00 00 00 00 02 09 67 23 00 00 00 00 00 02 0a 01 23 00 00 00 00 00 02 0b 97 23 00 00 00 00 00 02 0c 01 23 00 00 00 00 00 02 0d bf 23 00 00 00 00 00 02 0e 01 23 00 00 00 00 00 02 0f fe 23 00 00 00 00 00 02 10 02 23 00 00 00 00 00 02 11 32 23 00 00 00 00 00 02 12 02 23 00 00 00 00 00 02 13 34 23 00 00 00 00 00 02 14 02 23 00 00 00 00 00 02 15 66 23 00 00 00 00 00 02 16 02 23 00 00 00 00 00 02 17 a0 23 00 00 00 00 00 02 18 02 23 00 00 00 00 00 02 19 c8 23 00 00 00 00 00 02 1a 02 23 00 00 00 00 00 02 1b fe 23 00 00 00 00 00 02 1c 03 23 00 00 00 00 00 02 1d 26 23 00 00 00 00 00 02 1e 03 23 00 00 00 00 00 02 1f 56 23 00 00 00 00 00 02 20 03 23 00 00 00 00 00 02 21 64 23 00 00 00 00 00 02 22 03 23 00 00 00 00 00 02 23 74 23 00 00 00 00 00 02 24 03 23 00 00 00 00 00 02 25 85 23 00 00 00 00 00 02 26 03 23 00 00 00 00 00 02 27 99 23 00 00 00 00 00 02 28 03 23 00 00 00 00 00 02 29 b0 23 00 00 00 00 00 02 2a 03 23 00 00 00 00 00 02 2b c5 23 00 00 00 00 00 02 2d 03 23 00 00 00 00 00 02 2f d2 23 00 00 00 00 00 02 30 03 23 00 00 00 00 00 02 31 d3 23 00 00 00 00 00 02 32 00 23 00 00 00 00 00 02 33 d6 23 00 00 00 00 00 02 34 00 23 00 00 00 00 00 02 35 dd 23 00 00 00 00 00 02 36 00 23 00 00 00 00 00 02 37 ea 23 00 00 00 00 00 02 38 00 23 00 00 00 00 00 02 39 f6 23 00 00 00 00 00 02 3a 01 23 00 00 00 00 00 02 3b 02 23 00 00 00 00 00 02 3d 01 23 00 00 00 00 00 02 3f 0c 23 00 00 00 00 00 02 40 01 23 00 00 00 00 00 02 41 17 23 00 00 00 00 00 02 42 01 23 00 00 00 00 00 02 43 20 23 00 00 00 00 00 02 44 01 23 00 00 00 00 00 02 45 29 23 00 00 00 00 00 02 46 01 23 00 00 00 00 00 02 47 4b 23 00 00 00 00 00 02 48 01 23 00 00 00 00 00 02 49 67 23 00 00 00 00 00 02 4a 01 23 00 00 00 00 00 02 4b 97 23 00 00 00 00 00 02 4c 01 23 00 00 00 00 00 02 4d bf 23 00 00 00 00 00 02 4e 01 23 00 00 00 00 00 02 4f fe 23 00 00 00 00 00 02 50 02 23 00 00 00 00 00 02 51 32 23 00 00 00 00 00 02 52 02 23 00 00 00 00 00 02 53 34 23 00 00 00 00 00 02 54 02 23 00 00 00 00 00 02 55 66 23 00 00 00 00 00 02 56 02 23 00 00 00 00 00 02 58 a0 23 00 00 00 00 00 02 59 02 23 00 00 00 00 00 02 5a c8 23 00 00 00 00 00 02 5b 02 23 00 00 00 00 00 02 5c fe 23 00 00 00 00 00 02 5d 03 23 00 00 00 00 00 02 5e 26 23 00 00 00 00 00 02 5f 03 23 00 00 00 00 00 02 60 56 23 00 00 00 00 00 02 61 03 23 00 00 00 00 00 02 62 64 23 00 00 00 00 00 02 63 03 23 00 00 00 00 00 02 64 74 23 00 00 00 00 00 02 65 03 23 00 00 00 00 00 02 66 85 23 00 00 00 00 00 02 67 03 23 00 00 00 00 00 02 68 99 23 00 00 00 00 00 02 69 03 23 00 00 00 00 00 02 6a b0 23 00 00 00 00 00 02 6b 03 23 00 00 00 00 00 02 6c c5 23 00 00 00 00 00 02 6d 03 23 00 00 00 00 00 02 6e d2 23 00 00 00 00 00 02 6f 03 23 00 00 00 00 00 02 70 d3 23 00 00 00 00 00 02 71 01 23 00 00 00 00 00 02 72 c2 23 00 00 00 00 00 02 73 01 23 00 00 00 00 00 02 74 c4 23 00 00 00 00 00 02 75 01 23 00 00 00 00 00 02 76 c7 23 00 00 00 00 00 02 77 01 23 00 00 00 00 00 02 78 ca 23 00 00 00 00 00 02 79 01 23 00 00 00 00 00 02 7a ce 23 00 00 00 00 00 02 7b 01 23 00 00 00 00 00 02 7c d1 23 00 00 00 00 00 02 7d 01 23 00 00 00 00 00 02 7e d4 23 00 00 00 00 00 02 7f 01 23 00 00 00 00 00 02 80 d7 23 00 00 00 00 00 02 81 01 23 00 00 00 00 00 02 82 da 23 00 00 00 00 00 02 83 01 23 00 00 00 00 00 02 84 e6 23 00 00 00 00 00 02 85 01 23 00 00 00 00 00 02 86 f1 23 00 00 00 00 00 02 87 02 23 00 00 00 00 00 02 88 06 23 00 00 00 00 00 02 89 02 23 00 00 00 00 00 02 8a 1a 23 00 00 00 00 00 02 8b 02 23 00 00 00 00 00 02 8c 3e 23 00 00 00 00 00 02 8d 02 23 00 00 00 00 00 02 8e 64 23 00 00 00 00 00 02 8f 02 23 00 00 00 00 00 02 90 65 23 00 00 00 00 00 02 91 02 23 00 00 00 00 00 02 92 8f 23 00 00 00 00 00 02 93 02 23 00 00 00 00 00 02 94 c6 23 00 00 00 00 00 02 95 02 23 00 00 00 00 00 02 96 ee 23 00 00 00 00 00 02 97 03 23 00 00 00 00 00 02 98 24 23 00 00 00 00 00 02 99 03 23 00 00 00 00 00 02 9a 46 23 00 00 00 00 00 02 9b 03 23 00 00 00 00 00 02 9c 71 23 00 00 00 00 00 02 9d 03 23 00 00 00 00 00 02 9e 7f 23 00 00 00 00 00 02 9f 03 23 00 00 00 00 00 02 a0 8f 23 00 00 00 00 00 02 a2 03 23 00 00 00 00 00 02 a3 a1 23 00 00 00 00 00 02 a4 03 23 00 00 00 00 00 02 a5 b3 23 00 00 00 00 00 02 a6 03 23 00 00 00 00 00 02 a7 c2 23 00 00 00 00 00 02 a9 03 23 00 00 00 00 00 02 aa cd 23 00 00 00 00 00 02 ab 03 23 00 00 00 00 00 02 ac d3 23 00 00 00 00 00 02 ad 03 23 00 00 00 00 00 02 ae d4 23 00 00 00 00 00 02 af 01 23 00 00 00 00 00 02 b0 c2 23 00 00 00 00 00 02 b1 01 23 00 00 00 00 00 02 b2 c4 23 00 00 00 00 00 02 b3 01 23 00 00 00 00 00 02 b4 c7 23 00 00 00 00 00 02 b5 01 23 00 00 00 00 00 02 b6 ca 23 00 00 00 00 00 02 b7 01 23 00 00 00 00 00 02 b8 ce 23 00 00 00 00 00 02 b9 01 23 00 00 00 00 00 02 ba d1 23 00 00 00 00 00 02 bb 01 23 00 00 00 00 00 02 bc d4 23 00 00 00 00 00 02 bd 01 23 00 00 00 00 00 02 be d7 23 00 00 00 00 00 02 bf 01 23 00 00 00 00 00 02 c0 da 23 00 00 00 00 00 02 c1 01 23 00 00 00 00 00 02 c2 e6 23 00 00 00 00 00 02 c3 01 23 00 00 00 00 00 02 c4 f1 23 00 00 00 00 00 02 c5 02 23 00 00 00 00 00 02 c6 06 23 00 00 00 00 00 02 c7 02 23 00 00 00 00 00 02 c8 1a 23 00 00 00 00 00 02 c9 02 23 00 00 00 00 00 02 ca 3e 23 00 00 00 00 00 02 cb 02 23 00 00 00 00 00 02 cc 64 23 00 00 00 00 00 02 cd 02 23 00 00 00 00 00 02 ce 65 23 00 00 00 00 00 02 cf 02 23 00 00 00 00 00 02 d0 8f 23 00 00 00 00 00 02 d1 02 23 00 00 00 00 00 02 d2 c6 23 00 00 00 00 00 02 d3 02 23 00 00 00 00 00 02 d4 ee 23 00 00 00 00 00 02 d5 03 23 00 00 00 00 00 02 d6 24 23 00 00 00 00 00 02 d7 03 23 00 00 00 00 00 02 d8 46 23 00 00 00 00 00 02 d9 03 23 00 00 00 00 00 02 da 71 23 00 00 00 00 00 02 db 03 23 00 00 00 00 00 02 dc 7f 23 00 00 00 00 00 02 dd 03 23 00 00 00 00 00 02 de 8f 23 00 00 00 00 00 02 df 03 23 00 00 00 00 00 02 e0 a1 23 00 00 00 00 00 02 e1 03 23 00 00 00 00 00 02 e2 b3 23 00 00 00 00 00 02 e3 03 23 00 00 00 00 00 02 e4 c2 23 00 00 00 00 00 02 e5 03 23 00 00 00 00 00 02 e6 cd 23 00 00 00 00 00 02 e7 03 23 00 00 00 00 00 02 e8 d3 23 00 00 00 00 00 02 e9 03 23 01 00 00 00 00 02 ea d4 23 01 00 00 00 00 02 ff 00];
        qcom,mdss-dsi-eyecare-level6-command = [23 00 00 00 00 00 02 ff 01 23 00 00 00 00 00 02 fb 01 23 00 00 00 00 00 02 68 13 23 00 00 00 00 00 02 75 00 23 00 00 00 00 00 02 76 00 23 00 00 00 00 00 02 77 00 23 00 00 00 00 00 02 78 29 23 00 00 00 00 00 02 79 00 23 00 00 00 00 00 02 7a 59 23 00 00 00 00 00 02 7b 00 23 00 00 00 00 00 02 7c 7a 23 00 00 00 00 00 02 7d 00 23 00 00 00 00 00 02 7e 93 23 00 00 00 00 00 02 7f 00 23 00 00 00 00 00 02 80 a9 23 00 00 00 00 00 02 81 00 23 00 00 00 00 00 02 82 bc 23 00 00 00 00 00 02 83 00 23 00 00 00 00 00 02 84 cd 23 00 00 00 00 00 02 85 00 23 00 00 00 00 00 02 86 dc 23 00 00 00 00 00 02 87 01 23 00 00 00 00 00 02 88 0e 23 00 00 00 00 00 02 89 01 23 00 00 00 00 00 02 8a 36 23 00 00 00 00 00 02 8b 01 23 00 00 00 00 00 02 8c 75 23 00 00 00 00 00 02 8d 01 23 00 00 00 00 00 02 8e a5 23 00 00 00 00 00 02 8f 01 23 00 00 00 00 00 02 90 f0 23 00 00 00 00 00 02 91 02 23 00 00 00 00 00 02 92 29 23 00 00 00 00 00 02 93 02 23 00 00 00 00 00 02 94 2a 23 00 00 00 00 00 02 95 02 23 00 00 00 00 00 02 96 5f 23 00 00 00 00 00 02 97 02 23 00 00 00 00 00 02 98 9a 23 00 00 00 00 00 02 99 02 23 00 00 00 00 00 02 9a c2 23 00 00 00 00 00 02 9b 02 23 00 00 00 00 00 02 9c f9 23 00 00 00 00 00 02 9d 03 23 00 00 00 00 00 02 9e 1f 23 00 00 00 00 00 02 9f 03 23 00 00 00 00 00 02 a0 50 23 00 00 00 00 00 02 a2 03 23 00 00 00 00 00 02 a3 5f 23 00 00 00 00 00 02 a4 03 23 00 00 00 00 00 02 a5 6e 23 00 00 00 00 00 02 a6 03 23 00 00 00 00 00 02 a7 80 23 00 00 00 00 00 02 a9 03 23 00 00 00 00 00 02 aa 94 23 00 00 00 00 00 02 ab 03 23 00 00 00 00 00 02 ac ac 23 00 00 00 00 00 02 ad 03 23 00 00 00 00 00 02 ae c3 23 00 00 00 00 00 02 af 03 23 00 00 00 00 00 02 b0 d2 23 00 00 00 00 00 02 b1 03 23 00 00 00 00 00 02 b2 d3 23 00 00 00 00 00 02 b3 00 23 00 00 00 00 00 02 b4 00 23 00 00 00 00 00 02 b5 00 23 00 00 00 00 00 02 b6 29 23 00 00 00 00 00 02 b7 00 23 00 00 00 00 00 02 b8 59 23 00 00 00 00 00 02 b9 00 23 00 00 00 00 00 02 ba 7a 23 00 00 00 00 00 02 bb 00 23 00 00 00 00 00 02 bc 93 23 00 00 00 00 00 02 bd 00 23 00 00 00 00 00 02 be a9 23 00 00 00 00 00 02 bf 00 23 00 00 00 00 00 02 c0 bc 23 00 00 00 00 00 02 c1 00 23 00 00 00 00 00 02 c2 cd 23 00 00 00 00 00 02 c3 00 23 00 00 00 00 00 02 c4 dc 23 00 00 00 00 00 02 c5 01 23 00 00 00 00 00 02 c6 0e 23 00 00 00 00 00 02 c7 01 23 00 00 00 00 00 02 c8 36 23 00 00 00 00 00 02 c9 01 23 00 00 00 00 00 02 ca 75 23 00 00 00 00 00 02 cb 01 23 00 00 00 00 00 02 cc a5 23 00 00 00 00 00 02 cd 01 23 00 00 00 00 00 02 ce f0 23 00 00 00 00 00 02 cf 02 23 00 00 00 00 00 02 d0 29 23 00 00 00 00 00 02 d1 02 23 00 00 00 00 00 02 d2 2a 23 00 00 00 00 00 02 d3 02 23 00 00 00 00 00 02 d4 5f 23 00 00 00 00 00 02 d5 02 23 00 00 00 00 00 02 d6 9a 23 00 00 00 00 00 02 d7 02 23 00 00 00 00 00 02 d8 c2 23 00 00 00 00 00 02 d9 02 23 00 00 00 00 00 02 da f9 23 00 00 00 00 00 02 db 03 23 00 00 00 00 00 02 dc 1f 23 00 00 00 00 00 02 dd 03 23 00 00 00 00 00 02 de 50 23 00 00 00 00 00 02 df 03 23 00 00 00 00 00 02 e0 5f 23 00 00 00 00 00 02 e1 03 23 00 00 00 00 00 02 e2 6e 23 00 00 00 00 00 02 e3 03 23 00 00 00 00 00 02 e4 80 23 00 00 00 00 00 02 e5 03 23 00 00 00 00 00 02 e6 94 23 00 00 00 00 00 02 e7 03 23 00 00 00 00 00 02 e8 ac 23 00 00 00 00 00 02 e9 03 23 00 00 00 00 00 02 ea c3 23 00 00 00 00 00 02 eb 03 23 00 00 00 00 00 02 ec d2 23 00 00 00 00 00 02 ed 03 23 00 00 00 00 00 02 ee d3 23 00 00 00 00 00 02 ef 00 23 00 00 00 00 00 02 f0 d6 23 00 00 00 00 00 02 f1 00 23 00 00 00 00 00 02 f2 dd 23 00 00 00 00 00 02 f3 00 23 00 00 00 00 00 02 f4 ea 23 00 00 00 00 00 02 f5 00 23 00 00 00 00 00 02 f6 f6 23 00 00 00 00 00 02 f7 01 23 00 00 00 00 00 02 f8 02 23 00 00 00 00 00 02 f9 01 23 00 00 00 00 00 02 fa 0c 23 00 00 00 00 00 02 ff 02 23 00 00 00 00 00 02 fb 01 23 00 00 00 00 00 02 00 01 23 00 00 00 00 00 02 01 17 23 00 00 00 00 00 02 02 01 23 00 00 00 00 00 02 03 20 23 00 00 00 00 00 02 04 01 23 00 00 00 00 00 02 05 29 23 00 00 00 00 00 02 06 01 23 00 00 00 00 00 02 07 4b 23 00 00 00 00 00 02 08 01 23 00 00 00 00 00 02 09 67 23 00 00 00 00 00 02 0a 01 23 00 00 00 00 00 02 0b 97 23 00 00 00 00 00 02 0c 01 23 00 00 00 00 00 02 0d bf 23 00 00 00 00 00 02 0e 01 23 00 00 00 00 00 02 0f fe 23 00 00 00 00 00 02 10 02 23 00 00 00 00 00 02 11 32 23 00 00 00 00 00 02 12 02 23 00 00 00 00 00 02 13 34 23 00 00 00 00 00 02 14 02 23 00 00 00 00 00 02 15 66 23 00 00 00 00 00 02 16 02 23 00 00 00 00 00 02 17 a0 23 00 00 00 00 00 02 18 02 23 00 00 00 00 00 02 19 c8 23 00 00 00 00 00 02 1a 02 23 00 00 00 00 00 02 1b fe 23 00 00 00 00 00 02 1c 03 23 00 00 00 00 00 02 1d 26 23 00 00 00 00 00 02 1e 03 23 00 00 00 00 00 02 1f 56 23 00 00 00 00 00 02 20 03 23 00 00 00 00 00 02 21 64 23 00 00 00 00 00 02 22 03 23 00 00 00 00 00 02 23 74 23 00 00 00 00 00 02 24 03 23 00 00 00 00 00 02 25 85 23 00 00 00 00 00 02 26 03 23 00 00 00 00 00 02 27 99 23 00 00 00 00 00 02 28 03 23 00 00 00 00 00 02 29 b0 23 00 00 00 00 00 02 2a 03 23 00 00 00 00 00 02 2b c5 23 00 00 00 00 00 02 2d 03 23 00 00 00 00 00 02 2f d2 23 00 00 00 00 00 02 30 03 23 00 00 00 00 00 02 31 d3 23 00 00 00 00 00 02 32 00 23 00 00 00 00 00 02 33 d6 23 00 00 00 00 00 02 34 00 23 00 00 00 00 00 02 35 dd 23 00 00 00 00 00 02 36 00 23 00 00 00 00 00 02 37 ea 23 00 00 00 00 00 02 38 00 23 00 00 00 00 00 02 39 f6 23 00 00 00 00 00 02 3a 01 23 00 00 00 00 00 02 3b 02 23 00 00 00 00 00 02 3d 01 23 00 00 00 00 00 02 3f 0c 23 00 00 00 00 00 02 40 01 23 00 00 00 00 00 02 41 17 23 00 00 00 00 00 02 42 01 23 00 00 00 00 00 02 43 20 23 00 00 00 00 00 02 44 01 23 00 00 00 00 00 02 45 29 23 00 00 00 00 00 02 46 01 23 00 00 00 00 00 02 47 4b 23 00 00 00 00 00 02 48 01 23 00 00 00 00 00 02 49 67 23 00 00 00 00 00 02 4a 01 23 00 00 00 00 00 02 4b 97 23 00 00 00 00 00 02 4c 01 23 00 00 00 00 00 02 4d bf 23 00 00 00 00 00 02 4e 01 23 00 00 00 00 00 02 4f fe 23 00 00 00 00 00 02 50 02 23 00 00 00 00 00 02 51 32 23 00 00 00 00 00 02 52 02 23 00 00 00 00 00 02 53 34 23 00 00 00 00 00 02 54 02 23 00 00 00 00 00 02 55 66 23 00 00 00 00 00 02 56 02 23 00 00 00 00 00 02 58 a0 23 00 00 00 00 00 02 59 02 23 00 00 00 00 00 02 5a c8 23 00 00 00 00 00 02 5b 02 23 00 00 00 00 00 02 5c fe 23 00 00 00 00 00 02 5d 03 23 00 00 00 00 00 02 5e 26 23 00 00 00 00 00 02 5f 03 23 00 00 00 00 00 02 60 56 23 00 00 00 00 00 02 61 03 23 00 00 00 00 00 02 62 64 23 00 00 00 00 00 02 63 03 23 00 00 00 00 00 02 64 74 23 00 00 00 00 00 02 65 03 23 00 00 00 00 00 02 66 85 23 00 00 00 00 00 02 67 03 23 00 00 00 00 00 02 68 99 23 00 00 00 00 00 02 69 03 23 00 00 00 00 00 02 6a b0 23 00 00 00 00 00 02 6b 03 23 00 00 00 00 00 02 6c c5 23 00 00 00 00 00 02 6d 03 23 00 00 00 00 00 02 6e d2 23 00 00 00 00 00 02 6f 03 23 00 00 00 00 00 02 70 d3 23 00 00 00 00 00 02 71 01 23 00 00 00 00 00 02 72 d9 23 00 00 00 00 00 02 73 01 23 00 00 00 00 00 02 74 da 23 00 00 00 00 00 02 75 01 23 00 00 00 00 00 02 76 dd 23 00 00 00 00 00 02 77 01 23 00 00 00 00 00 02 78 e0 23 00 00 00 00 00 02 79 01 23 00 00 00 00 00 02 7a e3 23 00 00 00 00 00 02 7b 01 23 00 00 00 00 00 02 7c e6 23 00 00 00 00 00 02 7d 01 23 00 00 00 00 00 02 7e e8 23 00 00 00 00 00 02 7f 01 23 00 00 00 00 00 02 80 eb 23 00 00 00 00 00 02 81 01 23 00 00 00 00 00 02 82 ee 23 00 00 00 00 00 02 83 01 23 00 00 00 00 00 02 84 f7 23 00 00 00 00 00 02 85 02 23 00 00 00 00 00 02 86 02 23 00 00 00 00 00 02 87 02 23 00 00 00 00 00 02 88 14 23 00 00 00 00 00 02 89 02 23 00 00 00 00 00 02 8a 26 23 00 00 00 00 00 02 8b 02 23 00 00 00 00 00 02 8c 49 23 00 00 00 00 00 02 8d 02 23 00 00 00 00 00 02 8e 6c 23 00 00 00 00 00 02 8f 02 23 00 00 00 00 00 02 90 6e 23 00 00 00 00 00 02 91 02 23 00 00 00 00 00 02 92 97 23 00 00 00 00 00 02 93 02 23 00 00 00 00 00 02 94 ce 23 00 00 00 00 00 02 95 02 23 00 00 00 00 00 02 96 f7 23 00 00 00 00 00 02 97 03 23 00 00 00 00 00 02 98 2b 23 00 00 00 00 00 02 99 03 23 00 00 00 00 00 02 9a 4c 23 00 00 00 00 00 02 9b 03 23 00 00 00 00 00 02 9c 77 23 00 00 00 00 00 02 9d 03 23 00 00 00 00 00 02 9e 85 23 00 00 00 00 00 02 9f 03 23 00 00 00 00 00 02 a0 95 23 00 00 00 00 00 02 a2 03 23 00 00 00 00 00 02 a3 a6 23 00 00 00 00 00 02 a4 03 23 00 00 00 00 00 02 a5 b6 23 00 00 00 00 00 02 a6 03 23 00 00 00 00 00 02 a7 c4 23 00 00 00 00 00 02 a9 03 23 00 00 00 00 00 02 aa ce 23 00 00 00 00 00 02 ab 03 23 00 00 00 00 00 02 ac d3 23 00 00 00 00 00 02 ad 03 23 00 00 00 00 00 02 ae d4 23 00 00 00 00 00 02 af 01 23 00 00 00 00 00 02 b0 d9 23 00 00 00 00 00 02 b1 01 23 00 00 00 00 00 02 b2 da 23 00 00 00 00 00 02 b3 01 23 00 00 00 00 00 02 b4 dd 23 00 00 00 00 00 02 b5 01 23 00 00 00 00 00 02 b6 e0 23 00 00 00 00 00 02 b7 01 23 00 00 00 00 00 02 b8 e3 23 00 00 00 00 00 02 b9 01 23 00 00 00 00 00 02 ba e6 23 00 00 00 00 00 02 bb 01 23 00 00 00 00 00 02 bc e8 23 00 00 00 00 00 02 bd 01 23 00 00 00 00 00 02 be eb 23 00 00 00 00 00 02 bf 01 23 00 00 00 00 00 02 c0 ee 23 00 00 00 00 00 02 c1 01 23 00 00 00 00 00 02 c2 f7 23 00 00 00 00 00 02 c3 02 23 00 00 00 00 00 02 c4 02 23 00 00 00 00 00 02 c5 02 23 00 00 00 00 00 02 c6 14 23 00 00 00 00 00 02 c7 02 23 00 00 00 00 00 02 c8 26 23 00 00 00 00 00 02 c9 02 23 00 00 00 00 00 02 ca 49 23 00 00 00 00 00 02 cb 02 23 00 00 00 00 00 02 cc 6c 23 00 00 00 00 00 02 cd 02 23 00 00 00 00 00 02 ce 6e 23 00 00 00 00 00 02 cf 02 23 00 00 00 00 00 02 d0 97 23 00 00 00 00 00 02 d1 02 23 00 00 00 00 00 02 d2 ce 23 00 00 00 00 00 02 d3 02 23 00 00 00 00 00 02 d4 f7 23 00 00 00 00 00 02 d5 03 23 00 00 00 00 00 02 d6 2b 23 00 00 00 00 00 02 d7 03 23 00 00 00 00 00 02 d8 4c 23 00 00 00 00 00 02 d9 03 23 00 00 00 00 00 02 da 77 23 00 00 00 00 00 02 db 03 23 00 00 00 00 00 02 dc 85 23 00 00 00 00 00 02 dd 03 23 00 00 00 00 00 02 de 95 23 00 00 00 00 00 02 df 03 23 00 00 00 00 00 02 e0 a6 23 00 00 00 00 00 02 e1 03 23 00 00 00 00 00 02 e2 b6 23 00 00 00 00 00 02 e3 03 23 00 00 00 00 00 02 e4 c4 23 00 00 00 00 00 02 e5 03 23 00 00 00 00 00 02 e6 ce 23 00 00 00 00 00 02 e7 03 23 00 00 00 00 00 02 e8 d3 23 00 00 00 00 00 02 e9 03 23 01 00 00 00 00 02 ea d4 23 01 00 00 00 00 02 ff 00];
        qcom,mdss-dsi-eyecare-level7-command = [23 00 00 00 00 00 02 ff 01 23 00 00 00 00 00 02 fb 01 23 00 00 00 00 00 02 68 13 23 00 00 00 00 00 02 75 00 23 00 00 00 00 00 02 76 00 23 00 00 00 00 00 02 77 00 23 00 00 00 00 00 02 78 29 23 00 00 00 00 00 02 79 00 23 00 00 00 00 00 02 7a 59 23 00 00 00 00 00 02 7b 00 23 00 00 00 00 00 02 7c 7a 23 00 00 00 00 00 02 7d 00 23 00 00 00 00 00 02 7e 93 23 00 00 00 00 00 02 7f 00 23 00 00 00 00 00 02 80 a9 23 00 00 00 00 00 02 81 00 23 00 00 00 00 00 02 82 bc 23 00 00 00 00 00 02 83 00 23 00 00 00 00 00 02 84 cd 23 00 00 00 00 00 02 85 00 23 00 00 00 00 00 02 86 dc 23 00 00 00 00 00 02 87 01 23 00 00 00 00 00 02 88 0e 23 00 00 00 00 00 02 89 01 23 00 00 00 00 00 02 8a 36 23 00 00 00 00 00 02 8b 01 23 00 00 00 00 00 02 8c 75 23 00 00 00 00 00 02 8d 01 23 00 00 00 00 00 02 8e a5 23 00 00 00 00 00 02 8f 01 23 00 00 00 00 00 02 90 f0 23 00 00 00 00 00 02 91 02 23 00 00 00 00 00 02 92 29 23 00 00 00 00 00 02 93 02 23 00 00 00 00 00 02 94 2a 23 00 00 00 00 00 02 95 02 23 00 00 00 00 00 02 96 5f 23 00 00 00 00 00 02 97 02 23 00 00 00 00 00 02 98 9a 23 00 00 00 00 00 02 99 02 23 00 00 00 00 00 02 9a c2 23 00 00 00 00 00 02 9b 02 23 00 00 00 00 00 02 9c f9 23 00 00 00 00 00 02 9d 03 23 00 00 00 00 00 02 9e 1f 23 00 00 00 00 00 02 9f 03 23 00 00 00 00 00 02 a0 50 23 00 00 00 00 00 02 a2 03 23 00 00 00 00 00 02 a3 5f 23 00 00 00 00 00 02 a4 03 23 00 00 00 00 00 02 a5 6e 23 00 00 00 00 00 02 a6 03 23 00 00 00 00 00 02 a7 80 23 00 00 00 00 00 02 a9 03 23 00 00 00 00 00 02 aa 94 23 00 00 00 00 00 02 ab 03 23 00 00 00 00 00 02 ac ac 23 00 00 00 00 00 02 ad 03 23 00 00 00 00 00 02 ae c3 23 00 00 00 00 00 02 af 03 23 00 00 00 00 00 02 b0 d2 23 00 00 00 00 00 02 b1 03 23 00 00 00 00 00 02 b2 d3 23 00 00 00 00 00 02 b3 00 23 00 00 00 00 00 02 b4 00 23 00 00 00 00 00 02 b5 00 23 00 00 00 00 00 02 b6 29 23 00 00 00 00 00 02 b7 00 23 00 00 00 00 00 02 b8 59 23 00 00 00 00 00 02 b9 00 23 00 00 00 00 00 02 ba 7a 23 00 00 00 00 00 02 bb 00 23 00 00 00 00 00 02 bc 93 23 00 00 00 00 00 02 bd 00 23 00 00 00 00 00 02 be a9 23 00 00 00 00 00 02 bf 00 23 00 00 00 00 00 02 c0 bc 23 00 00 00 00 00 02 c1 00 23 00 00 00 00 00 02 c2 cd 23 00 00 00 00 00 02 c3 00 23 00 00 00 00 00 02 c4 dc 23 00 00 00 00 00 02 c5 01 23 00 00 00 00 00 02 c6 0e 23 00 00 00 00 00 02 c7 01 23 00 00 00 00 00 02 c8 36 23 00 00 00 00 00 02 c9 01 23 00 00 00 00 00 02 ca 75 23 00 00 00 00 00 02 cb 01 23 00 00 00 00 00 02 cc a5 23 00 00 00 00 00 02 cd 01 23 00 00 00 00 00 02 ce f0 23 00 00 00 00 00 02 cf 02 23 00 00 00 00 00 02 d0 29 23 00 00 00 00 00 02 d1 02 23 00 00 00 00 00 02 d2 2a 23 00 00 00 00 00 02 d3 02 23 00 00 00 00 00 02 d4 5f 23 00 00 00 00 00 02 d5 02 23 00 00 00 00 00 02 d6 9a 23 00 00 00 00 00 02 d7 02 23 00 00 00 00 00 02 d8 c2 23 00 00 00 00 00 02 d9 02 23 00 00 00 00 00 02 da f9 23 00 00 00 00 00 02 db 03 23 00 00 00 00 00 02 dc 1f 23 00 00 00 00 00 02 dd 03 23 00 00 00 00 00 02 de 50 23 00 00 00 00 00 02 df 03 23 00 00 00 00 00 02 e0 5f 23 00 00 00 00 00 02 e1 03 23 00 00 00 00 00 02 e2 6e 23 00 00 00 00 00 02 e3 03 23 00 00 00 00 00 02 e4 80 23 00 00 00 00 00 02 e5 03 23 00 00 00 00 00 02 e6 94 23 00 00 00 00 00 02 e7 03 23 00 00 00 00 00 02 e8 ac 23 00 00 00 00 00 02 e9 03 23 00 00 00 00 00 02 ea c3 23 00 00 00 00 00 02 eb 03 23 00 00 00 00 00 02 ec d2 23 00 00 00 00 00 02 ed 03 23 00 00 00 00 00 02 ee d3 23 00 00 00 00 00 02 ef 00 23 00 00 00 00 00 02 f0 d6 23 00 00 00 00 00 02 f1 00 23 00 00 00 00 00 02 f2 dd 23 00 00 00 00 00 02 f3 00 23 00 00 00 00 00 02 f4 ea 23 00 00 00 00 00 02 f5 00 23 00 00 00 00 00 02 f6 f6 23 00 00 00 00 00 02 f7 01 23 00 00 00 00 00 02 f8 02 23 00 00 00 00 00 02 f9 01 23 00 00 00 00 00 02 fa 0c 23 00 00 00 00 00 02 ff 02 23 00 00 00 00 00 02 fb 01 23 00 00 00 00 00 02 00 01 23 00 00 00 00 00 02 01 17 23 00 00 00 00 00 02 02 01 23 00 00 00 00 00 02 03 20 23 00 00 00 00 00 02 04 01 23 00 00 00 00 00 02 05 29 23 00 00 00 00 00 02 06 01 23 00 00 00 00 00 02 07 4b 23 00 00 00 00 00 02 08 01 23 00 00 00 00 00 02 09 67 23 00 00 00 00 00 02 0a 01 23 00 00 00 00 00 02 0b 97 23 00 00 00 00 00 02 0c 01 23 00 00 00 00 00 02 0d bf 23 00 00 00 00 00 02 0e 01 23 00 00 00 00 00 02 0f fe 23 00 00 00 00 00 02 10 02 23 00 00 00 00 00 02 11 32 23 00 00 00 00 00 02 12 02 23 00 00 00 00 00 02 13 34 23 00 00 00 00 00 02 14 02 23 00 00 00 00 00 02 15 66 23 00 00 00 00 00 02 16 02 23 00 00 00 00 00 02 17 a0 23 00 00 00 00 00 02 18 02 23 00 00 00 00 00 02 19 c8 23 00 00 00 00 00 02 1a 02 23 00 00 00 00 00 02 1b fe 23 00 00 00 00 00 02 1c 03 23 00 00 00 00 00 02 1d 26 23 00 00 00 00 00 02 1e 03 23 00 00 00 00 00 02 1f 56 23 00 00 00 00 00 02 20 03 23 00 00 00 00 00 02 21 64 23 00 00 00 00 00 02 22 03 23 00 00 00 00 00 02 23 74 23 00 00 00 00 00 02 24 03 23 00 00 00 00 00 02 25 85 23 00 00 00 00 00 02 26 03 23 00 00 00 00 00 02 27 99 23 00 00 00 00 00 02 28 03 23 00 00 00 00 00 02 29 b0 23 00 00 00 00 00 02 2a 03 23 00 00 00 00 00 02 2b c5 23 00 00 00 00 00 02 2d 03 23 00 00 00 00 00 02 2f d2 23 00 00 00 00 00 02 30 03 23 00 00 00 00 00 02 31 d3 23 00 00 00 00 00 02 32 00 23 00 00 00 00 00 02 33 d6 23 00 00 00 00 00 02 34 00 23 00 00 00 00 00 02 35 dd 23 00 00 00 00 00 02 36 00 23 00 00 00 00 00 02 37 ea 23 00 00 00 00 00 02 38 00 23 00 00 00 00 00 02 39 f6 23 00 00 00 00 00 02 3a 01 23 00 00 00 00 00 02 3b 02 23 00 00 00 00 00 02 3d 01 23 00 00 00 00 00 02 3f 0c 23 00 00 00 00 00 02 40 01 23 00 00 00 00 00 02 41 17 23 00 00 00 00 00 02 42 01 23 00 00 00 00 00 02 43 20 23 00 00 00 00 00 02 44 01 23 00 00 00 00 00 02 45 29 23 00 00 00 00 00 02 46 01 23 00 00 00 00 00 02 47 4b 23 00 00 00 00 00 02 48 01 23 00 00 00 00 00 02 49 67 23 00 00 00 00 00 02 4a 01 23 00 00 00 00 00 02 4b 97 23 00 00 00 00 00 02 4c 01 23 00 00 00 00 00 02 4d bf 23 00 00 00 00 00 02 4e 01 23 00 00 00 00 00 02 4f fe 23 00 00 00 00 00 02 50 02 23 00 00 00 00 00 02 51 32 23 00 00 00 00 00 02 52 02 23 00 00 00 00 00 02 53 34 23 00 00 00 00 00 02 54 02 23 00 00 00 00 00 02 55 66 23 00 00 00 00 00 02 56 02 23 00 00 00 00 00 02 58 a0 23 00 00 00 00 00 02 59 02 23 00 00 00 00 00 02 5a c8 23 00 00 00 00 00 02 5b 02 23 00 00 00 00 00 02 5c fe 23 00 00 00 00 00 02 5d 03 23 00 00 00 00 00 02 5e 26 23 00 00 00 00 00 02 5f 03 23 00 00 00 00 00 02 60 56 23 00 00 00 00 00 02 61 03 23 00 00 00 00 00 02 62 64 23 00 00 00 00 00 02 63 03 23 00 00 00 00 00 02 64 74 23 00 00 00 00 00 02 65 03 23 00 00 00 00 00 02 66 85 23 00 00 00 00 00 02 67 03 23 00 00 00 00 00 02 68 99 23 00 00 00 00 00 02 69 03 23 00 00 00 00 00 02 6a b0 23 00 00 00 00 00 02 6b 03 23 00 00 00 00 00 02 6c c5 23 00 00 00 00 00 02 6d 03 23 00 00 00 00 00 02 6e d2 23 00 00 00 00 00 02 6f 03 23 00 00 00 00 00 02 70 d3 23 00 00 00 00 00 02 71 01 23 00 00 00 00 00 02 72 f2 23 00 00 00 00 00 02 73 01 23 00 00 00 00 00 02 74 f3 23 00 00 00 00 00 02 75 01 23 00 00 00 00 00 02 76 f5 23 00 00 00 00 00 02 77 01 23 00 00 00 00 00 02 78 f7 23 00 00 00 00 00 02 79 01 23 00 00 00 00 00 02 7a fa 23 00 00 00 00 00 02 7b 01 23 00 00 00 00 00 02 7c fc 23 00 00 00 00 00 02 7d 01 23 00 00 00 00 00 02 7e fe 23 00 00 00 00 00 02 7f 02 23 00 00 00 00 00 02 80 01 23 00 00 00 00 00 02 81 02 23 00 00 00 00 00 02 82 03 23 00 00 00 00 00 02 83 02 23 00 00 00 00 00 02 84 0c 23 00 00 00 00 00 02 85 02 23 00 00 00 00 00 02 86 15 23 00 00 00 00 00 02 87 02 23 00 00 00 00 00 02 88 25 23 00 00 00 00 00 02 89 02 23 00 00 00 00 00 02 8a 35 23 00 00 00 00 00 02 8b 02 23 00 00 00 00 00 02 8c 55 23 00 00 00 00 00 02 8d 02 23 00 00 00 00 00 02 8e 77 23 00 00 00 00 00 02 8f 02 23 00 00 00 00 00 02 90 78 23 00 00 00 00 00 02 91 02 23 00 00 00 00 00 02 92 a1 23 00 00 00 00 00 02 93 02 23 00 00 00 00 00 02 94 d8 23 00 00 00 00 00 02 95 03 23 00 00 00 00 00 02 96 01 23 00 00 00 00 00 02 97 03 23 00 00 00 00 00 02 98 33 23 00 00 00 00 00 02 99 03 23 00 00 00 00 00 02 9a 54 23 00 00 00 00 00 02 9b 03 23 00 00 00 00 00 02 9c 7e 23 00 00 00 00 00 02 9d 03 23 00 00 00 00 00 02 9e 8c 23 00 00 00 00 00 02 9f 03 23 00 00 00 00 00 02 a0 9b 23 00 00 00 00 00 02 a2 03 23 00 00 00 00 00 02 a3 ab 23 00 00 00 00 00 02 a4 03 23 00 00 00 00 00 02 a5 ba 23 00 00 00 00 00 02 a6 03 23 00 00 00 00 00 02 a7 c6 23 00 00 00 00 00 02 a9 03 23 00 00 00 00 00 02 aa cf 23 00 00 00 00 00 02 ab 03 23 00 00 00 00 00 02 ac d3 23 00 00 00 00 00 02 ad 03 23 00 00 00 00 00 02 ae d4 23 00 00 00 00 00 02 af 01 23 00 00 00 00 00 02 b0 f2 23 00 00 00 00 00 02 b1 01 23 00 00 00 00 00 02 b2 f3 23 00 00 00 00 00 02 b3 01 23 00 00 00 00 00 02 b4 f5 23 00 00 00 00 00 02 b5 01 23 00 00 00 00 00 02 b6 f7 23 00 00 00 00 00 02 b7 01 23 00 00 00 00 00 02 b8 fa 23 00 00 00 00 00 02 b9 01 23 00 00 00 00 00 02 ba fc 23 00 00 00 00 00 02 bb 01 23 00 00 00 00 00 02 bc fe 23 00 00 00 00 00 02 bd 02 23 00 00 00 00 00 02 be 01 23 00 00 00 00 00 02 bf 02 23 00 00 00 00 00 02 c0 03 23 00 00 00 00 00 02 c1 02 23 00 00 00 00 00 02 c2 0c 23 00 00 00 00 00 02 c3 02 23 00 00 00 00 00 02 c4 15 23 00 00 00 00 00 02 c5 02 23 00 00 00 00 00 02 c6 25 23 00 00 00 00 00 02 c7 02 23 00 00 00 00 00 02 c8 35 23 00 00 00 00 00 02 c9 02 23 00 00 00 00 00 02 ca 55 23 00 00 00 00 00 02 cb 02 23 00 00 00 00 00 02 cc 77 23 00 00 00 00 00 02 cd 02 23 00 00 00 00 00 02 ce 78 23 00 00 00 00 00 02 cf 02 23 00 00 00 00 00 02 d0 a1 23 00 00 00 00 00 02 d1 02 23 00 00 00 00 00 02 d2 d8 23 00 00 00 00 00 02 d3 03 23 00 00 00 00 00 02 d4 01 23 00 00 00 00 00 02 d5 03 23 00 00 00 00 00 02 d6 33 23 00 00 00 00 00 02 d7 03 23 00 00 00 00 00 02 d8 54 23 00 00 00 00 00 02 d9 03 23 00 00 00 00 00 02 da 7e 23 00 00 00 00 00 02 db 03 23 00 00 00 00 00 02 dc 8c 23 00 00 00 00 00 02 dd 03 23 00 00 00 00 00 02 de 9b 23 00 00 00 00 00 02 df 03 23 00 00 00 00 00 02 e0 ab 23 00 00 00 00 00 02 e1 03 23 00 00 00 00 00 02 e2 ba 23 00 00 00 00 00 02 e3 03 23 00 00 00 00 00 02 e4 c6 23 00 00 00 00 00 02 e5 03 23 00 00 00 00 00 02 e6 cf 23 00 00 00 00 00 02 e7 03 23 00 00 00 00 00 02 e8 d3 23 00 00 00 00 00 02 e9 03 23 01 00 00 00 00 02 ea d4 23 01 00 00 00 00 02 ff 00];
        qcom,mdss-dsi-eyecare-level8-command = [23 00 00 00 00 00 02 ff 01 23 00 00 00 00 00 02 fb 01 23 00 00 00 00 00 02 68 13 23 00 00 00 00 00 02 75 00 23 00 00 00 00 00 02 76 00 23 00 00 00 00 00 02 77 00 23 00 00 00 00 00 02 78 29 23 00 00 00 00 00 02 79 00 23 00 00 00 00 00 02 7a 59 23 00 00 00 00 00 02 7b 00 23 00 00 00 00 00 02 7c 7a 23 00 00 00 00 00 02 7d 00 23 00 00 00 00 00 02 7e 93 23 00 00 00 00 00 02 7f 00 23 00 00 00 00 00 02 80 a9 23 00 00 00 00 00 02 81 00 23 00 00 00 00 00 02 82 bc 23 00 00 00 00 00 02 83 00 23 00 00 00 00 00 02 84 cd 23 00 00 00 00 00 02 85 00 23 00 00 00 00 00 02 86 dc 23 00 00 00 00 00 02 87 01 23 00 00 00 00 00 02 88 0e 23 00 00 00 00 00 02 89 01 23 00 00 00 00 00 02 8a 36 23 00 00 00 00 00 02 8b 01 23 00 00 00 00 00 02 8c 75 23 00 00 00 00 00 02 8d 01 23 00 00 00 00 00 02 8e a5 23 00 00 00 00 00 02 8f 01 23 00 00 00 00 00 02 90 f0 23 00 00 00 00 00 02 91 02 23 00 00 00 00 00 02 92 29 23 00 00 00 00 00 02 93 02 23 00 00 00 00 00 02 94 2a 23 00 00 00 00 00 02 95 02 23 00 00 00 00 00 02 96 5f 23 00 00 00 00 00 02 97 02 23 00 00 00 00 00 02 98 9a 23 00 00 00 00 00 02 99 02 23 00 00 00 00 00 02 9a c2 23 00 00 00 00 00 02 9b 02 23 00 00 00 00 00 02 9c f9 23 00 00 00 00 00 02 9d 03 23 00 00 00 00 00 02 9e 1f 23 00 00 00 00 00 02 9f 03 23 00 00 00 00 00 02 a0 50 23 00 00 00 00 00 02 a2 03 23 00 00 00 00 00 02 a3 5f 23 00 00 00 00 00 02 a4 03 23 00 00 00 00 00 02 a5 6e 23 00 00 00 00 00 02 a6 03 23 00 00 00 00 00 02 a7 80 23 00 00 00 00 00 02 a9 03 23 00 00 00 00 00 02 aa 94 23 00 00 00 00 00 02 ab 03 23 00 00 00 00 00 02 ac ac 23 00 00 00 00 00 02 ad 03 23 00 00 00 00 00 02 ae c3 23 00 00 00 00 00 02 af 03 23 00 00 00 00 00 02 b0 d2 23 00 00 00 00 00 02 b1 03 23 00 00 00 00 00 02 b2 d3 23 00 00 00 00 00 02 b3 00 23 00 00 00 00 00 02 b4 00 23 00 00 00 00 00 02 b5 00 23 00 00 00 00 00 02 b6 29 23 00 00 00 00 00 02 b7 00 23 00 00 00 00 00 02 b8 59 23 00 00 00 00 00 02 b9 00 23 00 00 00 00 00 02 ba 7a 23 00 00 00 00 00 02 bb 00 23 00 00 00 00 00 02 bc 93 23 00 00 00 00 00 02 bd 00 23 00 00 00 00 00 02 be a9 23 00 00 00 00 00 02 bf 00 23 00 00 00 00 00 02 c0 bc 23 00 00 00 00 00 02 c1 00 23 00 00 00 00 00 02 c2 cd 23 00 00 00 00 00 02 c3 00 23 00 00 00 00 00 02 c4 dc 23 00 00 00 00 00 02 c5 01 23 00 00 00 00 00 02 c6 0e 23 00 00 00 00 00 02 c7 01 23 00 00 00 00 00 02 c8 36 23 00 00 00 00 00 02 c9 01 23 00 00 00 00 00 02 ca 75 23 00 00 00 00 00 02 cb 01 23 00 00 00 00 00 02 cc a5 23 00 00 00 00 00 02 cd 01 23 00 00 00 00 00 02 ce f0 23 00 00 00 00 00 02 cf 02 23 00 00 00 00 00 02 d0 29 23 00 00 00 00 00 02 d1 02 23 00 00 00 00 00 02 d2 2a 23 00 00 00 00 00 02 d3 02 23 00 00 00 00 00 02 d4 5f 23 00 00 00 00 00 02 d5 02 23 00 00 00 00 00 02 d6 9a 23 00 00 00 00 00 02 d7 02 23 00 00 00 00 00 02 d8 c2 23 00 00 00 00 00 02 d9 02 23 00 00 00 00 00 02 da f9 23 00 00 00 00 00 02 db 03 23 00 00 00 00 00 02 dc 1f 23 00 00 00 00 00 02 dd 03 23 00 00 00 00 00 02 de 50 23 00 00 00 00 00 02 df 03 23 00 00 00 00 00 02 e0 5f 23 00 00 00 00 00 02 e1 03 23 00 00 00 00 00 02 e2 6e 23 00 00 00 00 00 02 e3 03 23 00 00 00 00 00 02 e4 80 23 00 00 00 00 00 02 e5 03 23 00 00 00 00 00 02 e6 94 23 00 00 00 00 00 02 e7 03 23 00 00 00 00 00 02 e8 ac 23 00 00 00 00 00 02 e9 03 23 00 00 00 00 00 02 ea c3 23 00 00 00 00 00 02 eb 03 23 00 00 00 00 00 02 ec d2 23 00 00 00 00 00 02 ed 03 23 00 00 00 00 00 02 ee d3 23 00 00 00 00 00 02 ef 00 23 00 00 00 00 00 02 f0 d6 23 00 00 00 00 00 02 f1 00 23 00 00 00 00 00 02 f2 dd 23 00 00 00 00 00 02 f3 00 23 00 00 00 00 00 02 f4 ea 23 00 00 00 00 00 02 f5 00 23 00 00 00 00 00 02 f6 f6 23 00 00 00 00 00 02 f7 01 23 00 00 00 00 00 02 f8 02 23 00 00 00 00 00 02 f9 01 23 00 00 00 00 00 02 fa 0c 23 00 00 00 00 00 02 ff 02 23 00 00 00 00 00 02 fb 01 23 00 00 00 00 00 02 00 01 23 00 00 00 00 00 02 01 17 23 00 00 00 00 00 02 02 01 23 00 00 00 00 00 02 03 20 23 00 00 00 00 00 02 04 01 23 00 00 00 00 00 02 05 29 23 00 00 00 00 00 02 06 01 23 00 00 00 00 00 02 07 4b 23 00 00 00 00 00 02 08 01 23 00 00 00 00 00 02 09 67 23 00 00 00 00 00 02 0a 01 23 00 00 00 00 00 02 0b 97 23 00 00 00 00 00 02 0c 01 23 00 00 00 00 00 02 0d bf 23 00 00 00 00 00 02 0e 01 23 00 00 00 00 00 02 0f fe 23 00 00 00 00 00 02 10 02 23 00 00 00 00 00 02 11 32 23 00 00 00 00 00 02 12 02 23 00 00 00 00 00 02 13 34 23 00 00 00 00 00 02 14 02 23 00 00 00 00 00 02 15 66 23 00 00 00 00 00 02 16 02 23 00 00 00 00 00 02 17 a0 23 00 00 00 00 00 02 18 02 23 00 00 00 00 00 02 19 c8 23 00 00 00 00 00 02 1a 02 23 00 00 00 00 00 02 1b fe 23 00 00 00 00 00 02 1c 03 23 00 00 00 00 00 02 1d 26 23 00 00 00 00 00 02 1e 03 23 00 00 00 00 00 02 1f 56 23 00 00 00 00 00 02 20 03 23 00 00 00 00 00 02 21 64 23 00 00 00 00 00 02 22 03 23 00 00 00 00 00 02 23 74 23 00 00 00 00 00 02 24 03 23 00 00 00 00 00 02 25 85 23 00 00 00 00 00 02 26 03 23 00 00 00 00 00 02 27 99 23 00 00 00 00 00 02 28 03 23 00 00 00 00 00 02 29 b0 23 00 00 00 00 00 02 2a 03 23 00 00 00 00 00 02 2b c5 23 00 00 00 00 00 02 2d 03 23 00 00 00 00 00 02 2f d2 23 00 00 00 00 00 02 30 03 23 00 00 00 00 00 02 31 d3 23 00 00 00 00 00 02 32 00 23 00 00 00 00 00 02 33 d6 23 00 00 00 00 00 02 34 00 23 00 00 00 00 00 02 35 dd 23 00 00 00 00 00 02 36 00 23 00 00 00 00 00 02 37 ea 23 00 00 00 00 00 02 38 00 23 00 00 00 00 00 02 39 f6 23 00 00 00 00 00 02 3a 01 23 00 00 00 00 00 02 3b 02 23 00 00 00 00 00 02 3d 01 23 00 00 00 00 00 02 3f 0c 23 00 00 00 00 00 02 40 01 23 00 00 00 00 00 02 41 17 23 00 00 00 00 00 02 42 01 23 00 00 00 00 00 02 43 20 23 00 00 00 00 00 02 44 01 23 00 00 00 00 00 02 45 29 23 00 00 00 00 00 02 46 01 23 00 00 00 00 00 02 47 4b 23 00 00 00 00 00 02 48 01 23 00 00 00 00 00 02 49 67 23 00 00 00 00 00 02 4a 01 23 00 00 00 00 00 02 4b 97 23 00 00 00 00 00 02 4c 01 23 00 00 00 00 00 02 4d bf 23 00 00 00 00 00 02 4e 01 23 00 00 00 00 00 02 4f fe 23 00 00 00 00 00 02 50 02 23 00 00 00 00 00 02 51 32 23 00 00 00 00 00 02 52 02 23 00 00 00 00 00 02 53 34 23 00 00 00 00 00 02 54 02 23 00 00 00 00 00 02 55 66 23 00 00 00 00 00 02 56 02 23 00 00 00 00 00 02 58 a0 23 00 00 00 00 00 02 59 02 23 00 00 00 00 00 02 5a c8 23 00 00 00 00 00 02 5b 02 23 00 00 00 00 00 02 5c fe 23 00 00 00 00 00 02 5d 03 23 00 00 00 00 00 02 5e 26 23 00 00 00 00 00 02 5f 03 23 00 00 00 00 00 02 60 56 23 00 00 00 00 00 02 61 03 23 00 00 00 00 00 02 62 64 23 00 00 00 00 00 02 63 03 23 00 00 00 00 00 02 64 74 23 00 00 00 00 00 02 65 03 23 00 00 00 00 00 02 66 85 23 00 00 00 00 00 02 67 03 23 00 00 00 00 00 02 68 99 23 00 00 00 00 00 02 69 03 23 00 00 00 00 00 02 6a b0 23 00 00 00 00 00 02 6b 03 23 00 00 00 00 00 02 6c c5 23 00 00 00 00 00 02 6d 03 23 00 00 00 00 00 02 6e d2 23 00 00 00 00 00 02 6f 03 23 00 00 00 00 00 02 70 d3 23 00 00 00 00 00 02 71 02 23 00 00 00 00 00 02 72 08 23 00 00 00 00 00 02 73 02 23 00 00 00 00 00 02 74 09 23 00 00 00 00 00 02 75 02 23 00 00 00 00 00 02 76 0b 23 00 00 00 00 00 02 77 02 23 00 00 00 00 00 02 78 0d 23 00 00 00 00 00 02 79 02 23 00 00 00 00 00 02 7a 0f 23 00 00 00 00 00 02 7b 02 23 00 00 00 00 00 02 7c 11 23 00 00 00 00 00 02 7d 02 23 00 00 00 00 00 02 7e 13 23 00 00 00 00 00 02 7f 02 23 00 00 00 00 00 02 80 15 23 00 00 00 00 00 02 81 02 23 00 00 00 00 00 02 82 17 23 00 00 00 00 00 02 83 02 23 00 00 00 00 00 02 84 1f 23 00 00 00 00 00 02 85 02 23 00 00 00 00 00 02 86 26 23 00 00 00 00 00 02 87 02 23 00 00 00 00 00 02 88 35 23 00 00 00 00 00 02 89 02 23 00 00 00 00 00 02 8a 44 23 00 00 00 00 00 02 8b 02 23 00 00 00 00 00 02 8c 62 23 00 00 00 00 00 02 8d 02 23 00 00 00 00 00 02 8e 83 23 00 00 00 00 00 02 8f 02 23 00 00 00 00 00 02 90 84 23 00 00 00 00 00 02 91 02 23 00 00 00 00 00 02 92 ac 23 00 00 00 00 00 02 93 02 23 00 00 00 00 00 02 94 e2 23 00 00 00 00 00 02 95 03 23 00 00 00 00 00 02 96 0b 23 00 00 00 00 00 02 97 03 23 00 00 00 00 00 02 98 3c 23 00 00 00 00 00 02 99 03 23 00 00 00 00 00 02 9a 5c 23 00 00 00 00 00 02 9b 03 23 00 00 00 00 00 02 9c 86 23 00 00 00 00 00 02 9d 03 23 00 00 00 00 00 02 9e 94 23 00 00 00 00 00 02 9f 03 23 00 00 00 00 00 02 a0 a2 23 00 00 00 00 00 02 a2 03 23 00 00 00 00 00 02 a3 b1 23 00 00 00 00 00 02 a4 03 23 00 00 00 00 00 02 a5 be 23 00 00 00 00 00 02 a6 03 23 00 00 00 00 00 02 a7 c8 23 00 00 00 00 00 02 a9 03 23 00 00 00 00 00 02 aa d0 23 00 00 00 00 00 02 ab 03 23 00 00 00 00 00 02 ac d3 23 00 00 00 00 00 02 ad 03 23 00 00 00 00 00 02 ae d4 23 00 00 00 00 00 02 af 02 23 00 00 00 00 00 02 b0 08 23 00 00 00 00 00 02 b1 02 23 00 00 00 00 00 02 b2 09 23 00 00 00 00 00 02 b3 02 23 00 00 00 00 00 02 b4 0b 23 00 00 00 00 00 02 b5 02 23 00 00 00 00 00 02 b6 0d 23 00 00 00 00 00 02 b7 02 23 00 00 00 00 00 02 b8 0f 23 00 00 00 00 00 02 b9 02 23 00 00 00 00 00 02 ba 11 23 00 00 00 00 00 02 bb 02 23 00 00 00 00 00 02 bc 13 23 00 00 00 00 00 02 bd 02 23 00 00 00 00 00 02 be 15 23 00 00 00 00 00 02 bf 02 23 00 00 00 00 00 02 c0 17 23 00 00 00 00 00 02 c1 02 23 00 00 00 00 00 02 c2 1f 23 00 00 00 00 00 02 c3 02 23 00 00 00 00 00 02 c4 26 23 00 00 00 00 00 02 c5 02 23 00 00 00 00 00 02 c6 35 23 00 00 00 00 00 02 c7 02 23 00 00 00 00 00 02 c8 44 23 00 00 00 00 00 02 c9 02 23 00 00 00 00 00 02 ca 62 23 00 00 00 00 00 02 cb 02 23 00 00 00 00 00 02 cc 83 23 00 00 00 00 00 02 cd 02 23 00 00 00 00 00 02 ce 84 23 00 00 00 00 00 02 cf 02 23 00 00 00 00 00 02 d0 ac 23 00 00 00 00 00 02 d1 02 23 00 00 00 00 00 02 d2 e2 23 00 00 00 00 00 02 d3 03 23 00 00 00 00 00 02 d4 0b 23 00 00 00 00 00 02 d5 03 23 00 00 00 00 00 02 d6 3c 23 00 00 00 00 00 02 d7 03 23 00 00 00 00 00 02 d8 5c 23 00 00 00 00 00 02 d9 03 23 00 00 00 00 00 02 da 86 23 00 00 00 00 00 02 db 03 23 00 00 00 00 00 02 dc 94 23 00 00 00 00 00 02 dd 03 23 00 00 00 00 00 02 de a2 23 00 00 00 00 00 02 df 03 23 00 00 00 00 00 02 e0 b1 23 00 00 00 00 00 02 e1 03 23 00 00 00 00 00 02 e2 be 23 00 00 00 00 00 02 e3 03 23 00 00 00 00 00 02 e4 c8 23 00 00 00 00 00 02 e5 03 23 00 00 00 00 00 02 e6 d0 23 00 00 00 00 00 02 e7 03 23 00 00 00 00 00 02 e8 d3 23 00 00 00 00 00 02 e9 03 23 01 00 00 00 00 02 ea d4 23 01 00 00 00 00 02 ff 00];
        qcom,mdss-dsi-cold-command-state = "dsi_hs_mode";
        qcom,mdss-dsi-warm-command-state = "dsi_hs_mode";
        qcom,mdss-dsi-default-command-state = "dsi_hs_mode";
        qcom,mdss-dsi-ceon-command-state = "dsi_lp_mode";
        qcom,mdss-dsi-ceoff-command-state = "dsi_lp_mode";
        qcom,mdss-dsi-eyecare-off-command-state = "dsi_hs_mode";
        qcom,mdss-dsi-eyecare-level1-command-state = "dsi_hs_mode";
        qcom,mdss-dsi-eyecare-level2-command-state = "dsi_hs_mode";
        qcom,mdss-dsi-eyecare-level3-command-state = "dsi_hs_mode";
        qcom,mdss-dsi-eyecare-level4-command-state = "dsi_hs_mode";
        qcom,mdss-dsi-eyecare-level5-command-state = "dsi_hs_mode";
        qcom,mdss-dsi-eyecare-level6-command-state = "dsi_hs_mode";
        qcom,mdss-dsi-eyecare-level7-command-state = "dsi_hs_mode";
        qcom,mdss-dsi-eyecare-level8-command-state = "dsi_hs_mode";
        qcom,mdss-dsi-panel-name = "boe nt35532 1080p video mode dsi panel";
        qcom,mdss-dsi-panel-type = "dsi_video_mode";
        qcom,mdss-dsi-panel-framerate = <60>;
        qcom,mdss-dsi-virtual-channel-id = <0>;
        qcom,mdss-dsi-stream = <0>;
        qcom,mdss-dsi-panel-width = <1080>;
        qcom,mdss-dsi-panel-height = <1920>;
        qcom,mdss-dsi-h-front-porch = <98>;
        qcom,mdss-dsi-h-back-porch = <98>;
        qcom,mdss-dsi-h-pulse-width = <8>;
        qcom,mdss-dsi-h-sync-skew = <0>;
        qcom,mdss-dsi-v-back-porch = <8>;
        qcom,mdss-dsi-v-front-porch = <10>;
        qcom,mdss-dsi-v-pulse-width = <2>;
        qcom,mdss-dsi-h-left-border = <0>;
        qcom,mdss-dsi-h-right-border = <0>;
        qcom,mdss-dsi-v-top-border = <0>;
        qcom,mdss-dsi-v-bottom-border = <0>;
        qcom,mdss-dsi-bpp = <24>;
        qcom,mdss-dsi-underflow-color = <0xff>;
        qcom,mdss-dsi-border-color = <0>;
        qcom,mdss-dsi-h-sync-pulse = <0>;
        qcom,mdss-dsi-traffic-mode = "burst_mode";
        qcom,mdss-dsi-bllp-eof-power-mode;
        qcom,mdss-dsi-bllp-power-mode;
        qcom,mdss-dsi-lane-0-state;
        qcom,mdss-dsi-lane-1-state;
        qcom,mdss-dsi-lane-2-state;
        qcom,mdss-dsi-lane-3-state;
        qcom,mdss-dsi-panel-timings = <0xe6382600 0x686c2a3c 0x2c030400>;
        qcom,mdss-dsi-t-clk-post = <0x02>;
        qcom,mdss-dsi-t-clk-pre = <0x2d>;
        qcom,mdss-dsi-bl-min-level = <1>;
        qcom,mdss-dsi-bl-max-level = <4095>;
        qcom,mdss-dsi-dma-trigger = "trigger_sw";
        qcom,mdss-dsi-mdp-trigger = "none";
        qcom,mdss-dsi-on-command = [23 01 00 00 00 00 02 ff ee 23 01 00 00 00 00 02 18 40 23 01 00 00 00 00 02 18 00 23 01 00 00 00 00 02 ff 01 23 01 00 00 00 00 02 fb 01 23 01 00 00 00 00 02 68 13 23 01 00 00 00 00 02 75 00 23 01 00 00 00 00 02 76 00 23 01 00 00 00 00 02 77 00 23 01 00 00 00 00 02 78 22 23 01 00 00 00 00 02 79 00 23 01 00 00 00 00 02 7a 51 23 01 00 00 00 00 02 7b 00 23 01 00 00 00 00 02 7c 73 23 01 00 00 00 00 02 7d 00 23 01 00 00 00 00 02 7e 8d 23 01 00 00 00 00 02 7f 00 23 01 00 00 00 00 02 80 a4 23 01 00 00 00 00 02 81 00 23 01 00 00 00 00 02 82 b8 23 01 00 00 00 00 02 83 00 23 01 00 00 00 00 02 84 ca 23 01 00 00 00 00 02 85 00 23 01 00 00 00 00 02 86 d9 23 01 00 00 00 00 02 87 01 23 01 00 00 00 00 02 88 0d 23 01 00 00 00 00 02 89 01 23 01 00 00 00 00 02 8a 36 23 01 00 00 00 00 02 8b 01 23 01 00 00 00 00 02 8c 75 23 01 00 00 00 00 02 8d 01 23 01 00 00 00 00 02 8e a7 23 01 00 00 00 00 02 8f 01 23 01 00 00 00 00 02 90 f2 23 01 00 00 00 00 02 91 02 23 01 00 00 00 00 02 92 2b 23 01 00 00 00 00 02 93 02 23 01 00 00 00 00 02 94 2b 23 01 00 00 00 00 02 95 02 23 01 00 00 00 00 02 96 61 23 01 00 00 00 00 02 97 02 23 01 00 00 00 00 02 98 9d 23 01 00 00 00 00 02 99 02 23 01 00 00 00 00 02 9a c6 23 01 00 00 00 00 02 9b 03 23 01 00 00 00 00 02 9c 01 23 01 00 00 00 00 02 9d 03 23 01 00 00 00 00 02 9e 27 23 01 00 00 00 00 02 9f 03 23 01 00 00 00 00 02 a0 63 23 01 00 00 00 00 02 a2 03 23 01 00 00 00 00 02 a3 6b 23 01 00 00 00 00 02 a4 03 23 01 00 00 00 00 02 a5 72 23 01 00 00 00 00 02 a6 03 23 01 00 00 00 00 02 a7 7e 23 01 00 00 00 00 02 a9 03 23 01 00 00 00 00 02 aa 87 23 01 00 00 00 00 02 ab 03 23 01 00 00 00 00 02 ac 93 23 01 00 00 00 00 02 ad 03 23 01 00 00 00 00 02 ae 9b 23 01 00 00 00 00 02 af 03 23 01 00 00 00 00 02 b0 a2 23 01 00 00 00 00 02 b1 03 23 01 00 00 00 00 02 b2 ff 23 01 00 00 00 00 02 b3 00 23 01 00 00 00 00 02 b4 00 23 01 00 00 00 00 02 b5 00 23 01 00 00 00 00 02 b6 22 23 01 00 00 00 00 02 b7 00 23 01 00 00 00 00 02 b8 51 23 01 00 00 00 00 02 b9 00 23 01 00 00 00 00 02 ba 73 23 01 00 00 00 00 02 bb 00 23 01 00 00 00 00 02 bc 8d 23 01 00 00 00 00 02 bd 00 23 01 00 00 00 00 02 be a4 23 01 00 00 00 00 02 bf 00 23 01 00 00 00 00 02 c0 b8 23 01 00 00 00 00 02 c1 00 23 01 00 00 00 00 02 c2 ca 23 01 00 00 00 00 02 c3 00 23 01 00 00 00 00 02 c4 d9 23 01 00 00 00 00 02 c5 01 23 01 00 00 00 00 02 c6 0d 23 01 00 00 00 00 02 c7 01 23 01 00 00 00 00 02 c8 36 23 01 00 00 00 00 02 c9 01 23 01 00 00 00 00 02 ca 75 23 01 00 00 00 00 02 cb 01 23 01 00 00 00 00 02 cc a7 23 01 00 00 00 00 02 cd 01 23 01 00 00 00 00 02 ce f2 23 01 00 00 00 00 02 cf 02 23 01 00 00 00 00 02 d0 2b 23 01 00 00 00 00 02 d1 02 23 01 00 00 00 00 02 d2 2b 23 01 00 00 00 00 02 d3 02 23 01 00 00 00 00 02 d4 61 23 01 00 00 00 00 02 d5 02 23 01 00 00 00 00 02 d6 9d 23 01 00 00 00 00 02 d7 02 23 01 00 00 00 00 02 d8 c6 23 01 00 00 00 00 02 d9 03 23 01 00 00 00 00 02 da 01 23 01 00 00 00 00 02 db 03 23 01 00 00 00 00 02 dc 27 23 01 00 00 00 00 02 dd 03 23 01 00 00 00 00 02 de 63 23 01 00 00 00 00 02 df 03 23 01 00 00 00 00 02 e0 6b 23 01 00 00 00 00 02 e1 03 23 01 00 00 00 00 02 e2 72 23 01 00 00 00 00 02 e3 03 23 01 00 00 00 00 02 e4 7e 23 01 00 00 00 00 02 e5 03 23 01 00 00 00 00 02 e6 87 23 01 00 00 00 00 02 e7 03 23 01 00 00 00 00 02 e8 93 23 01 00 00 00 00 02 e9 03 23 01 00 00 00 00 02 ea 9b 23 01 00 00 00 00 02 eb 03 23 01 00 00 00 00 02 ec a2 23 01 00 00 00 00 02 ed 03 23 01 00 00 00 00 02 ee ff 23 01 00 00 00 00 02 ef 00 23 01 00 00 00 00 02 f0 d6 23 01 00 00 00 00 02 f1 00 23 01 00 00 00 00 02 f2 dd 23 01 00 00 00 00 02 f3 00 23 01 00 00 00 00 02 f4 ea 23 01 00 00 00 00 02 f5 00 23 01 00 00 00 00 02 f6 f7 23 01 00 00 00 00 02 f7 01 23 01 00 00 00 00 02 f8 03 23 01 00 00 00 00 02 f9 01 23 01 00 00 00 00 02 fa 0d 23 01 00 00 00 00 02 ff 02 23 01 00 00 00 00 02 fb 01 23 01 00 00 00 00 02 00 01 23 01 00 00 00 00 02 01 17 23 01 00 00 00 00 02 02 01 23 01 00 00 00 00 02 03 21 23 01 00 00 00 00 02 04 01 23 01 00 00 00 00 02 05 2a 23 01 00 00 00 00 02 06 01 23 01 00 00 00 00 02 07 4b 23 01 00 00 00 00 02 08 01 23 01 00 00 00 00 02 09 68 23 01 00 00 00 00 02 0a 01 23 01 00 00 00 00 02 0b 98 23 01 00 00 00 00 02 0c 01 23 01 00 00 00 00 02 0d c0 23 01 00 00 00 00 02 0e 02 23 01 00 00 00 00 02 0f 00 23 01 00 00 00 00 02 10 02 23 01 00 00 00 00 02 11 34 23 01 00 00 00 00 02 12 02 23 01 00 00 00 00 02 13 35 23 01 00 00 00 00 02 14 02 23 01 00 00 00 00 02 15 68 23 01 00 00 00 00 02 16 02 23 01 00 00 00 00 02 17 a4 23 01 00 00 00 00 02 18 02 23 01 00 00 00 00 02 19 cc 23 01 00 00 00 00 02 1a 03 23 01 00 00 00 00 02 1b 07 23 01 00 00 00 00 02 1c 03 23 01 00 00 00 00 02 1d 2f 23 01 00 00 00 00 02 1e 03 23 01 00 00 00 00 02 1f 6a 23 01 00 00 00 00 02 20 03 23 01 00 00 00 00 02 21 71 23 01 00 00 00 00 02 22 03 23 01 00 00 00 00 02 23 85 23 01 00 00 00 00 02 24 03 23 01 00 00 00 00 02 25 9a 23 01 00 00 00 00 02 26 03 23 01 00 00 00 00 02 27 b2 23 01 00 00 00 00 02 28 03 23 01 00 00 00 00 02 29 ca 23 01 00 00 00 00 02 2a 03 23 01 00 00 00 00 02 2b e2 23 01 00 00 00 00 02 2d 03 23 01 00 00 00 00 02 2f f5 23 01 00 00 00 00 02 30 03 23 01 00 00 00 00 02 31 ff 23 01 00 00 00 00 02 32 00 23 01 00 00 00 00 02 33 d6 23 01 00 00 00 00 02 34 00 23 01 00 00 00 00 02 35 dd 23 01 00 00 00 00 02 36 00 23 01 00 00 00 00 02 37 ea 23 01 00 00 00 00 02 38 00 23 01 00 00 00 00 02 39 f7 23 01 00 00 00 00 02 3a 01 23 01 00 00 00 00 02 3b 03 23 01 00 00 00 00 02 3d 01 23 01 00 00 00 00 02 3f 0d 23 01 00 00 00 00 02 40 01 23 01 00 00 00 00 02 41 17 23 01 00 00 00 00 02 42 01 23 01 00 00 00 00 02 43 21 23 01 00 00 00 00 02 44 01 23 01 00 00 00 00 02 45 2a 23 01 00 00 00 00 02 46 01 23 01 00 00 00 00 02 47 4b 23 01 00 00 00 00 02 48 01 23 01 00 00 00 00 02 49 68 23 01 00 00 00 00 02 4a 01 23 01 00 00 00 00 02 4b 98 23 01 00 00 00 00 02 4c 01 23 01 00 00 00 00 02 4d c0 23 01 00 00 00 00 02 4e 02 23 01 00 00 00 00 02 4f 00 23 01 00 00 00 00 02 50 02 23 01 00 00 00 00 02 51 34 23 01 00 00 00 00 02 52 02 23 01 00 00 00 00 02 53 35 23 01 00 00 00 00 02 54 02 23 01 00 00 00 00 02 55 68 23 01 00 00 00 00 02 56 02 23 01 00 00 00 00 02 58 a4 23 01 00 00 00 00 02 59 02 23 01 00 00 00 00 02 5a cc 23 01 00 00 00 00 02 5b 03 23 01 00 00 00 00 02 5c 07 23 01 00 00 00 00 02 5d 03 23 01 00 00 00 00 02 5e 2f 23 01 00 00 00 00 02 5f 03 23 01 00 00 00 00 02 60 6a 23 01 00 00 00 00 02 61 03 23 01 00 00 00 00 02 62 71 23 01 00 00 00 00 02 63 03 23 01 00 00 00 00 02 64 85 23 01 00 00 00 00 02 65 03 23 01 00 00 00 00 02 66 9a 23 01 00 00 00 00 02 67 03 23 01 00 00 00 00 02 68 b2 23 01 00 00 00 00 02 69 03 23 01 00 00 00 00 02 6a ca 23 01 00 00 00 00 02 6b 03 23 01 00 00 00 00 02 6c e2 23 01 00 00 00 00 02 6d 03 23 01 00 00 00 00 02 6e f5 23 01 00 00 00 00 02 6f 03 23 01 00 00 00 00 02 70 ff 23 01 00 00 00 00 02 71 00 23 01 00 00 00 00 02 72 cd 23 01 00 00 00 00 02 73 00 23 01 00 00 00 00 02 74 d5 23 01 00 00 00 00 02 75 00 23 01 00 00 00 00 02 76 e3 23 01 00 00 00 00 02 77 00 23 01 00 00 00 00 02 78 ef 23 01 00 00 00 00 02 79 00 23 01 00 00 00 00 02 7a fb 23 01 00 00 00 00 02 7b 01 23 01 00 00 00 00 02 7c 06 23 01 00 00 00 00 02 7d 01 23 01 00 00 00 00 02 7e 11 23 01 00 00 00 00 02 7f 01 23 01 00 00 00 00 02 80 1b 23 01 00 00 00 00 02 81 01 23 01 00 00 00 00 02 82 24 23 01 00 00 00 00 02 83 01 23 01 00 00 00 00 02 84 46 23 01 00 00 00 00 02 85 01 23 01 00 00 00 00 02 86 63 23 01 00 00 00 00 02 87 01 23 01 00 00 00 00 02 88 94 23 01 00 00 00 00 02 89 01 23 01 00 00 00 00 02 8a bb 23 01 00 00 00 00 02 8b 01 23 01 00 00 00 00 02 8c fc 23 01 00 00 00 00 02 8d 02 23 01 00 00 00 00 02 8e 32 23 01 00 00 00 00 02 8f 02 23 01 00 00 00 00 02 90 32 23 01 00 00 00 00 02 91 02 23 01 00 00 00 00 02 92 66 23 01 00 00 00 00 02 93 02 23 01 00 00 00 00 02 94 a3 23 01 00 00 00 00 02 95 02 23 01 00 00 00 00 02 96 cc 23 01 00 00 00 00 02 97 03 23 01 00 00 00 00 02 98 0b 23 01 00 00 00 00 02 99 03 23 01 00 00 00 00 02 9a 38 23 01 00 00 00 00 02 9b 03 23 01 00 00 00 00 02 9c 8a 23 01 00 00 00 00 02 9d 03 23 01 00 00 00 00 02 9e 97 23 01 00 00 00 00 02 9f 03 23 01 00 00 00 00 02 a0 97 23 01 00 00 00 00 02 a2 03 23 01 00 00 00 00 02 a3 99 23 01 00 00 00 00 02 a4 03 23 01 00 00 00 00 02 a5 9b 23 01 00 00 00 00 02 a6 03 23 01 00 00 00 00 02 a7 9d 23 01 00 00 00 00 02 a9 03 23 01 00 00 00 00 02 aa 9f 23 01 00 00 00 00 02 ab 03 23 01 00 00 00 00 02 ac a1 23 01 00 00 00 00 02 ad 03 23 01 00 00 00 00 02 ae a2 23 01 00 00 00 00 02 af 00 23 01 00 00 00 00 02 b0 cd 23 01 00 00 00 00 02 b1 00 23 01 00 00 00 00 02 b2 d5 23 01 00 00 00 00 02 b3 00 23 01 00 00 00 00 02 b4 e3 23 01 00 00 00 00 02 b5 00 23 01 00 00 00 00 02 b6 ef 23 01 00 00 00 00 02 b7 00 23 01 00 00 00 00 02 b8 fb 23 01 00 00 00 00 02 b9 01 23 01 00 00 00 00 02 ba 06 23 01 00 00 00 00 02 bb 01 23 01 00 00 00 00 02 bc 11 23 01 00 00 00 00 02 bd 01 23 01 00 00 00 00 02 be 1b 23 01 00 00 00 00 02 bf 01 23 01 00 00 00 00 02 c0 24 23 01 00 00 00 00 02 c1 01 23 01 00 00 00 00 02 c2 46 23 01 00 00 00 00 02 c3 01 23 01 00 00 00 00 02 c4 63 23 01 00 00 00 00 02 c5 01 23 01 00 00 00 00 02 c6 94 23 01 00 00 00 00 02 c7 01 23 01 00 00 00 00 02 c8 bb 23 01 00 00 00 00 02 c9 01 23 01 00 00 00 00 02 ca fc 23 01 00 00 00 00 02 cb 02 23 01 00 00 00 00 02 cc 32 23 01 00 00 00 00 02 cd 02 23 01 00 00 00 00 02 ce 32 23 01 00 00 00 00 02 cf 02 23 01 00 00 00 00 02 d0 66 23 01 00 00 00 00 02 d1 02 23 01 00 00 00 00 02 d2 a3 23 01 00 00 00 00 02 d3 02 23 01 00 00 00 00 02 d4 cc 23 01 00 00 00 00 02 d5 03 23 01 00 00 00 00 02 d6 0b 23 01 00 00 00 00 02 d7 03 23 01 00 00 00 00 02 d8 38 23 01 00 00 00 00 02 d9 03 23 01 00 00 00 00 02 da 8a 23 01 00 00 00 00 02 db 03 23 01 00 00 00 00 02 dc 97 23 01 00 00 00 00 02 dd 03 23 01 00 00 00 00 02 de 97 23 01 00 00 00 00 02 df 03 23 01 00 00 00 00 02 e0 99 23 01 00 00 00 00 02 e1 03 23 01 00 00 00 00 02 e2 9b 23 01 00 00 00 00 02 e3 03 23 01 00 00 00 00 02 e4 9d 23 01 00 00 00 00 02 e5 03 23 01 00 00 00 00 02 e6 9f 23 01 00 00 00 00 02 e7 03 23 01 00 00 00 00 02 e8 a1 23 01 00 00 00 00 02 e9 03 23 01 00 00 00 00 02 ea a2 23 01 00 00 00 00 02 ff 00 23 01 00 00 00 00 02 36 00 23 01 00 00 00 00 02 35 00 23 01 00 00 00 00 02 ff 01 23 01 00 00 00 00 02 fb 01 23 01 00 00 00 00 02 6e 00 23 01 00 00 00 00 02 ff 04 23 01 00 00 00 00 02 fb 01 23 01 00 00 00 00 02 08 06 23 01 00 00 00 00 02 ff 00 23 01 00 00 00 00 02 fb 01 23 01 00 00 00 00 02 53 24 23 01 00 00 00 00 02 55 00 23 01 00 00 00 00 02 d3 0a 23 01 00 00 00 00 02 d4 0a 05 01 00 00 78 00 02 11 00 05 01 00 00 00 00 02 29 00];
        qcom,mdss-dsi-off-command = [05 01 00 00 96 00 02 28 00 05 01 00 00 96 00 02 10 00];
        qcom,mdss-dsi-on-command-state = "dsi_lp_mode";
        qcom,mdss-dsi-off-command-state = "dsi_lp_mode";
        qcom,mdss-dsi-bl-pmic-control-type = "bl_ctrl_wled";
        qcom,mdss-dsi-reset-sequence = <1 20>, <0 10>, <1 20>;
        qcom,mdss-dsi-tx-eot-append;
        qcom,cont-splash-enabled;
        qcom,panel-supply-entries = <&dsi_panel_pwr_supply>;
        qcom,mdss-pan-physical-width-dimension = <70>;
        qcom,mdss-pan-physical-height-dimension = <128>;
        qcom,mdss-dsi-panel-status-command = [06 01 00 01 05 00 02 0a 08];
        qcom,mdss-dsi-panel-status-command-state = "dsi_hs_mode";
        qcom,mdss-dsi-panel-status-check-mode = "reg_read";
        qcom,mdss-dsi-panel-status-value = <0x9c>;
        qcom,esd-check-enabled;
        qcom,mdss-night-brightness = <0x09 0x1b 0x2d 0x3f>;
    };
};
