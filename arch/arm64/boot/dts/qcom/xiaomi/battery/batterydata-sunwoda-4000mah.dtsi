/*
 * Copyright (c) 2015, The Linux Foundation. All rights reserved.
 * Copyright (C) 2016, XiaoMi, Inc.
 * Copyright (c) 2023, Irawans Prjkt. All rights reserved.
 *
 * This program is free software; you can redistribute it and/or modify
 * it under the terms of the GNU General Public License version 2 and
 * only version 2 as published by the Free Software Foundation.
 *
 * This program is distributed in the hope that it will be useful,
 * but WITHOUT ANY WARRANTY; without even the implied warranty of
 * MERCHANTABILITY or FITNESS FOR A PARTICULAR PURPOSE.  See the
 * GNU General Public License for more details.
 */
qcom,2162464_longcheer_ct865sunwoda_4000mah_averaged_masterslave_oct12th2015 {
    qcom,max-voltage-uv = <4400000>;
    qcom,nom-batt-capacity-mah = <4000>;
    qcom,batt-id-kohm = <50>;
    qcom,battery-beta = <4150>;
    qcom,battery-type = "2162464_longcheer_ct865sunwoda_4000mah_averaged_masterslave_oct12th2015";
    qcom,chg-rslow-comp-c1 = <2905279>;
    qcom,chg-rslow-comp-c2 = <3467482>;
    qcom,chg-rs-to-rslow = <911611>;
    qcom,chg-rslow-comp-thr = <0x99>;
    qcom,fastchg-current-ma = <2000>;
    qcom,checksum = <0x43de>;
    qcom,gui-version = "PMI8950GUI - 2.0.0.14";
    qcom,fg-profile-data = <0xf1837d7d 0x99811c7c 0x5e83ec6c 0xbf83118e 0x2182c999 0x98bcf1c8 0x5b0f1488 0xf7fb182 0x1b7d4b83 0x6771ac67 0xf3765682 0x5a998fbc 0x44c95e0d 0xed0fb55a 0x1470eefc 0x436d645 0xde3b0000 0x1c47943b 0x3f210000 0x00 0x00 0xaa6b276a 0x316a6588 0xb9745a69 0xe8629a80 0x886e9662 0xdc7ffba0 0x1d5d6318 0x65a0710c 0x2800ff36 0xf0113003 0x0c>;
};
