/*
 * Copyright (c) 2015, The Linux Foundation. All rights reserved.
 * Copyright (c) 2023, Irawans Prjkt. All rights reserved.
 *
 * This program is free software; you can redistribute it and/or modify
 * it under the terms of the GNU General Public License version 2 and
 * only version 2 as published by the Free Software Foundation.
 *
 * This program is distributed in the hope that it will be useful,
 * but WITHOUT ANY WARRANTY; without even the implied warranty of
 * MERCHANTABILITY or FITNESS FOR A PARTICULAR PURPOSE.  See the
 * GNU General Public License for more details.
 */

#include "mdss.dtsi"
#include "mdss-panels.dtsi"
#include "regulator.dtsi"

&mtp_batterydata {
    qcom,batt-id-range-pct = <15>;

    /delete-node/ qcom,itech-3000mah-4200mv;
    /delete-node/ qcom,itech-3000mah;

    #include "battery/batterydata-coslight-4000mah-10k.dtsi"
    #include "battery/batterydata-scud-4000mah.dtsi"
    #include "battery/batterydata-sunwoda-4000mah.dtsi"
};
