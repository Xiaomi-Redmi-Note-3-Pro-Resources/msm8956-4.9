/*
 * Copyright (c) 2015, The Linux Foundation. All rights reserved.
 * Copyright (c) 2023, Irawans Prjkt. All rights reserved.
 *
 * This program is free software; you can redistribute it and/or modify
 * it under the terms of the GNU General Public License version 2 and
 * only version 2 as published by the Free Software Foundation.
 *
 * This program is distributed in the hope that it will be useful,
 * but WITHOUT ANY WARRANTY; without even the implied warranty of
 * MERCHANTABILITY or FITNESS FOR A PARTICULAR PURPOSE.  See the
 * GNU General Public License for more details.
 */

&i2c_4 {
    /delete-node/ synaptics@20;

    atmel@4a {
        compatible = "atmel,mxt-ts-1";
        reg = <0x4a>;
        interrupt-parent = <&msm_gpio>;
        interrupts = <65 0x02>;
        vcc_i2c-supply = <&pm8950_l6>;
        pinctrl-names = "pmx_ts_active", "pmx_ts_suspend";
        pinctrl-0 = <&ts_int_active &ts_reset_active &ts_power_active>;
        pinctrl-1 = <&ts_int_suspend &ts_reset_suspend &ts_power_suspend>;
        atmel,family-id = <0x82>;
        atmel,reset-gpio = <&msm_gpio 64 0x00>;
        atmel,power_ldo-gpio = <&msm_gpio 134 0x00>;
        atmel,irq-gpio = <&msm_gpio 65 0x2008>;
        atmel,display-coords = <0 0 1080 1920>;
        atmel,panel-coords = <0 0 1080 1920>;
        atmel,button-map = <158 102 139>;
        atmel,no-force-update;
        atmel,i2c-pull-up;
    };

    focaltech@38 {
        compatible = "focaltech,5x06";
        reg = <0x38>;
        interrupt-parent = <&msm_gpio>;
        interrupts = <65 0x2008>;
        vdd-supply = <&pm8950_l10>;
        vcc_i2c-supply = <&pm8950_l6>;
        pinctrl-names = "pmx_ts_active", "pmx_ts_suspend", "pmx_ts_release";
        pinctrl-0 = <&ts_int_active &ts_reset_active &ts_power_active>;
        pinctrl-1 = <&ts_int_suspend &ts_reset_suspend &ts_power_suspend>;
        pinctrl-2 = <&ts_release>;
        focaltech,name = "ft5346";
        focaltech,family-id = <0x54>;
        focaltech,reset-gpio = <&msm_gpio 64 0x00>;
        focaltech,irq-gpio = <&msm_gpio 65 0x2008>;
        focaltech,power-gpio = <&msm_gpio 134 0x00>;
        focaltech,display-coords = <0 0 1080 1920>;
        focaltech,panel-coords = <0 0 1080 2098>;
        focaltech,button-map = <139 102 158>;
        focaltech,fw-name = "ct820_ft_fw.bin";
        focaltech,fw-auto-update;
        focaltech,i2c-pull-up;
        focaltech,group-id = <0x01>;
        focaltech,hard-reset-delay-ms = <20>;
        focaltech,soft-reset-delay-ms = <30>;
        focaltech,num-max-touches = <10>;
        focaltech,fw-delay-aa-ms = <2>;
        focaltech,fw-delay-55-ms = <2>;
        focaltech,fw-upgrade-id1 = <0x54>;
        focaltech,fw-upgrade-id2 = <0x2c>;
        focaltech,fw-delay-readid-ms = <10>;
        focaltech,fw-delay-era-flsh-ms = <2000>;
        focaltech,fw-auto-cal;
        focaltech,ignore-id-check;
    };
};
